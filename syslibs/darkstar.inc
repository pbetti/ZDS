;****** Equ's file autogenerated by genequs ver: 1.0
;****** Input files:
;****** SysCommon.lst
VI0            	.equ	0xFFF0
VI1            	.equ	0xFFF2
VI2            	.equ	0xFFF4
VI3            	.equ	0xFFF6
VI4            	.equ	0xFFF8
VI5            	.equ	0xFFFA
VI6            	.equ	0xFFFC
VI7            	.equ	0xFFFE
TX0            	.equ	0xFF15
FIN            	.equ	0xFE5E
VC00           	.equ	0xFDCB
VC01           	.equ	0xFDCF
DLY1           	.equ	0xFD87
DLY2           	.equ	0xFD85
RPCH           	.equ	0xFE49
FOUT           	.equ	0xFE7F
U1NUL          	.equ	0xFF03
U0ISR          	.equ	0xFEC7
U1ISR          	.equ	0xFEFA
DELAY          	.equ	0xFD83
UISRE          	.equ	0xFEEF
FSTAT          	.equ	0xFE4F
UISRI          	.equ	0xFED9
COUT00         	.equ	0xFDE2
PRINT          	.equ	0xFE2F
UISRS          	.equ	0xFEEC
DOSTX          	.equ	0xFF0D
DGCLP0         	.equ	0xFDEF
PRINT0         	.equ	0xFE31
PRINT1         	.equ	0xFE40
BBU1ST         	.equ	0xFC3A
BBU1RX         	.equ	0xFC35
BBU1TX         	.equ	0xFC30
BBEXEC         	.equ	0xFD28
BBHDRD         	.equ	0xFCEE
BBVOID         	.equ	0xFD68
DISPCH         	.equ	0xFDEE
INLINE         	.equ	0xFE43
UASTKB         	.equ	0xFF2E
MMPMAP         	.equ	0xFD69
INTRDI         	.equ	0xFEB1
BBDBOX         	.equ	0xFC62
SCONIN         	.equ	0xFC21
VCONIN         	.equ	0xFC0D
BBDIV16        	.equ	0xFCD0
BBHDWR         	.equ	0xFCE9
MMGETP         	.equ	0xFD76
INTREN         	.equ	0xFEA0
RLDROM         	.equ	0xFF21
BBMUL16        	.equ	0xFCD5
UASTAV         	.equ	0xFF2C
MOVRGT         	.equ	0xFDD2
SYTIMR         	.equ	0xFEBB
SCONST         	.equ	0xFC26
VCONST         	.equ	0xFC12
SRXRSM         	.equ	0xFF0B
SCRTST         	.equ	0xFE01
SRXSTP         	.equ	0xFF07
BBEXEC1        	.equ	0xFD25
BBEXEC2        	.equ	0xFD20
BBEXEC3        	.equ	0xFD1B
BBU0INI        	.equ	0xFC2B
BBU1INI        	.equ	0xFC3F
BBFREAD        	.equ	0xFC85
BBEIDCK        	.equ	0xFD02
BBHDGEO        	.equ	0xFCF3
BBSTACK        	.equ	0xFF5E
BBFHOME        	.equ	0xFC80
BBCONIN        	.equ	0xFD92
SINTVEC        	.equ	0xFFF0
UPDVIDP        	.equ	0xFE09
VBCEXIT        	.equ	0xFDE9
SYSCMLO        	.equ	0xFF5E
VOIDISR        	.equ	0xFEC4
BBCONST        	.equ	0xFDA8
EOSTEST        	.equ	0xFDD6
SCRSPOS        	.equ	0xFE0E
SCONOUT        	.equ	0xFC1C
VCONOUT        	.equ	0xFDB3
BBJBNK_2       	.equ	0xFC1E
BBJBNK_3       	.equ	0xFC3C
BBCONOU2       	.equ	0xFC53
BBOFFCAL       	.equ	0xFCDA
BBINICTC       	.equ	0xFC44
BBSTBASE       	.equ	0xFF3A
BBRESCTC       	.equ	0xFC49
BBRDTIME       	.equ	0xFC9E
BBCALRET       	.equ	0xFD58
BBDMASET       	.equ	0xFCAD
BBDSKSEL       	.equ	0xFCB2
BBHDINIT       	.equ	0xFCDF
BBSECSET       	.equ	0xFCA8
BBUPLCHR       	.equ	0xFC6C
BBPRNCHR       	.equ	0xFC94
BBFLOPIO       	.equ	0xFC8F
BBSIDSET       	.equ	0xFCC6
BBLDPART       	.equ	0xFCF8
BBRDVDSK       	.equ	0xFC76
BBWRTIME       	.equ	0xFC99
BBSCROLL       	.equ	0xFC4E
BBFWRITE       	.equ	0xFC8A
BBGETCRS       	.equ	0xFC58
BBBOOTER       	.equ	0xFCC1
BBGETDSR       	.equ	0xFD0C
UPDTUREG       	.equ	0xFE1C
BBSETCRS       	.equ	0xFC5D
BBSETDSR       	.equ	0xFD07
BBCURSET       	.equ	0xFC17
BBTRKSET       	.equ	0xFCA3
BBWRVDSK       	.equ	0xFC7B
BBMVPART       	.equ	0xFD11
BBCONOUT       	.equ	0xFD9D
BBSYSINT       	.equ	0xFD16
BBDRIVEID      	.equ	0xFCE4
BBPSNDBLK      	.equ	0xFC67
BBCRTCINI      	.equ	0xFC03
BBPRCVBLK      	.equ	0xFC71
BBCRTFILL      	.equ	0xFC08
BBFDRVSEL      	.equ	0xFCCB
BBCPMBOOT      	.equ	0xFCB7
BBDPRMSET      	.equ	0xFCFD
BBUZIBOOT      	.equ	0xFCBC
;****** EOF ***

