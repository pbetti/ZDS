;****** Equ's file autogenerated by genequs ver: 1.0
;****** Input files:
;****** SysCommon.lst
VI0            	.equ	0xFFF0
VI1            	.equ	0xFFF2
VI2            	.equ	0xFFF4
VI3            	.equ	0xFFF6
VI4            	.equ	0xFFF8
VI5            	.equ	0xFFFA
VI6            	.equ	0xFFFC
VI7            	.equ	0xFFFE
TX0            	.equ	0xFF38
FIN            	.equ	0xFE81
VC00           	.equ	0xFDEE
VC01           	.equ	0xFDF2
DLY1           	.equ	0xFDAA
DLY2           	.equ	0xFDA8
RPCH           	.equ	0xFE6C
FOUT           	.equ	0xFEA2
U1NUL          	.equ	0xFF26
U0ISR          	.equ	0xFEEA
U1ISR          	.equ	0xFF1D
DELAY          	.equ	0xFDA6
UISRE          	.equ	0xFF12
FSTAT          	.equ	0xFE72
UISRI          	.equ	0xFEFC
COUT00         	.equ	0xFE05
PRINT          	.equ	0xFE52
UISRS          	.equ	0xFF0F
DOSTX          	.equ	0xFF30
DGCLP0         	.equ	0xFE12
PRINT0         	.equ	0xFE54
PRINT1         	.equ	0xFE63
BBU1ST         	.equ	0xFC3A
BBU1RX         	.equ	0xFC35
BBU1TX         	.equ	0xFC30
BBEXEC         	.equ	0xFD4B
BBHDRD         	.equ	0xFCE9
BBVOID         	.equ	0xFD8B
DISPCH         	.equ	0xFE11
INLINE         	.equ	0xFE66
UASTKB         	.equ	0xFF51
MMPMAP         	.equ	0xFD8C
INTRDI         	.equ	0xFED4
BBDBOX         	.equ	0xFC62
SCONIN         	.equ	0xFC21
VCONIN         	.equ	0xFC0D
BBDIV16        	.equ	0xFCC1
BBHDWR         	.equ	0xFCE4
MMGETP         	.equ	0xFD99
INTREN         	.equ	0xFEC3
RLDROM         	.equ	0xFF44
BBMUL16        	.equ	0xFCC6
UASTAV         	.equ	0xFF4F
MOVRGT         	.equ	0xFDF5
SYTIMR         	.equ	0xFEDE
SCONST         	.equ	0xFC26
VCONST         	.equ	0xFC12
SRXRSM         	.equ	0xFF2E
SCRTST         	.equ	0xFE24
SRXSTP         	.equ	0xFF2A
BBEXEC1        	.equ	0xFD48
BBEXEC2        	.equ	0xFD43
BBEXEC3        	.equ	0xFD3E
BBEXEC4        	.equ	0xFD39
BBEXEC5        	.equ	0xFD34
BBEXEC6        	.equ	0xFD2F
BBEXEC7        	.equ	0xFD2A
BBU0INI        	.equ	0xFC2B
BBU1INI        	.equ	0xFC3F
BBFREAD        	.equ	0xFC85
BBEIDCK        	.equ	0xFCFD
BBHDGEO        	.equ	0xFCEE
BBSTACK        	.equ	0xFF81
BBFHOME        	.equ	0xFC80
BBCONIN        	.equ	0xFDB5
SINTVEC        	.equ	0xFFF0
UPDVIDP        	.equ	0xFE2C
VBCEXIT        	.equ	0xFE0C
SYSCMLO        	.equ	0xFF81
VOIDISR        	.equ	0xFEE7
BBCONST        	.equ	0xFDCB
EOSTEST        	.equ	0xFDF9
SCRSPOS        	.equ	0xFE31
SCONOUT        	.equ	0xFC1C
VCONOUT        	.equ	0xFDD6
BBJBNK_2       	.equ	0xFC1E
BBJBNK_3       	.equ	0xFC3C
BBJBNK_4       	.equ	0xFC5A
BBJBNK_5       	.equ	0xFC78
BBJBNK_6       	.equ	0xFC96
BBJBNK_7       	.equ	0xFCB4
BBCONOU2       	.equ	0xFC53
BBSYSFN1       	.equ	0xFD20
BBSYSFN2       	.equ	0xFD25
BBOFFCAL       	.equ	0xFCCB
BBINICTC       	.equ	0xFC44
BBSTBASE       	.equ	0xFF5D
BBRESCTC       	.equ	0xFC49
BBRDTIME       	.equ	0xFC9E
BBCALRET       	.equ	0xFD7B
BBDMASET       	.equ	0xFCAD
BBDSKSEL       	.equ	0xFCB2
BBHDINIT       	.equ	0xFCDA
BBSECSET       	.equ	0xFCA8
BBUPLCHR       	.equ	0xFC6C
BBPRNCHR       	.equ	0xFC94
BBFLOPIO       	.equ	0xFC8F
BBSIDSET       	.equ	0xFCB7
BBLDPART       	.equ	0xFCF3
BBRDVDSK       	.equ	0xFC76
BBWRTIME       	.equ	0xFC99
BBSCROLL       	.equ	0xFC4E
BBFWRITE       	.equ	0xFC8A
BBGETCRS       	.equ	0xFC58
BBGETDSR       	.equ	0xFD07
UPDTUREG       	.equ	0xFE3F
BBSETCRS       	.equ	0xFC5D
BBSETDSR       	.equ	0xFD02
BBCURSET       	.equ	0xFC17
BBTRKSET       	.equ	0xFCA3
BBWRVDSK       	.equ	0xFC7B
BBMVPART       	.equ	0xFD0C
BBCONOUT       	.equ	0xFDC0
BBSYSMON       	.equ	0xFD16
BBSYSINT       	.equ	0xFD11
BBSYSEXT       	.equ	0xFD1B
BBDRIVEID      	.equ	0xFCDF
BBPSNDBLK      	.equ	0xFC67
BBCRTCINI      	.equ	0xFC03
BBPRCVBLK      	.equ	0xFC71
BBCRTFILL      	.equ	0xFC08
BBFDRVSEL      	.equ	0xFCBC
BBLOGHDRV      	.equ	0xFCD0
BBDPRMSET      	.equ	0xFCF8
BBCURHDRV      	.equ	0xFCD5
;****** EOF ***

