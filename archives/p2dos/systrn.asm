;;
;; SYSTRN.ASM
;; (c) 2006 Piergiorgio Betti <pbetti@lpconsul.net>
;; This is a freeware program. You can use it without limitations.
;;
;;-----------------------------------------------------------------------------
;; Simple utility to transfer system (CP/M) sectors from
;; disk to disk
;;.............................................................................
;;

; load symbols from BIOS ...
rsym bios.sym
;
;
VERSMA	EQU	1			; VERSION MAJOR,MINOR
VERSMI	EQU	0
BDOSE	EQU	$0005			; BDOS FUNCTION CALL ENTRY PT
;
;--[ REAL CODE START HERE ]
;
	ORG	TPA
	;
	JP	SYSTRN
;
;--[ INTERNAL STORAGE ]
;
; VARS
STKBAS:	DEFS	64			; LOCAL STACK
STKTOP	EQU	$
SRCD:	DEFS	1			; SOURCE,DEST DISKS
DSTD:	DEFS	1
SNSEC:	DEFW	0			; S&D SECTORS #
SLSEC:	DEFW	0			; S&D SECTORS LEN
CSEC:	DEFW	0			; I/O REGISTERS: SEC
CTRK:	DEFW	0			; TRACK
COFF:	DEFW	0			; DMA
CTRN:	DEFW	0
RSEC:	DEFB	0
;
; MESSAGES
;
LOGONM:	DEFB	CR,LF
	DEFB	"SYSTRN ",(VERSMA+'0'),'.',(VERSMI+'0')
	DEFB	CR,LF
	DEFB	"Disk-to-disk CP/M transfer utility."
	DEFB	CR,LF,CR,LF,0
MSOUDK:	DEFB	CR,LF,"ENTER SYSTEM SOURCE DISK [A-P] : ",0
MDESDK:	DEFB	CR,LF,"ENTER DESTINATION DISK [A-P] : ",0
MWRNGD:	DEFB	CR,LF,"WRONG DRIVE NUMBER!",CR,LF,0
MINSED:	DEFB	CR,LF,"Insert ",0
MSOURC:	DEFB	"source ",0
MDESTI:	DEFB	"destination ",0
MPRESS:	DEFB	"disk and press any key..",CR,LF,0
MDONE:	DEFB	CR,LF,"CP/M + BOOTLOADER TRANSFERRED OK.",CR,LF,0
;
;--[ START ]
; prompt user for orig and destination

SYSTRN:
	LD	SP,STKTOP		; INIT STACK, DISABLE INTERRUPTS
	LD	IX,PHYPRM		; IX point to current CHS info IN BIOS
IF	INTRON
	DI
ENDIF
	LD	HL,LOGONM		; DISP LOGON
	CALL	ZDISP
SAGAIN:	LD	HL,MSOUDK		; ASK FOR SOURCE
	CALL	ZDISP
	CALL	TTYI			; GET IT
	CALL	CHKDNM			; CHECK RANGE
	LD	(SRCD),A		; STORE ANSWER
	CP	$FF
	JR	NZ,GOTSRC
	LD	HL,MWRNGD		; WARN USER
	CALL	ZDISP
	JR	SAGAIN			; ASK AGAIN
	;
GOTSRC:	LD	HL,MDESDK		; ASK FOR DESTINATION
	CALL	ZDISP
	CALL	TTYI			; GET IT
	CALL	CHKDNM			; CHECK RANGE
	LD	(DSTD),A		; STORE ANSWER
	CP	$FF
	JR	NZ,GOTDST
	LD	HL,MWRNGD		; WARN USER
	CALL	ZDISP
	JR	GOTSRC			; ASK AGAIN
	;
GOTDST:	LD	HL,MINSED		; PROMPT USER FOR SOURCE IN DRIVE
	CALL	ZDISP
	LD	HL,MSOURC
	CALL	ZDISP
	LD	HL,MPRESS
	CALL	ZDISP
	CALL	WAITK			; WAIT...
	LD	A,(SRCD)		; RETRIEVE SRC
	LD	C,A
	CALL	BSELDSK
	CALL	SELDSK			; CALL BIOS DIRECTLY
	LD	A,L			; OK ?
	OR	H
	JR	NZ,STEP01
	LD	HL,MWRNGD		; WARN USER
	CALL	ZDISP
	JR	SAGAIN			; ASK AGAIN
	;
STEP01:	LD	DE,16			; EXTRACT TRANS TABLE ADDRESS
	ADD	HL,DE
	LD	(CTRN),HL
	LD	L,(IX+2)		; GET SEC LEN FROM SEL DRV
	LD	H,(IX+3)
	LD	(SLSEC),HL		; STORE
	EX	DE,HL			; STORE LEN IN DE AS DIVISOR
	LD	BC,BEGDAT-CCP		; STORE CP/M LEN AS DIVIDEND
	CALL	BBDIV16			; DIVIDEND
	PUSH	BC			; BC IS THE QUOTIENT
	POP	HL			; LOAD IN HL
	INC	HL			; ADD 1 FOR THE BOOTLOADER
	LD	(SNSEC),HL		; STORE #
	;
	; now load the image
	;
	LD	HL,SYSSTO
	LD	(COFF),HL		; INIT DMA
	XOR	A
	LD	(CTRK),A		; INIT TRACK
	LD	(RSEC),A		; SEC. COUNT
SRTRK:	INC	A
	LD	(CSEC),A		; SECTOR
RNSEC:	LD	BC,(COFF)		; TRANSFER PARAMS TO BIOS
	CALL	BBDMASET
	LD	BC,(CTRK)
	CALL	BBTRKSET
	LD	BC,(CSEC)		; TRANSLATE SECTOR
	LD	DE,(CTRN)
	CALL	LSECTRA
	CALL	BBSECSET
	CALL	DREADH			; LOAD SEC
	LD	HL,(COFF)
	LD	BC,(SLSEC)
	ADD	HL,BC			; NEXT DMA OFFSET
	LD	(COFF),HL
	;
	LD	A,(SNSEC)		; CHECK IMAGE SIZE
	LD	B,A
	LD	A,(RSEC)
	CP	B			; ALL SECS LOADED ?
	JR	Z,LOADED
	INC	A
	LD	(RSEC),A		; NO
	;
	LD	A,(CSEC)
	INC	A
	LD	B,(IX+0)
	INC	B
	CP	B			; EOT ?
	JR	Z,RNTRK
	LD	(CSEC),A
	JR	RNSEC
RNTRK:	LD	A,(CTRK)
	INC	A
	LD	(CTRK),A
	XOR	A
	JR	SRTRK
	;
	; NOW WE HAVE THE IMAGE
	;
LOADED:	LD	HL,MINSED		; PROMPT USER FOR DEST. IN DRIVE
	CALL	ZDISP
	LD	HL,MDESTI
	CALL	ZDISP
	LD	HL,MPRESS
	CALL	ZDISP
	CALL	WAITK			; WAIT...
	LD	A,(DSTD)		; RETRIEVE SRC
	LD	C,A
	CALL	BSELDSK
	CALL	SELDSK			; CALL BIOS DIRECTLY
	LD	A,L			; OK ?
	OR	H
	JR	NZ,STEP11
	LD	HL,MWRNGD		; WARN USER
	CALL	ZDISP
	JP	SAGAIN			; ASK AGAIN
	;
STEP11:	LD	DE,16			; EXTRACT TRANS TABLE ADDRESS
	ADD	HL,DE
	LD	(CTRN),HL
	;
	; now SAVE the image
	;
	LD	HL,SYSSTO
	LD	(COFF),HL		; INIT DMA
	XOR	A
	LD	(CTRK),A		; INIT TRACK
	LD	(RSEC),A		; SEC. COUNT
DWTRK:	INC	A
	LD	(CSEC),A		; SECTOR
WNSEC:	LD	BC,(COFF)		; TRANSFER PARAMS TO BIOS
	CALL	BBDMASET
	LD	BC,(CTRK)
	CALL	BBTRKSET
	LD	BC,(CSEC)		; TRANSLATE SECTOR
	LD	DE,(CTRN)
	CALL	LSECTRA
	CALL	BBSECSET
	CALL	DWRITH			; SAVE SEC
	LD	HL,(COFF)
	LD	BC,(SLSEC)
	ADD	HL,BC			; NEXT DMA OFFSET
	LD	(COFF),HL
	;
	LD	A,(SNSEC)		; CHECK IMAGE SIZE
	LD	B,A
	LD	A,(RSEC)
	CP	B			; ALL SECS SAVED ?
	JR	Z,SAVED
	INC	A
	LD	(RSEC),A		; NO
	;
	LD	A,(CSEC)
	INC	A
	LD	B,(IX+0)
	INC	B
	CP	B			; EOT ?
	JR	Z,WNTRK
	LD	(CSEC),A
	JR	WNSEC
WNTRK:	LD	A,(CTRK)
	INC	A
	LD	(CTRK),A
	XOR	A
	JR	DWTRK
SAVED:
	LD	HL,MDONE		; ENDING
	CALL	ZDISP
	;
	; TERMINATION
	;
EOP:
	JP	$0000

;
;--[ ROUTINES ]
;
	;
	; APPLY SKEW FACTOR
	;
LSECTRA:
	EX      DE,HL			; HL= trans
	ADD     HL,BC			; HL= trans(sector)
	LD      L,(HL)			; L = trans(sector)
	LD      H,0			; HL= trans(sector)
	RET				; with value in HL
	;
	; OUTPUT A CHAR USING BDOS
	;
BDOOUT:
	PUSH	BC
	PUSH	HL
	LD	C,2
	CALL	BDOSE
	POP	HL
	POP	BC
	RET
	;
	; OUTPUT A STRING
	;
ZDISP:	PUSH	DE
ZSDSP1:	LD	A,(HL)			; pick char pointed by HL
	OR	A			; is the terminating NUL ?
	JR	NZ,NZSDSP		; yes
	POP	DE
	RET
NZSDSP:	LD	E,A			;
	CALL	BDOOUT			; display it
	INC	HL			;
	JP	ZSDSP1			;
	;
	; TAKE A CHAR FOR KEYBD
	;
TTYI:	PUSH	BC
	LD	C,1
	CALL	BDOS
	POP	BC
	RET
	;
	; WAIT FOR A KEY, NO ECHO
	;
WAITK:	PUSH	BC
	PUSH	DE
	PUSH	HL
WAITK0:
	LD	C,6
	LD	E,0FFH
	CALL	BDOS
	AND	7FH
	JR	Z,WAITK0
	POP	HL
	POP	DE
	POP	BC
	RET
	;
	; CHECK ENTERED DRIVE NUM
	;
CHKDNM:	CP	$60			; CONVERT UPPERCASE
	JP	M,CKRNG
	CP	$7B
	JP	P,CKRNG
	RES	5,A
CKRNG:	CP	'A'			; MUST BE BETWEEN A AND P
	JP	M,CHKDKO
	CP	'Q'
	JP	P,CHKDKO
	SUB	'A'			; OK
	RET
CHKDKO:	LD	A,$FF
	RET
	;
	; 16 BY 16 BIT DIVISION
	;
	; IN BC = DIVIDEND
	; IN DE = DIVISOR
	; ----
	; OUT BC = QUOTIENT
	; OUT HL = REMAINDER
; DIV16:	LD	A,B
; 	LD	B,16
; DIVLO:	RL	C
; 	RLA
; 	ADC	HL,HL
; 	SBC	HL,DE
; 	JR	NC,$+3
; 	ADD	HL,DE
; 	CCF
; 	DJNZ	DIVLO
; 	RL	C
; 	RLA
; 	LD	B,A
; 	RET
; DIV16:	LD	A,D
; 	OR	E
; 	JR	Z,DVERR			; DIVIDE BY 0 CHECK
; 	LD	A,B
; 	LD	HL,0
; 	LD	B,16
; DIVTRY:	RL	C
; 	RLA
; 	ADC	HL,HL
; 	SBC	HL,DE
; DIVNUL:	CCF
; 	JR	NC,DIVNGV
; DIVPTV:	DJNZ	DIVTRY
; 	JR	DIVDON
; DIVRST:	RL	C
; 	RLA
; 	ADC	HL,HL
; 	AND	A
; 	ADC	HL,DE
; 	JR	C,DIVPTV
; 	JR	Z,DIVNUL
; DIVNGV:	DJNZ	DIVRST
; DIVDON:	RL	C
; 	RLA
; 	ADD	HL,DE
; 	LD	B,A
; 	LD	A,0			; DIV OK
; 	RET
; DVERR:	LD	A,$FF			; DIV ERR
; 	RET

;--[ END OF PROGRAM ]
; after this point system image will be loaded...
;
SYSSTO	EQU	$

; REAL END
	END

;--EOF
