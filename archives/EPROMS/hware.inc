;

; -- Global --
iobyte		equ	0003h		; byte: Intel IOBYTE (CP/M 2.2 only)
cdisk		equ	0004h		; byte: Last logged drive
btpasiz		equ	0006h		; word: size of tpa + 1
;

;
; Some commodity equs
;
cr		equ	0dh		; ascii CR & LF
lf		equ	0ah
ff		equ	0ch		; FORM FEED (clear screen)
esc		equ	1bh		; ESCape
xonc		equ	11h		; Xon
xofc		equ	13h		; Xoff
true		equ	-1
false		equ	0
tpa		equ	0100h		; TPA base address (for CP/M)


; ---------------------------------------------------------------------
; LX529 VIDEO BOARD:
; ---------------------------------------------------------------------
crtbase		equ	80h
	; RAM0 for ascii chars & semi6. Combined with RAM1 and RAM2 for graphics
crtram0dat	equ	crtbase		; RAM0 access: PIO0 port A data register
crtram0cnt	equ	crtbase+2	; RAM0 access: PIO0 port A control register
	; Printer port
crtprntdat	equ	crtbase+1	; PRINTER (output): PIO0 port B data register
crtprntcnt	equ	crtbase+3	; PRINTER (output): PIO0 port B control register
					; STROBE is generated by hardware
	; RAM1 for graphics. (pixel index by RAM0+RAM1+RAM2)
crtram1dat	equ	crtbase+4	; RAM1 access: PIO1 port A data register
crtram1cnt	equ	crtbase+6	; RAM1 access: PIO1 port A control register
	; Keyboard port (negated). Bit 7 is for strobe
crtkeybdat	equ	crtbase+5	; KEYBOARD (input): PIO1 port B data register
crtkeybcnt	equ	crtbase+7	; KEYBOARD (input): PIO1 port B control register
keybstrbbit	equ	7		; Strobe bit
	; RAM2 for graphics. (pixel index by RAM0+RAM1+RAM2)
crtram2dat	equ	crtbase+8	; RAM2 access: PIO2 port A data register
crtram2cnt	equ	crtbase+10	; RAM2 access: PIO2 port A control register
	; Service/User port
crtservdat	equ	crtbase+9	; Service (i/o): PIO2 port B data register
crtservcnt	equ	crtbase+11	; Service (i/o): PIO2 port B control register
					; Other bits available to user
	; RAM3 control chars/graphics attributes
crtram3port	equ	crtbase+14	; RAM3 port
crtblinkbit	equ	0		; Blink
crtrevrsbit	equ	1		; Reverse
crtunderbit	equ	2		; Underline
crthilitbit	equ	3		; Highlight
crtmodebit	equ	4		; ASCII/GRAPHIC mode
	; Beeper port
crtbeepport	equ	crtbase+15	; Beeper port
	; 6545 CRT controller ports
crt6545adst	equ	crtbase+12	; Address & Status register
crt6545data	equ	crtbase+13	; Data register
endvid		equ	07cfh		; end video cursor (25*80)
; ---------------------------------------------------------------------
; LX390 FDC CONTROLLER:
; ---------------------------------------------------------------------
fdcbase		equ	0d0h
fdccmdstatr	equ	fdcbase		; Command and status register
fdctrakreg	equ	fdcbase+1	; Track register
fdcsectreg	equ	fdcbase+2	; Sector register
fdcdatareg	equ	fdcbase+7	; Data register *** Verificare che sia $d7
fdcdrvrcnt	equ	fdcbase+6	; Driver select/control register
;
fdcrestc	equ	00000111b	; 1771 restore (seek to trak 0) cmd
fdcseekc	equ	00010110b	; seek cmd
fdcreadc	equ	10001000b	; read cmd
fdcwritc	equ	10101000b	; write cmd
fdcreset	equ	11010000b	; fdc reset immediate cmd
;
; ---------------------------------------------------------------------
; LX389: PARALLEL INTERFACE
; ---------------------------------------------------------------------;
; parallel port PC link
ppdatap		equ	03h		; Data port
ppcntrp		equ	02h		; Control port
