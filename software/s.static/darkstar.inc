;****** Equ's file autogenerated by genequs ver: 1.0
;****** Input files:
;****** SysCommon.lst
TX0            	.equ	0xFE76
FIN            	.equ	0xFDC4
TX01           	.equ	0xFE78
DLY1           	.equ	0xFD89
DLY2           	.equ	0xFD87
FOUT           	.equ	0xFDE1
U1NUL          	.equ	0xFE64
U0ISR          	.equ	0xFE25
U1ISR          	.equ	0xFE5B
DELAY          	.equ	0xFD85
UISRE          	.equ	0xFE50
FSTAT          	.equ	0xFDB5
UISRI          	.equ	0xFE35
DOSTX          	.equ	0xFE6E
BBU1ST         	.equ	0xFC4B
BBU1RX         	.equ	0xFC45
BBU1TX         	.equ	0xFC3F
BBEXEC         	.equ	0xFD29
BBHDRD         	.equ	0xFCFF
BBVOID         	.equ	0xFD6A
UASTKB         	.equ	0xFE91
MMPMAP         	.equ	0xFD6B
INTRDI         	.equ	0xFE0F
SCONIN         	.equ	0xFC2D
VCONIN         	.equ	0xFC15
BBDIV16        	.equ	0xFCDB
BBHDWR         	.equ	0xFCF9
MMGETP         	.equ	0xFD78
INTREN         	.equ	0xFDFE
RLDROM         	.equ	0xFE84
BBMUL16        	.equ	0xFCE1
SYSCOM         	.equ	0xFC00
UASTAV         	.equ	0xFE8F
SYTIMR         	.equ	0xFE19
SCONST         	.equ	0xFC33
VCONST         	.equ	0xFC1B
SRXRSM         	.equ	0xFE6C
SRXSTP         	.equ	0xFE68
BBU0INI        	.equ	0xFC39
BBU1INI        	.equ	0xFC51
BBFREAD        	.equ	0xFC87
BBEIDCK        	.equ	0xFD23
BBHDGEO        	.equ	0xFD05
BBSTACK        	.equ	0xFEBF
BBFHOME        	.equ	0xFC81
BBCONIN        	.equ	0xFD94
CRDUREG        	.equ	0xFC27
SINTVEC        	.equ	0xFFF0
SYSCMLO        	.equ	0xFEBF
VOIDISR        	.equ	0xFE22
BBSTTIM        	.equ	0xFC9F
BBCONST        	.equ	0xFDAA
SCONOUT        	.equ	0xFC27
VCONOUT        	.equ	0xFC0F
BBOFFCAL       	.equ	0xFCE7
BBINICTC       	.equ	0xFC57
BBSTBASE       	.equ	0xFE9B
BBRESCTC       	.equ	0xFC5D
BBRDTIME       	.equ	0xFCA5
BBCALRET       	.equ	0xFD5A
BBDMASET       	.equ	0xFCB7
BBJTOBNK       	.equ	0xFC00
BBDSKSEL       	.equ	0xFCBD
BBHDINIT       	.equ	0xFCED
BBSECSET       	.equ	0xFCB1
BBHDBOOT       	.equ	0xFD0B
BBUPLCHR       	.equ	0xFC69
BBPRNCHR       	.equ	0xFC99
BBVCPMBT       	.equ	0xFCC9
BBFLOPIO       	.equ	0xFC93
BBEPMNGR       	.equ	0xFD1D
BBSIDSET       	.equ	0xFCCF
BBLDPART       	.equ	0xFD11
BBRDVDSK       	.equ	0xFC75
BBFWRITE       	.equ	0xFC8D
BBCPBOOT       	.equ	0xFCC3
BBCURSET       	.equ	0xFC21
BBTRKSET       	.equ	0xFCAB
BBWRVDSK       	.equ	0xFC7B
BBCONOUT       	.equ	0xFD9F
BBDRIVEID      	.equ	0xFCF3
BBPSNDBLK      	.equ	0xFC63
BBCRTCINI      	.equ	0xFC03
BBPRCVBLK      	.equ	0xFC6F
BBCRTFILL      	.equ	0xFC09
BBFDRVSEL      	.equ	0xFCD5
BBDPRMSET      	.equ	0xFD17
;****** EOF ***

