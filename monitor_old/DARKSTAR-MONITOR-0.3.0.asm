;
;
; Z80 Nuova Elettronica Monitor 390 su eprom 2532 (4k)
;
; Disassemblato e ricostruito da Piergiorgio Betti <pbetti@lpconsul.net>
; 2005 01 26
;
; ---[20051030]--------------------------------------------------------
; Avviate modifiche per inserimento routine di download parallelo
; ---[20051109]--------------------------------------------------------
; Versionata come 0.2.0. Da questa release iniziano modifiche di
; struttura
; - rinominati entry point
; - cancellata UKROUT
; - cancellata DISPGR . ATTENZIONE: TUTTI GLI INDIRIZZI SONO CAMBIATI!!
; - DISPGR2 rinominata DISPGR
; - rilocati tutti i buffer nell'area $003b-$004f non usata dal CP/M
; - numero versione 1.0
; - removed code from $f97c to $f9f1....
; - removed code from $fa2f to $fa37....
; ---[20051113]--------------------------------------------------------
; - Completate routine di I/O su parallela. Nuova copia su EPROM.
; ---[20051114]--------------------------------------------------------
; Release 0.2.3
; - Gestione errore per link parallelo (TX only)
; ---[20051216]--------------------------------------------------------
; Versione 1.1, funzionamento ok del'i/o parallelo.
; Inserita routine di boot CP/M da parallela
; ---[20051216]--------------------------------------------------------
; Release 0.2.4
; - Riunificati MIOBYTE e CYOBYTE con conseguente eliminazione di
;   CYOBYTE
; - Eliminata doppia tabella di inizializzazione SY6545 e copia della
;   tabella in RAM ($0010)
; ---[20060204]--------------------------------------------------------
; Release 0.2.5
; - sistemazione del codice (maiuscolo, tabulazioni)
; - inserito menu do boot
; ---[20060213]--------------------------------------------------------
; Release 0.2.6
; - Fixed DSELBF init from previous release
; - Moved here some code from from BIOS to keep space
; - Removed GETKBD (redundant)
; - Moved SETSID from BIOS
; - Revised internal buffer organization
; - Removed unused routines (LPAGE,BLOOP) and data (RAMBLOCK)
; - Cleaned up splitted routines (BCONIN/BCONOUT)
; - Completeley revised BOOT routine
; ---[20060302]--------------------------------------------------------
; Release 0.3.0
; - Added the followin routines to cope with floppy bootloader (and
;   CP/M WBOOT) adding on-the-fly skew capabilities
;   o DIV16 - 16 by 16 integer division
;   o MUL16 - 16 by 16 integer multiplication
;   o TRANSK - calculate skew factor on-the-fly
;   o OFFCAL - apply a read skew factor to sequential written
;              floppies. Used by bootloader and CP/M WBOOT.
; - Version number moved to 2.0
; - drive i/o no more rely on sector lenght
; ---------------------------------------------------------------------

;
; Monitor version numbers (major.minor)
;
MONMAJ		EQU	'2'
MONMIN		EQU	'0'

; Defines for the i/o ports
;
; *** LX529 VIDEO BOARD:
CRTBASE		EQU	$80
	; RAM0 for ascii chars & semi6. Combined with RAM1 and RAM2 for graphics
CRTRAM0DAT	EQU	CRTBASE		; RAM0 access: PIO0 port A data register
CRTRAM0CNT	EQU	CRTBASE+2	; RAM0 access: PIO0 port A control register
	; Printer port
CRTPRNTDAT	EQU	CRTBASE+1	; PRINTER (output): PIO0 port B data register
CRTPRNTCNT	EQU	CRTBASE+3	; PRINTER (output): PIO0 port B control register
					; STROBE is generated by hardware
	; RAM1 for graphics. (pixel index by RAM0+RAM1+RAM2)
CRTRAM1DAT	EQU	CRTBASE+4	; RAM1 access: PIO1 port A data register
CRTRAM1CNT	EQU	CRTBASE+6	; RAM1 access: PIO1 port A control register
	; Keyboard port (negated). Bit 7 is for strobe
CRTKEYBDAT	EQU	CRTBASE+5	; KEYBOARD (input): PIO1 port B data register
CRTKEYBCNT	EQU	CRTBASE+7	; KEYBOARD (input): PIO1 port B control register
KEYBSTRBBIT	EQU	7		; Strobe bit
	; RAM2 for graphics. (pixel index by RAM0+RAM1+RAM2)
CRTRAM2DAT	EQU	CRTBASE+8	; RAM2 access: PIO2 port A data register
CRTRAM2CNT	EQU	CRTBASE+10	; RAM2 access: PIO2 port A control register
	; Service/User port
CRTSERVDAT	EQU	CRTBASE+9	; Service (i/o): PIO2 port B data register
CRTSERVCNT	EQU	CRTBASE+11	; Service (i/o): PIO2 port B control register
PRNTBUSYBIT	EQU	0		; Printer BUSY bit
CRTWIDTHBIT	EQU	1		; Set 40/80 chars per line
					; Other bits available to user
	; RAM3 control chars/graphics attributes
CRTRAM3PORT	EQU	CRTBASE+14	; RAM3 port
CRTBLINKBIT	EQU	0		; Blink
CRTREVRSBIT	EQU	1		; Reverse
CRTUNDERBIT	EQU	2		; Underline
CRTHILITBIT	EQU	3		; Highlight
CRTMODEBIT	EQU	4		; ASCII/GRAPHIC mode
	; Beeper port
CRTBEEPPORT	EQU	CRTBASE+15	; Beeper port
	; 6545 CRT controller ports
CRT6545ADST	EQU	CRTBASE+12	; Address & Status register
CRT6545DATA	EQU	CRTBASE+13	; Data register
;
; *** LX390 FDC CONTROLLER:
FDCBASE	EQU	$D0
FDCCMDSTATR	EQU	FDCBASE		; Command and status register
FDCTRAKREG	EQU	FDCBASE+1	; Track register
FDCSECTREG	EQU	FDCBASE+2	; Sector register
FDCDATAREG	EQU	FDCBASE+7	; Data register *** Verificare che sia $d7
FDCDRVRCNT	EQU	FDCBASE+6	; Driver select/control register
FSECLEN		EQU	$80		; 128 bytes sector
; FRWWORD		EQU	((FSECLEN * $100) + FDCDATAREG) ; $80d7 in other words
FDCRESTC	EQU	$07		; 1771 restore (seek to trak 0) cmd
FDCSEEKC	EQU	$17		; seek cmd
FDCREADC	EQU	$88		; read cmd
FDCWRITC	EQU	$A8		; write cmd
;
; alternate printer port
ALTPRNPRT	EQU	$03
;
; parallel port PC link
PPDATAP		EQU	$3		; Data port
PPCNTRP		EQU	$2		; Control port
PPSTROB		EQU	0		; Strobe bit
PPAKSTB		EQU	1		; Acknowledge/Stop bit
;
PPDINI		EQU	$0		; 00000000 Dnl Init byte
PPDRDY		EQU	$4		; 00000100 Dnl Ready
PPDSTP		EQU	$6		; 00000110 Dnl Stop
PPDOKG		EQU	$2		; 00000010 Dnl Ok Go
PPUINI		EQU	$1		; 00000001 Upl Init byte
PPURDY		EQU	$5		; 00000101 Upl Ready
PPUACK		EQU	$7		; 00000111 Upl Acknowledge
PPUOKG		EQU	$3		; 00000011 Upl Ok Go
;
; virtual disks (PC-linked over parallel port)
; VDSECLN		EQU	128		; sector length
VDRDSEC		EQU	0		; read sector command
VDWRSEC		EQU	1		; write sector command
VDBUFSZ		EQU	10		; 9 bytes block
;
; Ram addresses labels
;
; -- Global --
IOBYTE		EQU	$0003		; byte: Intel IOBYTE (CP/M 2.2 only)
CDISK		EQU	$0004		; byte: Last logged drive (CP/M 2.2 only)
BTPASIZ		EQU	$0006		; word: size of tpa + 1
;CRTTABUF	equ	$0010		; table: 20 bytes
;
; -- Private --
PRVTOP		EQU	$004F		; top of private area storage
COLBUF		EQU	PRVTOP		; byte:
DSELBF		EQU	COLBUF-1	; byte: floppy drive select status
					; - bits: 0 = drive 0
					; - bits: 1 = drive 1
					; - bits: 2 = drive 2
					; - bits: 3 = drive 3
					; - bits: 4 = unused
					; - bits: 5 = head select
					; - bits: 6 = motor on (disabled by jumper)
					; - bits: 7 = unused
KBDBYTE		EQU	DSELBF-1	; byte: store keyboard input
MIOBYTE		EQU	KBDBYTE-1	; byte:
					; - bits: 0: 0 = floppy write		1 = floppy read
					;         1: 0 = no ctrl on keypress	1 = ctrl on keypress
					;         2: 0 = scroll			1 = no scroll
					;         3: 0 = accept lowercase	1 = convert to uppercase
					;         4: 0 = destr. bkspace		1 = non destr. bkspace
					;         5: 0 = console out		1 = printer out
					;         6: 0 = disp. all chars	1 = obscure non punct.
					;         7: 0 = ctrl chr set 1		1 = ctrl chr set 2
TMPBYTE		EQU	MIOBYTE-1	; byte: transients flags
					; - bits: 0: 0 = high in cursor addressing
					;         1: 0 = unused
					;         2: 0 = unused
					;         3: 0 = unused
					;         4: 0 = unused
					;         5: 0 = unused
					;         6: 0 = floppy home on err	1 = no home on err
					;         7: 0 = unused
CURPBUF		EQU	TMPBYTE-2	; word:
FTRKBUF		EQU	CURPBUF-2	; word: track # for i/o (0 - 65535)
FDRVBUF		EQU	FTRKBUF-1	; byte: drive number for i/0 (0 - 15)
FSECBUF		EQU	FDRVBUF-2	; word: sector # for i/o (1 .. 65535)
FRDPBUF		EQU	FSECBUF-2	; word: dma address for i/o
FSEKBUF		EQU	FRDPBUF-2	; word: current track number for drive A/B
RST7SPC		EQU	$0038		; keep clear area of RST38 (RST7)
RAM3BUF		EQU	RST7SPC-1	; byte:
RAM2BUF		EQU	RAM3BUF-1	; byte:
RAM1BUF		EQU	RAM2BUF-1	; byte:
RAM0BUF		EQU	RAM1BUF-1	; byte:
VDSKBUF		EQU	RAM0BUF-8	; table: 8 bytes command structure buffer
APPBUF		EQU	VDSKBUF-2	; word: generic buffer
	; Some commodity equs
CR		EQU	$0D		; ascii CR & LF
LF		EQU	$0A
TPA		EQU	$0100		; TPA base address (for CP/M)

; ; GRAM0BUF	equ	$3040
; GRAM1BUF	equ	$3041
; GRAM2BUF	equ	$3042
; GRAM3BUF	equ	$3043

;
; aliases
IOCACK		EQU	INICRTCUR
IOCVT		EQU	CHOME
IOCFF		EQU	CLRSCR
IOCSI		EQU	CLREOL
IOCDC1		EQU	RESATTR
IOCDC4		EQU	LINDN

	ORG	$F000		; THIS IS MONITOR EPROM BASE, (de)comment when you need to test
;	ORG	$E000		; THIS FOR TESTING PURPOSES, (de)comment when you need it

JBOOT:	JP	BOOT		; BOOT - Bring up system
JCONIN:	JP	BCONIN		; Char input
JCONOU:	JP	BCONOUT		; Char output
JHOME:	JP	BHOME		; move head to trak 0 (cp/m home like)
JSELDS:	JP	BSELDSK		; Drive select
JSETTR:	JP	BSETTRK		; Track Select
JSETSE:	JP	BSETSEC		; Sector select
JSETDM:	JP	BSETDMA		; DMA (io address) select
JREAD:	JP	BREAD		; read floppy sector
JWRITE:	JP	BWRITE		; write floppy sector
JFSTAT:	JP	GFDCSTAT	; get 1771 status
JFDCMD:	JP	SFDCCMD		; send cmd to 1771
JCURTR:	JP	GCURTRK		; get current track for current drive
JFSEEK:	JP	FSEEK		; floppy seek
JDRVSL:	JP	DRVSEL		; do drive selection
JDISPG:	JP	DISPNORTR	; graphic output (VERIFY NEED OF JUMP ENTRY)
JUSRCM:	JP	UCREJ		; negative monitor prompt
JCPMBT:	JP	CPMBOOT		; floppy bootstrap of CP/M
JGETHN:	JP	GETHNUM		; get hexadecimal number
JCONST:	JP	BCONST		; console status
JPRNCH:	JP	PRNCHR		; printer output

;;
;; DISPGR - Display a full graphic char frpm GRAMBUF
;
; TODO: RIMUOVERE
; DISPGR:
; 	in     a,(CRT6545ADST)
; 	bit    7,a
; 	jr     z,DISPGR
; 	ld     hl,GRAM0BUF
; 	ld     a,(hl)
; 	out    (CRTRAM0DAT),a
; 	inc    hl
; 	ld     a,(hl)
; 	out    (CRTRAM1DAT),a
; 	inc    hl
; 	ld     a,(hl)
; 	out    (CRTRAM2DAT),a
; 	inc    hl
; 	ld     a,(hl)
; 	out    (CRTRAM3PORT),a
; 	xor    a
; 	out    (CRT6545DATA),a
; 	ret
;;

;; SET DISPLAY CURSOR ADDRESS EXTENDED
;
SDCUAE:
	LD	A,$0E			; was 00F060 3E 0E
	OUT	(CRT6545ADST),A
	LD	A,H
	OUT	(CRT6545DATA),A
	LD	A,$0F
	OUT	(CRT6545ADST),A
	LD	A,L
	OUT	(CRT6545DATA),A
SDCUAE1:
	LD	A,$12
	OUT	(CRT6545ADST),A
	LD	A,H
	OUT	(CRT6545DATA),A
	LD	A,$13
	OUT	(CRT6545ADST),A
	LD	A,L
	OUT	(CRT6545DATA),A
	JR	CRTPRGEND
;;
;; SCUROF - turn off cursor
;
SCUROF:
	LD	A,$0A			; was 00F07E 3E 0A
	OUT	(CRT6545ADST),A
	LD	A,$20
	OUT	(CRT6545DATA),A
;;
;; CRTPRGEND
;; resets 6545 register pointer
;
CRTPRGEND:
	LD	A,$1F			; was 00F086 3E 1F
	OUT	(CRT6545ADST),A
	RET
;;
;; SCURON - turn on cursor
;
SCURON:
	LD	A,$0A			; was 00F08B 3E 0A
	OUT	(CRT6545ADST),A
	XOR	A
	OUT	(CRT6545DATA),A
	JR	CRTPRGEND
;;
;; GETKBD - wait for a key and return in A
;
; GETKBD:
; 	; wait for strobe clean
; 	IN	A,(CRTKEYBDAT)		; was 00F094 DB 85
; 	CPL
; 	BIT	7,A
; 	JR	NZ,GETKBD
; 	; wait for keypress
; GKLP0:	IN	A,(CRTKEYBDAT)
; 	CPL
; 	BIT	7,A
; 	JR	Z,GKLP0
; 	AND	$7F
; 	RET
;;
;; INICRT - should be
;
INICRT:
	IN	A,(CRTSERVDAT)		; was 00F0A5 DB 89
	RES	1,A			; Modo 40/80 colonne (80)
;	ld     hl,CRTTAB
	OUT	(CRTSERVDAT),A
	LD	A,$8F
	OUT	(CRTRAM0CNT),A
	OUT	(CRTRAM1CNT),A
	OUT	(CRTRAM2CNT),A
	LD	A,$CF
	OUT	(CRTPRNTCNT),A
	EX	AF,AF'
	XOR	A
	OUT	(CRTPRNTCNT),A
	EX	AF,AF'
	OUT	(CRTKEYBCNT),A
	EX	AF,AF'
	DEC	A
	OUT	(CRTKEYBCNT),A
	EX	AF,AF'
	OUT	(CRTSERVCNT),A
	LD	A,$F1
	OUT	(CRTSERVCNT),A
; SDRR11R0:
; 	ld     b,$0c
; ICLP0:	ld     a,b
; 	dec    a
; 	out    (CRT6545ADST),a
; 	ld     a,(hl)
; 	out    (CRT6545DATA),a
; 	inc    hl
; 	djnz   ICLP0
	CALL	INI6545
	JP	CRTPRGEND

;;
;; RDRR19R12 - zeroes SY6545 higher register (R12 to R19)
;;
RDRR19R12:
	LD	B,$08
ICLP1:	LD	A,B
	ADD	A,$0B
	OUT	(CRT6545ADST),A
	XOR	A
	OUT	(CRT6545DATA),A
	DJNZ	ICLP1
	JP	CRTPRGEND
;;
;; CLRSCRGR - Clear screen (80x24)
;
CLRSCRGR:
	CALL	SCUROF			; was 00F0E7 CD 7E F0
	LD	HL,$0020
	LD	(RAM0BUF),HL
	LD	HL,$FF00
	LD	(RAM2BUF),HL
	CALL	RDRR19R12
	LD	HL,$0000
CSGLP0:	LD	A,(RAM0BUF)
	CALL	DISPGRCH
	INC	HL
	LD	A,H
	CP	$07
	JR	NZ,CSGLP0
	LD	A,L
	CP	$80
	JR	NZ,CSGLP0
	CALL	RDRR19R12
	JP	SCURON
;;
;; DISPGRCH - Display a char (from A reg.) atrributed from RAM3BUF
;
DISPGRCH:
	PUSH	AF			; was 00F113 F5
DGCLP0:	IN	A,(CRT6545ADST)
	BIT	7,A
	JR	Z,DGCLP0
	POP	AF
	OUT	(CRTRAM0DAT),A
	LD	A,(RAM3BUF)
	OUT	(CRTRAM3PORT),A
	XOR	A
	OUT	(CRT6545DATA),A
	RET
;;
;; FILVRAMG - Fill the video ram in graphic mode (from RAMBUF)
;
FILVRAMG:
	LD	HL,$0000		; was 00F126 21 00 00
	CALL	RDRR19R12
FVLP0:	PUSH	HL
	CALL	DISPGR
	POP	HL
	INC	HL
	LD	A,H
	CP	$07
	JR	NZ,FVLP0
	LD	A,L
	CP	$80
	JR	NZ,FVLP0
	RET
;;
;; DELAY
;;
;; This routine generate a delay from 1 to 65535 milliseconds.
;;

MSCNT	EQU	116

DELAY:				; was F13D
	PUSH	BC		; 11 c.
	PUSH	AF		; 11 c.
DLY2:
	LD	C, MSCNT	; 7 c.	(assume de = 1 = 1msec.)
DLY1:
	DEC	C		; 4 c. * MSCNT
	JR	NZ, DLY1	; 7/12 c. * MSCNT
	DEC	DE		; 6 c.
	LD	A, D		; 4 c.
	OR	E		; 4 c.
	JR	NZ, DLY2	; 7/12 c.

	POP	AF		; 10 c.
	POP	BC		; 10 c.
	RET			; 10.c

;; MSEC evaluation (ret ignored):
;
; 42 + (de) * (7 + 16 * MSCNT - 5 + 26) - 5
;
; 65 + 16 * MSCNT = ClockSpeed   (ClockSpeed is 1920 for Z80 DarkStar)
; (ClockSpeed - 65) / 16 = MSCNT = 116
;

;;
;; UPLOAD wait for remote to upload code/data through
;; parallel link board
;;
;; UPLCHR get a single byte from remote
;;

;;
;; get a byte from remote
;;
;; use:
;;	none
;; return:
;;	D  - received byte
;;	A  - parport status
;; unclean register usage: A, E
UPLCHR:
	IN	A, (PPCNTRP)		; wait for remote ready to tx
	BIT	PPAKSTB, A
	RET	NZ
	BIT	PPSTROB, A
	JR	NZ, UPLCHR

	LD	A, PPURDY		; signal ready to receivce
	OUT	(PPCNTRP), A
UPWSTRB:
	IN	A, (PPCNTRP)		; wait for data
	BIT	PPSTROB, A
	JR	Z, UPWSTRB

	IN	A,(PPDATAP)
	LD	D, A			; copy on d (return value)

	LD	A, PPUOKG		; let's remote run...
	OUT	(PPCNTRP), A
	LD	A, D
	LD	DE, 1			; 1 msec wait
	CALL	DELAY
	LD	D, A
	IN	A, (PPCNTRP)		; in remote answer
	RET
;
;; PRCVBLK - upload a block through parallel link
;;
;; use:
;;	HL - offset of storage area
;;	BC - block size
;; unclean register usage: A, A', IY
;; return:
;; C: Rx status 0 = ok >0 = error
PRCVBLK:
	PUSH	AF
	PUSH	DE
	LD	A, PPUINI		; init parallel port for rx
	OUT	(PPCNTRP), A
	EX	AF, AF'
	XOR	A			; a' is used to calc checksum
	EX	AF, AF'
	CALL	UPLCHR			; get two bytes of block size
	LD	A, D			; and store in APPBUF
	LD	(APPBUF), A
	CALL	UPLCHR
	LD	A, D
	LD	(APPBUF+1), A
	LD	IY, (APPBUF)		; IY count from remote size
PRBLOO:	CALL	UPLCHR			; begin real transfer
	BIT	PPAKSTB, A		; check for stop requests
	JR	NZ, PRNAK		; stopped here: error!
	LD	(HL), D			; store data
	EX	AF, AF'			; update csum
	ADD	A, D
	EX	AF, AF'
	INC	HL
	DEC	IY
	DEC	BC			; check for upload end
	LD	A, B
	OR	C
	JR	NZ, PRBLOO		; next
	LD	(APPBUF), IY		; receive buffer full
	LD	DE, (APPBUF)
	LD	A, D			; received size match?
	OR	E
	JR	NZ, PRNAK		; no
PRWCSM:	CALL	UPLCHR			; flush sender waiting checksum byte
	BIT	PPAKSTB, A		; check for stop requests
	JR	Z, PRWCSM		; WHY WAIT FOR STOP ??
	EX	AF, AF'			; block end: calc. final csum
	CPL
	INC	A
	CP	D			; match ?
	JR	Z, PRBEND		; yes: exit
PRNAK:	LD	A,PPUACK		; send negative aknowledge
	OUT	(PPCNTRP),A
	LD	C, 1			; rx error
PRBEND:	LD	DE, 50			; 50 msec wait
	CALL	DELAY
	LD	A, PPUINI		; clean handshake
	OUT	(PPCNTRP), A
	POP	DE
	POP	AF
	RET

;;
;; upload data through parallel link
;;
;; use:
;;	none
;; unclean register usage: ALL
UPLOAD:
	CALL	OUTCRLF
	LD	HL, STRWAIT
	CALL	CONSTR

	CALL	UPLCHR			; in hi byte of upload offset
	LD	H,D
	CALL	UPLCHR			; in lo byte of upload offset
	LD	L,D
	CALL	UPLCHR			; in hi byte of data size
	LD	B,D
	CALL	UPLCHR			; in lo byte of data size
	LD	C,D
	PUSH	HL
	CALL	OUTCRLF
	LD	HL, STRLOAD
	CALL	CONSTR
	POP	HL

	CALL	PRCVBLK			; upload data block
	CALL	OUTCRLF
	RET
;--------------------
;; Routines to manage data send (download) over parallel port
;;
;; PSNDCH - send a byte over parallel
;;
;; use:
;; HL - point to byte to transfer (updated after exec)
;; unclean register usage: A, DE
PSNDCH:
	IN	A, (PPCNTRP)		; wait synchro strobe from remote
	BIT	PPSTROB, A
	JR	NZ, PSNDCH

	LD	A, (HL)
	OUT	(PPDATAP), A		; out data and then emit ready signal
	INC	HL
	LD	A, PPDRDY
	OUT	(PPCNTRP), A
					;; remote should reset strobe when PPDRDY is get...
PWACKB:
	IN	A, (PPCNTRP)		; wait ack from remote
	BIT	PPAKSTB, A
	JR	Z, PWACKB

	LD	A, PPDOKG		; reset ready bit and let remote run waiting 1 msec.
	OUT	(PPCNTRP), A
					;; remote should reset ack when PPDOKG is get...
	LD	DE, 1
	CALL	DELAY
	RET

;;
;; PSNDBLK - send a block over parallel link
;;
;; use:
;; HL - point to the base of block to transfer
;; BC - block size
;; unclean register usage: A, A', HL'
;; return:
;; C: Tx status 0 = ok >0 = error
;;
PSNDBLK:
	PUSH	AF
	PUSH	DE
	EX	AF, AF'
	XOR	A			; a' will carry the checksum
	EX	AF, AF'
	LD	(APPBUF), BC		; store block size to send it
	LD	A, PPDINI		; setup port for tx
	OUT	(PPCNTRP), A
	EXX				; use alt. bank and send block size
	LD	HL, APPBUF
	CALL	PSNDCH			; send len. lsb
	CALL	PSNDCH			; send len. msb
	EXX				; restore reg. bank
PSNXTC:
	EX	AF, AF'
	ADD	A, (HL)			; block bytes summing
	EX	AF, AF'
	CALL	PSNDCH			; send byte
	DEC	BC			; check for transfer end
	LD	A, B
	OR	C
	JR	NZ, PSNXTC
	EX	AF, AF'			; block end: calc. final csum
	CPL
	INC	A
	LD	HL, APPBUF		; store in first byte of APPBUF
	LD	(HL), A
	EX	AF, AF'
	CALL	PSNDCH			; send csum
	LD	DE, 34			; 34 more msec. to get okgo
	CALL	DELAY
	LD	A, PPDSTP
	OUT	(PPCNTRP), A
	LD	DE, 35			; 35 msec. to stop remote
	CALL	DELAY
	LD	A, PPUINI
	OUT	(PPCNTRP), A		; leave parallel clean
	LD	C, 0			; ret ok (maybe)
	IN	A, (PPCNTRP)		; in result code
	AND	$FC			; mask
	CP	$02			; init and strobe set ?
	JR	NZ, PSBOK
	LD	C, 1			; ret nok on reg. C
PSBOK:
	POP	DE
	POP	AF
	RET

;;
;; PDNLOAD- prompt user for parallel download
;;
PDNLOAD:
	CALL		OUTCRLF
	LD	HL, S_DLPR
	CALL	CONSTR
	LD	B, 2			; get params (offset, size)
	CALL	GETHNUM
	POP	BC
	CALL		OUTCRLF
	LD	HL, STRWAIT
	CALL	CONSTR
	CALL		OUTCRLF
	POP	HL
	CALL	PSNDBLK			; send data
	RET
;----------------------------------------------------------
; PC-LINKED VIRTUAL DISK HANDLE ROUTINES
; ---------------------------------------------------------
;;
;; VDSKRD - read a sector form remote
;;
;; use:
;;	none
;; unclean register usage: A, IY

VDSKRD:
	PUSH	IY
	PUSH	DE
	PUSH	BC
	PUSH	HL
	LD	D, 5			; retries
VDRTRY:	LD	IY, VDSKBUF
	LD	HL, S_VHDR
	LD	B, 4
VDRSL1: LD	C, (HL)
	LD	(IY + 0), C
	INC	IY
	INC	HL
	DJNZ	VDRSL1

	LD	C, VDRDSEC		; read command
	LD	(IY + 0), C
	LD	HL, FDRVBUF
	LD	C, (HL)			; drive
	LD	(IY + 1), C
	LD	BC, (FSECBUF)		; sector
	DEC	BC			; base sector # is zero...
	LD	(IY + 2), C
	LD	(IY + 3), B
	LD	BC, (FTRKBUF)		; track
	LD	(IY + 4), C
	LD	(IY + 5), B

	LD	HL, VDSKBUF		; command offset
	LD	BC, VDBUFSZ		; block size
	CALL	PSNDBLK			; send command block
	LD	A, C
	CP	$00			; what happens ?
	JR	Z, VDROK		; tx ok
	DEC	D			; retry ?
	JR	NZ, VDRTRY
	LD	A, 1			; ret tx err
	JR	VDRNOK
					; receive sector now
VDROK:	LD	HL, (FRDPBUF)		; set dma address
;	LD	BC, VDSECLN		; vdisk sector length
	LD	C,(IX+2)		; vdisk sector length
	LD	B,(IX+3)
	CALL	PRCVBLK			; download sector
	LD	A, C
	CP	$00			; what happens ?
	JR	Z, VDREND		; rx ok
	DEC	D			; retry ?
	JP	NZ, VDRTRY
	LD	A, 1			; ret rx err
	JR	VDRNOK
VDREND:	XOR	A
VDRNOK:	POP 	HL
	POP	BC
	POP	DE
	POP	IY
	RET

;;
;; VDSKWR - read a sector form remote
;;
;; use:
;;	none
;; unclean register usage: A

VDSKWR:
	PUSH	IY
	PUSH	DE
	PUSH	BC
	PUSH	HL
	LD	D, 5			; retries
VDWTRY:	LD	IY, VDSKBUF
	LD	HL, S_VHDR
	LD	B, 4
VDWSL1: LD	C, (HL)
	LD	(IY + 0), C
	INC	IY
	INC	HL
	DJNZ	VDWSL1

	LD	C, VDWRSEC		; read command
	LD	(IY + 0), C
	LD	HL, FDRVBUF
	LD	C, (HL)			; drive
	LD	(IY + 1), C
	LD	BC, (FSECBUF)		; sector
	DEC	BC			; base sector # is zero...
	LD	(IY + 2), C
	LD	(IY + 3), B
	LD	BC, (FTRKBUF)		; track
	LD	(IY + 4), C
	LD	(IY + 5), B

	LD	HL, VDSKBUF		; command offset
	LD	BC, VDBUFSZ		; block size
	CALL	PSNDBLK			; send command block
	LD	A, C
	CP	$00			; what happens ?
	JR	Z, VDWOK		; tx ok
	DEC	D			; retry ?
	JR	NZ, VDWTRY
	LD	A, 1			; ret tx err
	JR	VDWNOK
					; receive sector now
VDWOK:	LD	HL, (FRDPBUF)		; set dma address
;	LD	BC, VDSECLN		; vdisk sector length
	LD	C,(IX+2)		; vdisk sector length
	LD	B,(IX+3)
	CALL	PSNDBLK			; upload sector
	LD	A, C
	CP	$00			; what happens ?
	JR	Z, VDWEND		; tx ok
	DEC	D			; retry ?
	JR	NZ, VDWTRY
	LD	A, 1			; ret tx err
	JR	VDWNOK
VDWEND:	LD	A, 0
VDWNOK:	POP 	HL
	POP	BC
	POP	DE
	POP	IY
	RET

S_DLPR	DEFB	'D', 'L'+$80
S_VHDR:	DEFB	"@IO@"
STRWAIT:
	DEFB	'Wait..', '.'+$80
STRLOAD:
	DEFB	'Loa', 'd'+$80
;;
;; VCPMBT
;;
;; Boot CP/M from parallel link
;
BLDOFFS		EQU	$2000		; place for disk bootloader
;
VCPMBT:
	LD	BC, BLDOFFS          	; base transfer address
	CALL	BSETDMA
	LD	A,(CDISK)		; get logged drive
	LD	C, A			; make active
	CALL	BSELDSK
	LD	BC, 0			; START TRACK
	CALL	BSETTRK
	LD	BC, 1			; start sector
	CALL	BSETSEC
	LD	IX,SSIZ1 - 2
	CALL	VDSKRD			; perform i/o 128
	CP	$00
	JP	Z,BLDOFFS
	LD	IX,SSIZ2 - 2
	CALL	VDSKRD			; perform i/o 256
	CP	$00
	JP	Z,BLDOFFS
	LD	IX,SSIZ5 - 2
	CALL	VDSKRD			; perform i/o 512
	CP	$00
	JP	Z,BLDOFFS
	JP	UCREJ
; sector lenghts for vboot
SSIZ5:	DEFW	512
SSIZ2:	DEFW	256
SSIZ1:	DEFW	128
;;
;; NEDOSCR - NEDOS boot screen (wiped out)
;
;NEDOSCR:


	;; ALIGNMENT trick:
	;; NEDOSCR was the odl entry point. NEDOS related functions
	;; (except general routines like video management) are commented
	;; out and replaced by the new code.
	;; Here we keep in sync with old addresses. This should not be really
	;; necessary, but in a first try i prefer not to change entry points....
;	defs  DISPSTR - NEDOSCR
	;; -------------------
; 	call   CLRSCRGR
; 	ld     hl,STR005
; 	call   DISPSTR
; 	ld     hl,STR006
; 	call   DISPSTR
; 	ld     hl,STR007
; 	call   DISPSTR
; NDSLP3:	ld     a,$ff
; 	ld     (GRAM3BUF),a
; 	ld     hl,STR009
; 	call   DISPSTR
; 	ld     hl,$0526
; 	call   SDCUAE
; 	call   GETKBD
; 	ld     hl,(STR008)
; 	push   hl
; 	call   SDCUAE
; 	pop    hl
; 	; blank str008 space
; 	ld     b,$1a
; NDSLP0:	ld     a,$20
; 	call   DISPGRCH
; 	djnz   NDSLP0
; 	ld     hl,$0526
; 	call   SDCUAE
; 	xor    a
; 	out    (FDCDRVRCNT),a
; 	out    (FDCCMDSTATR),a
; NDSLP2:
; 	ex     (sp),hl
; 	ex     (sp),hl
; 	in     a,(FDCCMDSTATR)
; 	bit    1,a
; 	jr     z,NDSLP1
; 	ld     a,FDCCMDSTATR
; 	out    (FDCCMDSTATR),a
; 	jr     NDSLP2
; NDSLP1:
; 	ld     hl,$0000
; 	ld     ($9000),hl
; 	ld     hl,$1500
; 	ld     ($9002),hl
; 	ld     a,$01
; 	out    (FDCDRVRCNT),a
; 	ld     b,$05
; NDSJ1:	ld     a,$0b
; 	out    (FDCCMDSTATR),a
; 	ex     (sp),hl
; 	ex     (sp),hl
; 	djnz   NDSJ1
; NDSJ2:	in     a,(FDCCMDSTATR)
; 	bit    0,a
; 	jr     nz,NDSJ2
; NDSJ5:	ld     de,($9002)
; 	ld     hl,($9000)
; 	call   NDSRDSEC
; 	ld     a,($9002)
; 	inc    a
; 	cp     $0a
; 	jr     nz,NDSJ3
; 	ld     a,($9003)
; 	inc    a
; 	ld     ($9003),a
; 	xor    a
; NDSJ3:	ld     ($9002),a
; 	dec    hl
; 	ld     a,(hl)
; 	ld     ($9001),a
; 	dec    hl
; 	ld     a,(hl)
; 	ld     ($9000),a
; 	dec    hl
; 	ld     a,(hl)
; 	cp     $01
; 	jr     nz,NDSJ4
; 	dec    hl
; 	ld     a,(hl)
; 	cp     $01
; 	jr     z,NDSJ5
; 	rst    00h
; NDSJ4:	ld     hl,STR008
; 	xor    a
; 	out    (FDCDRVRCNT),a
; 	ld     a,$f0
; 	ld     (GRAM3BUF),a
; 	call   DISPSTR
; 	jp     NDSLP3
; ;;
; NDSRDSEC:
; 	ld     a,e
; 	out    (FDCSECTREG),a
; 	ld     a,d
; 	out    (FDCDATAREG),a
; 	ld     a,$1a
; 	out    (FDCCMDSTATR),a
; 	ex     (sp),hl
; 	ex     (sp),hl
; NRD1:	in     a,(FDCCMDSTATR)
; 	rrca
; 	jr     c,NRD1
; 	ld     a,$88
; 	out    (FDCCMDSTATR),a
; 	push   bc
; 	pop    bc
; 	jr     NRD2
; NRD4:	rrca
; 	jr     nc,NRD3
; NRD2:	in     a,(FDCCMDSTATR)
; 	bit    1,a
; 	jr     z,NRD4
; 	in     a,(FDCDATAREG)
; 	ld     (hl),a
; 	inc    hl
; 	jr     NRD2
; NRD3:	in     a,(FDCCMDSTATR)
; 	and    $5c
; 	ret    z
; 	ld     a,FDCCMDSTATR
; 	out    (FDCCMDSTATR),a
; 	ret
; ;;
; ;; NDSHW - test video hardware for nedos
; NDSHW:
; 	ld     hl,$7f00
; 	ld     ($9006),hl
; 	xor    a
; 	ex     af,af'
; 	ld     hl,$ffff
; 	ld     (GRAM0BUF),hl
; 	ld     hl,$efff
; 	ld     (GRAM2BUF),hl
; 	call   FILVRAMG
; 	call   RDRR19R12
; 	ld     hl,$0780
; NDH1:	in     a,(CRT6545ADST)
; 	bit    7,a
; 	jr     z,NDH1
; 	in     a,(CRTRAM0DAT)
; 	inc    a
; 	jr     nz,NDH2
; 	in     a,(CRTRAM1DAT)
; 	inc    a
; 	jr     nz,NDH2
; 	in     a,(CRTRAM2DAT)
; 	inc    a
; 	jr     z,NDH3
; NDH2:	ld     ($9004),sp
; 	ld     sp,($9006)
; 	push   hl
; 	ld     ($9006),sp
; 	ld     sp,($9004)
; 	ex     af,af'
; 	ld     a,$01
; 	ex     af,af'
; NDH3:	dec    hl
; 	xor    a
; 	out    (CRT6545DATA),a
; 	ld     a,h
; 	or     l
; 	jr     nz,NDH1
; 	call   RDRR19R12
; 	ex     af,af'
; 	or     a
; 	jr     z,NDH4
; 	call   CLRSCRGR
; 	ld     hl,STR010
; 	call   DISPSTR
; 	ld     hl,$0140
; 	call   SDCUAE
; 	ld     ($9004),sp
; NDH7:	ld     a,$20
; 	call   DISPGRCH
; 	ld     sp,($9006)
; 	pop    hl
; 	ld     ($9006),sp
; 	ld     a,h
; 	add    a,$30
; 	call   DISPGRCH
; 	ld     h,$00
; 	add    hl,hl
; 	add    hl,hl
; 	add    hl,hl
; 	add    hl,hl
; 	ld     a,h
; 	cp     $0a
; 	jr     c,NDH5
; 	add    a,$07
; NDH5:	add    a,$30
; 	call   DISPGRCH
; 	or     a
; 	ld     a,l
; 	rra
; 	rra
; 	rra
; 	rra
; 	cp     $0a
; 	jr     c,NDH6
; 	add    a,$07
; NDH6:	add    a,$30
; 	call   DISPGRCH
; 	ld     a,($9007)
; 	cp     $7f
; 	jr     nz,NDH7
; 	ld     sp,($9004)
; 	ld     hl,STR011
; 	call   DISPSTR
; 	call   SCUROF
; 	call   GETKBD
; NDH4:	jp     CLRSCRGR

;	org    $f2e1		;; old label alignment
;;
;; DISPSTR - Display a string of format:
;; R,C,"STRING",$00
;
DISPSTR:
	LD	C,(HL)          ; was 00F2E1 4E
	INC	HL
	LD	B,(HL)
	PUSH	HL
	PUSH	BC
	POP	HL
	CALL	SDCUAE1
	POP	HL
DSLP0:	INC    HL
	LD	A,(HL)
	CP	$00
	RET	Z
	CALL	DISPGRCH
	JR	DSLP0
;; CRTTAB - 6545 Register setup values
; CRTTAB:                        ; was 00F2F5
; 	db    $0b,$00,$0b,$48
; 	db    $18,$18,$00,$1a
; 	db    $28,$57,$50,$6f
;;
;STR001:                        ; was 00F301
	;; ALIGNMENT trick:
	;; STR001 was the odl entry point. NEDOS related functions
	;; (except general routines like video management) are commented
	;; out and replaced by the new code.
	;; Here we keep in sync with old addresses. This should not be really
	;; necessary, but in a first try i prefer not to change entry points....
;	defs  DRVSEL - STR001
	;; -------------------
; 	db    $0b,$01
; 	db    "GRAFIC - MONITOR 1.0",$00
; STR002:
; 	db    $04,$02
; 	db    "type",$00
; STR003:
; 	db    $3a,$03
; 	db    $22,"ESC",$22," for BOOTSTRAPPING",$00
; STR004:
;         db    $d9,$03
; 	db    $22,"RETURN",$22," for testing VIDEO",$00
; STR005:
; 	db    $08,$01
; 	db    "BOOTSTRAP Version GRAFIC 1.0",$00
; STR006:
; 	db    $9f,$01
; 	db    "Insert NE-DOS-DISK Version GRAFIC in drive 0",$00
; STR007:
; 	db    $4e,$02
; 	db    "then type a key",$00
; STR008:
; 	db    $89,$03
; 	db    " No NE-DOS Version GRAFIC ",$00
; STR009:
; 	db    $25,$05
; 	db    "> <",$00
; STR010:
; 	db    $0e,$00
; 	db    "Errorpoints :",$00
; STR011:
; 	db    $28,$00
; 	db    "Please type a key",$00
; ;;
; ;;
; JNDSTA:	jp     NDOSSTA
; JJNDST:	jp     JNDSTA
; NDOSSTA:
; 	in     a,(CRT6545ADST)
; 	xor    a
; 	out    (FDCDRVRCNT),a
; 	di
; 	ld     sp,$7000
; 	call   INICRT
; NDST1:	call   NDSHW
; 	ld     hl,STR001
; 	call   DISPSTR
; 	ld     hl,STR002
; 	call   DISPSTR
; 	ld     hl,STR003
; 	call   DISPSTR
; 	ld     hl,STR004
; 	call   DISPSTR
; 	ld     hl,STR009
; 	call   DISPSTR
; 	ld     hl,$0526
; 	call   SDCUAE
; KBLP0:
; 	call   GETKBD
; 	cp     $1b
; 	jp     z,NEDOSCR
; 	cp     $0d
; 	jr     z,NDST1
; 	jr     KBLP0
; 	nop
; 	nop
; 	nop
; 	nop
; 	nop
; 	nop
; 	nop
; 	nop
; 	nop
; 	nop
; 	nop
; 	nop
;;---------------------------------------------------

;	org   $f450
	; This used to translate the drive number in a cmd byte suitable
	; for drive selection on the floppy board
HDRVV:	DEFB	$01			; drive 1
	DEFB	$02			; drive 2
	DEFB	$04			; drive 3
	DEFB	$08 			; drive 4

;;
;; DRVSEL - select drive for r/w ops
;
DRVSEL:
	PUSH	AF			;
	PUSH	HL			;
	LD	HL,HDRVV		; 10
	LD	A,(FDRVBUF)		; 13
	ADD	A,L			; 4
	LD	L,A			; 4
	LD	A,(HL)			; 7
	LD	H,A			;
	LD	A, (DSELBF)
	AND	$F0
	OR	H
	LD	(DSELBF),A		; 13
	OUT	(FDCDRVRCNT),A		; 11
	POP	HL			;
	POP	AF			;
	RET				;
;;
;; SETSID - set current side bit on DSELBF
;;          selected side on C
;;
SETSID:	LD	HL,DSELBF		; loads drive interf. buffer
	LD	A,C			; which side ?
	CP	0			;
	JR	NZ,SIDONE		; side 1
	RES	5,(HL)			; side 0
	RET				;
SIDONE:	SET	5,(HL)			;
	RET

	; old code, removed...
;	push   af              ; was 00F450 F5
;	push   bc
;	ld     a,(FDRVBUF)	; 13
;	inc    a		; 4
;	ld     b,a		; 4
;	xor    a		; 4
;	scf			; 4
;DSHFT:	rla			; 8 * 2
;	djnz   DSHFT		;13 + 8
;	ld     b,a
;	ld     a, (DSELBF)
;	and    0xf0
;	or     b
;	ld     (DSELBF), a	; 13
;	out    (FDCDRVRCNT),a	; 11
;	pop    bc
;	pop    af
;	ret
;;
;; CPMBOOT - boostrap cp/m
;
CPMBOOT:
	LD	SP,$0080		; was 00F461 31 80 00
	LD	BC,$00
	CALL	BSETTRK
	LD	A,(CDISK)		; get logged drive
	LD	C,A
	CALL	BSELDSK
; 	INC	A
; 	OUT	(FDCDRVRCNT),A
	CALL	DRVSEL
	CALL	BHOME
	JP	NZ,UCREJ
;	LD	BC,$0080		; read in loader at $0080
	LD	BC,BLDOFFS		; read in loader at $2000
	CALL	BSETDMA
	LD	BC,$01
	CALL	BSETSEC
	CALL	BREAD
	JP	NZ,UCREJ
; 	JP	$0080			; jump to the loader if all ok
	JP	BLDOFFS			; jump to the loader if all ok
BSETTRK:
;	ld     a,c             ; was 00F489 79
	LD	(FTRKBUF),BC
	RET
BSETSEC:
; 	ld     a,c             ; was 00F48E 79
	LD	(FSECBUF),BC
	RET
BSETDMA:
	LD	(FRDPBUF),BC		; was 00F493 ED 43 45 00
	RET
BSELDSK:
	LD	A,C			; was 00F498 79
	LD	(FDRVBUF),A
	RET
;;
;; SFDCCMD - send 1771 a command
;
SFDCCMD:
	PUSH	AF			; was 00F49D F5
SNDCL:
	IN	A,(FDCCMDSTATR)
	BIT	0,A			; check busy
	JR	NZ,SNDCL
	POP	AF
; 	LD	(FCMDBUF),A
	OUT	(FDCCMDSTATR),A
	EX	(SP),HL
	EX	(SP),HL
	EX	(SP),HL
	EX	(SP),HL
	RET
;;
;; GFDCSTAT - get 1771 status and copy on buffer
;
GFDCSTAT:
	IN	A,(FDCCMDSTATR)		; was 00F4AF DB D0
	BIT	0,A
	JR	NZ,GFDCSTAT
; 	LD	(FSTABUF),A
	RET
;
GCURTRK:
	LD	HL,FSEKBUF		; was 00F4B9 21 4A 00
	LD	A,(FDRVBUF)
	ADD	A,L
	LD	L,A
	RET
;;
;; BHOME - move head to trak 0 (cp/m home like)
;;
BHOME:
	PUSH	BC              ; was 00F4C2 C5
	LD	B,$03           ; number of retries
FRETR0:	LD	A,FDCRESTC      ; move to trak 0 cmd
	CALL	SFDCCMD
	CALL	GFDCSTAT
	AND	$18             ; check for errors
	JR	Z,FOK0         ; go no
	DJNZ	FRETR0           ; retry
	LD	A,$82
	JR	FTERR           ; error handle
FOK0:	CALL	GCURTRK           ; proceed
	JR	FGTRK
;;
;; FSEEK - seek to specific track/sector
;
FSEEK:
	PUSH	BC              ; was 00F4DC C5
	LD	B,$03
	CALL	GCURTRK
	LD	A,(HL)
	OUT	(FDCTRAKREG),A
FRETR1:	LD	A,(FSECBUF)
	OUT	(FDCSECTREG),A
	LD	A,(FTRKBUF)
	OUT	(FDCDATAREG),A
	LD	A,FDCSEEKC           ; seek cmd
	CALL	SFDCCMD
	CALL	GFDCSTAT
	AND	$18
	JR	Z,FGTRK
	CALL	BHOME
	JR	NZ,FTERR
	DJNZ	FRETR1
	LD	A,$83
	JR	FTERR
FGTRK:	IN	A,(FDCTRAKREG)
	LD	(HL),A
FTERR:	POP	BC
	BIT	7,A             ; test if drive not ready
	RET
;;
;; BREAD - read a sector
;
BREAD:
	LD	A,(MIOBYTE)       ; was 00F50D 3A 47 00
	SET	0,A
	JR	BWAITIO
;;
;; BWRITE - write a sector
;
BWRITE:
	LD	A,(MIOBYTE)       ; was 00F514 3A 47 00
	RES	0,A
;;
;; BWAITIO - read or write a sector depending on MIOBYTE
;
BWAITIO:
	PUSH	DE
	LD	(MIOBYTE),A       ; was 00F519 32 47 00
FRWLP:	CALL	FSEEK
	JR	NZ,FSHTM
	LD	B,$0A           ; 10 retries
FRWNXT:	LD	HL,(FRDPBUF)
	LD	E,(IX+2)		; need to know buffer size on write
	LD	D,(IX+3)
	LD	A,(MIOBYTE)
	BIT	0,A
	JR	Z,FRWWRO
	LD	A,FDCREADC           ; read command
	CALL	SFDCCMD
	JR	FRRDY
FRBSY:	RRCA
	JR	NC,FWEND
FRRDY:	IN	A,(FDCCMDSTATR)
	BIT	1,A             ; sec found
	JR	Z,FRBSY
	IN	A,(FDCDATAREG)
	LD	(HL),A
	INC	HL
	JR	FRRDY
FRWWRO:	LD	A,FDCWRITC
	CALL	SFDCCMD
	JR	FWRDY
FRWBSY:	RRCA
	JR	NC,FWEND
FWRDY:	IN	A,(FDCCMDSTATR)
	BIT	1,A
	JR	Z,FRWBSY
	LD	A,(HL)
	OUT	(FDCDATAREG),A
	INC	HL
	DEC	DE		; 6 c.
	LD	A,D		; 4 c.
	OR	E		; 4 c.
	JR	NZ,FWRDY	; 7/12 c.
FWEND:	CALL	GFDCSTAT
	AND	$5C             ; test for errors
	JR	Z,FSHTM
	DJNZ	FRWNXT
	LD	A,(TMPBYTE)
	BIT	6,A
	JR	NZ,FSHTM
	SET	6,A
	LD	(TMPBYTE),A
	CALL	BHOME
	JR	NZ,FSHTM
	JR	FRWLP
FSHTM:
	PUSH	AF
	XOR	A
	OUT	(FDCDRVRCNT),A
	POP	AF
	POP	DE
	RET
;;
;; FLOPPYREAD - read from given drv,track,sector,ram address
;
FLOPPYREAD:
	LD	A,(MIOBYTE)       ; was 00F574 3A 47 00
	SET	0,A
	JR	FLOPIO
;;
;; FLOPPYWRIT - write to give ram address, sector, track, drive
;
FLOPPYWRIT:
	LD	A,(MIOBYTE)       ; was 00F57B 3A 47 00
	RES	0,A
FLOPIO:	LD	(MIOBYTE),A
	LD	B,$04
	CALL	GETHNUM
	POP	BC
	CALL	BSETDMA
	POP	BC
	CALL	BSETSEC
	POP	BC
	CALL	BSETTRK
	POP	BC
	CALL	BSELDSK
	CALL	DRVSEL
	CALL	FRWLP
	JP	USRCMD
;; Image to initalize location 0010H
CRTTAB1:
	DB	$6F,$50,$57,$28,$1A,0,$19,$19,$48,$0B
	DB	0,$0B,0,0,0,0,0,0,0,0
;	org $f5b5
;;
;;
;NEDOSINI:
	;; ALIGNMENT trick:
	;; NEDOSINI was the odl entry point. NEDOS related functions
	;; (except general routines like video management) are commented
	;; out and replaced by the new code.
	;; Here we keep in sync with old addresses. This should not be really
	;; necessary, but in a first try i prefer not to change entry points....
;	defs  INIT0 - NEDOSINI
	;; -------------------

; 	ld     c,$00
; 	call   JNXTTR
; 	inc    a
; 	out    (FDCDRVRCNT),a
; 	call   JHOME
; 	jp     nz,UCREJ
; 	jp     JJNDST
; 	nop
; 	nop
;;---------------------------------------------------------------------
;	org    $f5c8
;;
; INIT0 - init buffers,6545,test vram,clear,leave cursor at home
;
INIT0:
	CALL	INICRT           ; was 00F5C8 CD A5 F0
	CALL	INICRTREG
	CALL	DLIGHT
	CALL	DBLANK
	LD	A,$FF
	LD	(RAM3BUF),A
	LD	HL,$0000
	LD	(CURPBUF),HL
	JP	INICRTCUR
;;
STR100:                        ; was 00F5E2
	DB	"Z80 DarkStar - Monitor - REL ",MONMAJ,'.',MONMIN

;;
CRLFTAB:
	DB	$0D,$8A,$00	;,$01

;;
;; INICRTREG
;;
INICRTREG:
	CALL	GDCUA           ; was 00F606 CD B0 F7
	PUSH	HL
	CALL	INI6545
;	ld     hl,CRTTABUF
; 	ld     hl,CRTTAB1	; now read from eprom
; 	ld     b,$00
; 	ld     a,b
; ICTLP0:	out    (CRT6545ADST),a
; 	ld     a,(hl)
; 	out    (CRT6545DATA),a
; 	inc    hl
; 	inc    b
; 	ld     a,b
; 	cp     $14
; 	jr     nz,ICTLP0
	LD	HL,(CURPBUF)
	CALL	SDSTA
	POP	HL
	DEC	HL
	JP	SDCUAE

;;
;; INI6545 - initialize sy6545
;;
INI6545:
	LD	HL,CRTTAB1	; now read from eprom
	LD	B,$00
	LD	A,B
ICTLP0:	OUT    (CRT6545ADST),A
	LD	A,(HL)
	OUT	(CRT6545DATA),A
	INC	HL
	INC	B
	LD	A,B
	CP	$14
	JR	NZ,ICTLP0
	RET

; 	nop
; 	nop
; 	nop
; 	nop
; 	nop
; 	nop
; 	nop
; 	nop
; 	nop
;;
;; FMEMSIZ - cerca l'ultima pagina di memoria disponibile
;
FMEMSIZ:
	PUSH	BC			; was 00F67C C5 !!! NOT EXECUTED IF HERE FROM BOOT
	LD	BC,$FF00
	LD	HL,$FFFF
FMEMNP:
	INC	H
	LD	A,(HL)
	CPL
	LD	(HL),A
	CP	(HL)
	CPL
	LD	(HL),A
	JR	NZ,FMESTP
	LD	A,H
	CP	B
	JR	NZ,FMEMNP
FMESTP:
	DEC	H
; 	LD	BC,$FFDE
; 	ADD	HL,BC
	POP	BC
	RET
; ;;
; ;; LPAGE - Find ram last page and return in B
; LPAGE:
; 	PUSH	HL			; was 00F697 E5
; 	CALL	FMEMSIZ
; 	LD	A,L
; 	SUB	$3D
; 	JR	NC,LPAFND
; 	DEC	H
; LPAFND:
; 	LD	B,H
; 	POP	HL
; 	RET
;;
;; BOOT - Bring up system
;;
BOOT:
	; Reset bios position after reset
	IN	A,(FDCDRVRCNT)  ; was 00F630 DB D6
	LD	SP,$0080
;	ld     hl,CRTTAB1	; copy CRT init tab @ CRTTABUF
;	ld     de,CRTTABUF
;	ld     bc,$0014
;	; TODO: why this copy? verify remotion
;	ldir
	LD	HL,$0000
	LD	(CURPBUF),HL
	XOR	A
;	ld     (CIOBYTE),a
	LD	(CDISK),A
	LD	(COLBUF),A
	LD	(MIOBYTE),A
	LD	(DSELBF),A
	OUT	(FDCDRVRCNT),A		; resets floppy selection
	CPL
	LD	(RAM3BUF),A
	CALL	INIT0
	LD	HL,$FFFF
	LD	(FSEKBUF),HL
;	ld     ($004c),hl
	XOR	A
	OUT	(CRTPRNTDAT),A
	OUT	(ALTPRNPRT),A
	CPL
	OUT	(CRTPRNTDAT),A
	OUT	(ALTPRNPRT),A
	LD	A, PPUINI		; init parallel port for rx
	OUT	(PPCNTRP), A
	LD	A,$C3
	LD	($0008),A
	LD	($0066),A
	LD	HL,JBOOT
	LD	($0067),HL
	CALL	FMEMSIZ			; check for available ram
;	LD	SP,BJMP5
;	DB	$3E
	LD	SP,HL
 	LD	(BTPASIZ),HL
	;; print bios greetings
	LD	HL,STR100		; was 00F6CB 21 E2 F5
	CALL	GREET
; ;;
; ;; FMEMSIZ - cerca l'ultima pagina di memoria disponibile
; ;
; FMEMSIZ:
; 	PUSH	BC			; was 00F67C C5 !!! NOT EXECUTED IF HERE FROM BOOT
; 	LD	BC,$FF00
; 	LD	HL,$FFFF
; FMEMNP:
; 	INC	H
; 	LD	A,(HL)
; 	CPL
; 	LD	(HL),A
; 	CP	(HL)
; 	CPL
; 	LD	(HL),A
; 	JR	NZ,FMESTP
; 	LD	A,H
; 	CP	B
; 	JR	NZ,FMEMNP
; FMESTP:
; 	DEC	H
; 	LD	BC,$FFDE
; 	ADD	HL,BC
; 	POP	BC
; 	RET
; ;;
; ;; LPAGE - Find ram last page and return in B
; LPAGE:
; 	PUSH	HL			; was 00F697 E5
; 	CALL	FMEMSIZ
; 	LD	A,L
; 	SUB	$3D
; 	JR	NC,LPAFND
; 	DEC	H
; LPAFND:
; 	LD	B,H
; BJMP5:
; 	POP	HL
; 	RET
;
; BJTAB:					; was 00F6A4
; 	DW	BJTAB+2			; ovvero f6a6
; ;
; BJMP3:
; 	;; copy 29 bytes of bios code from RAMBLK to last page of available ram
; 	LD	SP,HL			; was 00F6A6 F9
; 	LD	DE,RAMBLK
; 	EX	DE,HL
; 	LD	BC,$001D
; 	LDIR
; 	LD	BC,BTPASIZ
; 	PUSH	DE
; 	POP	HL
; 	DEC	HL
; 	LDIR
; 	LD	HL,$FFE8		; should be a number in 2 compl.
; 	ADD	HL,SP
; 	PUSH	HL
; 	INC	HL
; 	INC	HL
; 	LD	(BTPASIZ),HL
; 	LD	D,$0A
; BJMP4:
; 	PUSH	BC
; 	DEC	D
; 	JR	NZ,BJMP4
; 	NOP
; 	NOP
; 	NOP
; 	;; print bios greetings
; 	LD	HL,STR100		; was 00F6CB 21 E2 F5
; 	CALL	GREET
; 	;JP	USRCMD
;;
;; New code for direct access to bootloaders
;;
BOOTM:
	LD	HL,(BTPASIZ)		; The same as USRCMD
	LD	SP,HL
	LD	HL,USRCMD
	PUSH	HL
	LD	($0001),HL
	LD	A,$C3
	LD	($0000),A
	;
BMPRO:	LD	HL,MBMENU		; display the menu
	CALL	CONSTR
	CALL	DOGETCHR		; get user choice
	CP	CR			; go to monitor ?
	JP	Z,USRCMD		; yes
	CP	'A'			; is  a valid drive ?
	JP	M,BMPRO			; no < A
	CP	'Q'
	JP	P,BMPRO			; no > P
	SUB	'A'			; makes a number
	LD	(FDRVBUF),A		; is valid: store in monitor buffer
	LD	(CDISK),A		; and in CP/M buf
	CP	'C'-'A'			; is floppy ?
	JP	M,CPMBOOT		; yes
	CP	'O'-'A'			; is hard disk ?
	JP	M,HDBOOT		; yes
	JP	VCPMBT			; then is a virtual drive

	; Boot messages
MBMENU:	DEFB	CR,LF
	DEFB	"Select BOOT drive:",CR,LF,LF
	DEFB	"A-B = Floppy",CR,LF
	DEFB	"C-N = HD",CR,LF
	DEFB	"O-P = Virtual",CR,LF
	DEFB	"RET = Monitor",CR,LF,LF
	DEFB	'>'+$80
;;
GET1HNUM:
	LD	B,$01			; was 00F6D3 06 01
	LD	HL,$0000
	JR	GENTR
HEHEX:	JR	NZ,UCREJ
POP1PRM:
	DEC	B
	RET	Z
;;
;; GETHNUM - get an hexadecimal string
;
GETHNUM:
	LD	HL,$0000		; was 00F6DE 21 00 00
GNXTC:	CALL	DOGETCHR
GENTR:	LD	C,A
	CALL	CHKHEX
	JR	C,HNHEX			; if not hex digit
	ADD	HL,HL
	ADD	HL,HL
	ADD	HL,HL
	ADD	HL,HL
	OR	L
	LD	L,A
	JR	GNXTC
HNHEX:	EX	(SP),HL
	PUSH	HL
	LD	A,C
	CALL	CHKCTR
	JR	NC,HEHEX
	DJNZ	UCREJ
	RET
;;
;; USRCMD - display prompt and process user commands
;;
UCREJ:
	LD	HL,URESTR        ; was 00F6FD 21 0F FA
	CALL	CONSTR
USRCMD:
	LD	HL,(BTPASIZ)      ; was 00F703 2A 06 00
	LD	SP,HL
	LD	HL,USRCMD
	PUSH	HL
	LD	($0001),HL
	LD	A,$C3
	LD	($0000),A
	CALL	OUTCRLF
	CALL	DOPROMPT
	SUB	$41             ; convert to number
	JR	C,UCREJ         ; minor 0
	CP	$1A
	JR	NC,UCREJ        ; greater than jump table
	ADD	A,A
	LD	E,A
	LD	D,$00
	LD	B,$02
	LD	HL,UCMDTAB
	ADD	HL,DE
	LD	A,(HL)
	INC	HL
	LD	H,(HL)
	LD	L,A
	JP	(HL)
;;
;; FILLMEM - fill memory with a given values
;
FILLMEM:
	CALL	POP3NUM           ; was 00F730 CD 33 F9
FLME1:	LD	(HL),C
	CALL	CHKEOR
	JR	NC,FLME1
	POP	DE
	JR	USRCMD
;;
;; MEMCOMP - compare two ram regions
MEMCOMP:
	CALL	POP3NUM           ; was 00F73C CD 33 F9
MCONX:	LD	A,(BC)
	PUSH	BC
	LD	B,(HL)
	CP	B
	JR	Z,MCO1
	PUSH	AF
	CALL	HL2ASCB
	LD	A,B
	CALL	H2AJ3
	POP	AF
	CALL	H2AJ1
MCO1:	POP	BC
	CALL	IPTRCKBD
	JR	MCONX
;;
;; MEMDUMP - prompt user and dump memory area
;
MEMDUMP:
	CALL	POP2PRM           ; was 00F757 CD AB FA
MDP6:	CALL	HL2ASCB
	LD	A,L
	CALL	DMPALIB
	PUSH	HL
MDP2:	LD	A,(HL)
	CALL	H2AJ1
	CALL	CHKEOR
	JR	C,MDP1
	CALL	SPACER
	LD	A,L
	AND	$0F
	JR	NZ,MDP2
MDP7:	POP	HL
	LD	A,L
	AND	$0F
	CALL	DMPALIA
MDP5:	LD	A,(HL)
	NOP
	NOP
	LD	C,A
	CP	$20
	JR	C,MDP3
	NOP
	NOP
	JR	MDP4
MDP3:	LD	C,$2E
MDP4:	CALL	OUTCHR
	CALL	CHKBRK
	LD	A,L
	AND	$0F
	JR	NZ,MDP5
	JR	MDP6
MDP1:	SUB	E
	CALL	DMPALIB
	JR	MDP7
;;
;; DMPALIB - beginning align (spacing) for a memdump
DMPALIB:
	AND	$0F             ; was 00F79B E6 0F
	LD	B,A
	ADD	A,A
	ADD	A,B
;;
;; DMPALIB - ascii align (spacing) for a memdump
DMPALIA:
	LD	B,A             ; was 00F7A0 47
	INC	B
ALIBN:	CALL	SPACER
	DJNZ	ALIBN
	RET
;;
;; GOEXEC - execute from user address
;
GOEXEC:
	CALL	POP1PRM           ; was 00F7A8 CD DC F6
	POP	HL
	JP	(HL)
;
; 	nop
; 	nop
; 	nop
;;
;; GET DISPLAY CURSOR POSITION and return in HL
;
GDCUA:
	LD	A,$0E           ; was 00F7B0 3E 0E
	OUT	(CRT6545ADST),A
	IN	A,(CRT6545DATA)
	LD	H,A
	LD	A,$0F
	OUT	(CRT6545ADST),A
	IN	A,(CRT6545DATA)
	LD	L,A
	INC	HL
	LD	A,$1F
	OUT	(CRT6545ADST),A
	RET
;;
; CIJP2:
; 	OUT	(CRT6545ADST),A         ; was 00F7C4 D3 8C
; 	IN	A,(CRT6545DATA)
; 	LD	L,A
; 	CALL	SDCUAE
; 	EX	DE,HL
; 	JP	CIJP3
;;
;; DISPCH - Display a char on CRT at current position
;
DISPCH:
	PUSH	AF              ; was 00F7D0 F5
	LD	A,$1F
	OUT	(CRT6545ADST),A
	LD	A,(RAM3BUF)
	OUT	(CRTRAM3PORT),A
	POP	AF
	OUT	(CRTRAM0DAT),A
DCLP0:
	IN	A,(CRT6545ADST)
	BIT	7,A
	JR	Z,DCLP0
	XOR	A
	OUT	(CRT6545DATA),A
	RET

; CIJP1:
; 	IN	A,(CRT6545ADST)
; 	BIT	6,A
; 	RET	Z
; 	LD	A,$10
; 	OUT	(CRT6545ADST),A
; 	IN	A,(CRT6545DATA)
; 	LD	H,A
; 	LD	A,$11
; 	JP	CIJP2
;;
;; PORTIN - input a byte from given port (display it in binary)
;
PORTIN:
	CALL	POP1PRM           ; was 00F7F8 CD DC F6
	POP	BC
	IN	E,(C)
	JR	BINDISP
;;
;; PORTOUT - output a byte to a give port
PORTOUT:
	CALL	GETHNUM           ; was 00F800 CD DE F6
	POP	DE
	POP	BC
	OUT	(C),E
	RET
;;
;; MEMMOVE - move data in memory
;
MEMMOVE:
	CALL	POP3NUM           ; was 00F808 CD 33 F9
MMNXT:	LD	A,(HL)
	LD	(BC),A
	CALL	IPTRCKBD
	JR	MMNXT
;;
;; RWMEM - lets user alter memory content
;
RWMEM:
	CALL	POP1PRM         ; was 00F812 CD DC F6
	POP	HL
RWM3:	LD	A,(HL)
	CALL	H2AJ3
	CALL	VALGETCHR
	RET	C
	JR	Z,RWM1
	CP	$0A
	JR	Z,RWM2
	PUSH	HL
	CALL	GET1HNUM
	POP	DE
	POP	HL
	LD	(HL),E
	LD	A,C
	CP	$0D
	RET	Z
RWM1:	INC	HL
	INC	HL
RWM2:	DEC	HL
	LD	A,L
	AND	$07
	CALL	Z,HL2ASCB
	JR	RWM3
;;
;; MEMTEST - test ram region
MEMTEST:
	CALL	POP2PRM           ; was 00F83A CD AB FA
MTNXT:	LD	A,(HL)
	PUSH	AF
	CPL
	LD	(HL),A
	XOR	(HL)
	CALL	NZ,MTERR
	POP	AF
	LD	(HL),A
	CALL	CHKBRK
	JR	MTNXT
MTERR:	PUSH	DE
	LD	E,A
	CALL	HL2ASCB
;;
;; BINDISP - display E in binary form
;
BINDISP:
	LD	B,$08           ; was 00F851 06 08
BDNXT:	LD	A,E
	RLCA
	LD	E,A
	LD	A,$18
	RLA
	LD	C,A
	CALL	OUTCHR
	DJNZ	BDNXT
	POP	DE
	RET
;;
;; BCONIN - main keyboard input handle
;
CIRBF:	LD	A,$00			; was 00F861 3E 00
	LD	(KBDBYTE),A		; clear buffer
BCONIN:
	IN	A,(CRTKEYBDAT)		; in from PIO
	CPL
	BIT	7,A			; pressed ?
	JR	Z,CIRBF			; no: wait for user action
	PUSH	HL			; yes
	LD	HL,KBDBYTE
	CP	(HL)			; test input with buffer
	JR	Z,CIEQB			; EQUALS: enter autorepeat mode
	LD	HL,$A0FF		; auto repeat start time
	JR	CIPRC			; jump to press cycle
CIEQB:	LD	HL,$0400		; button autorepeat delay (in AR mode)
CIPRC:	PUSH	AF
CISTI:	IN	A,(CRTKEYBDAT)		; press cycle: check for keyb release
	CPL
	BIT	7,A			; is still pressed?
	JR	Z,CIGON			; no, go on
	DEC	HL			; dec AR start time
	LD	A,L
	OR	H			; timeout reached ?
	JR	NZ,CISTI		; no timeout: check again
CIGON:	POP	AF			; now process imput
	LD	(KBDBYTE),A
	RES	7,A			; make ASCII
	LD	HL,MIOBYTE
	BIT	1,(HL)			; perform special processing ??
;	ld     hl,MIOBYTE
	JR	NZ,CIBT1		; yes
CILOP:	BIT	3,(HL)			; no: transform to uppercase ?
	POP	HL
	RET	Z			; no
	CP	'a'			; yes: is less then 'a' ?
	RET	M			; yes: return, already ok
	CP	'{'			; no: then is greater than 'z' ?
	RET	P			; yes: ok!
	RES	5,A			; no: convert uppercase...
	RET
CIBT1:	LD	HL,CIREN		; command chars processing...
	PUSH	HL
	LD	HL,MIOBYTE
	CP	'^'			; test == '^': enable software caps-lock ?
	JR	NZ,CITC1		; no
	SET	3,(HL)			; yes: enable software caps-lock
	RET				;
CITC1:	CP	$5C			; test == '\': disable soft. caps-lock ?
	JR	NZ,CITC2		; no
	RES	3,(HL)			; yes: disable software caps-lock
	RET
CITC2:	CP	$07			; test == CTRL+G ??
	JP	Z,CIGRTOG		; yes: switch to graphic mode
	CP	$05			; test ==CTRL+E ??
	JP	Z,LINDN			; yes: move cursor down one line
	CP	$13			; test == CTRL+S ??
	JP	Z,CIHCR			; yes: move cursor left one char
	CP	$04			; test == CTRL+D ??
	JP	Z,CURRGT		; yes: move cursor right one char
	CP	$18			; test == CTRL+X ??
	JP	Z,IOCSY2		; yes: move cursor up one line
	POP	HL
	LD	HL,MIOBYTE
	JP	GETLPEN			; go to check light pen status
CIREN:	POP	HL
	JP	BCONIN
CIHCR:	LD	HL,MIOBYTE		; manage backspace
	LD	A,(HL)
	PUSH	AF
	PUSH	HL
	SET	4,(HL)			; set destructive back-space
	CALL	IOCBS			; do backspace
	POP	HL
	POP	AF
	LD	(HL),A
	RET
; CIJP3:
; 	LD	HL,(CURPBUF)
; 	EX	DE,HL
; 	XOR	A
; 	SBC	HL,DE
; 	LD	DE,$0050
; CIJP4:	XOR	A
; 	SBC	HL,DE
; 	JR	NC,CIJP4
; 	ADD	HL,DE
; 	LD	A,L
; 	LD	(COLBUF),A
; 	RET
;
;; GETLPEN - manage light-pen operations
GETLPEN:
	PUSH	AF
	PUSH	DE
; 	CALL	CIJP1
; CIJP1:
	IN	A,(CRT6545ADST)
	BIT	6,A			; got LPEN strobe ?
	RET	Z			; no
	LD	A,$10			; yes...
	OUT	(CRT6545ADST),A		; get LPEN position
	IN	A,(CRT6545DATA)
	LD	H,A
	LD	A,$11
; 	JP	CIJP2
; CIJP2:
	OUT	(CRT6545ADST),A
	IN	A,(CRT6545DATA)
	LD	L,A			; ...in HL
	CALL	SDCUAE			; move cursor to LPEN pos
	EX	DE,HL
; 	JP	CIJP3
; CIJP3:
	LD	HL,(CURPBUF)
	EX	DE,HL
	XOR	A
	SBC	HL,DE
	LD	DE,$0050
CIJP4:	XOR	A
	SBC	HL,DE
	JR	NC,CIJP4
	ADD	HL,DE
	LD	A,L
	LD	(COLBUF),A		;
; 	RET
	POP	DE
	POP	AF
	JP	CILOP			; re-enter normal char processing
; 	nop
;;
;; CIGRTOG - toggle graphic mode on
;
CIGRTOG:
	IN	A,(CRT6545ADST)		; was 00FF40 DB 8C
	BIT	7,A
	JR	Z,CIGRTOG
	IN	A,(CRTRAM3PORT)
	SET	4,A
	LD	(RAM3BUF),A
	IN	A,(CRTRAM0DAT)
	POP	HL
	POP	HL
	RET
;;
;; SET DISPLAY START ADDRESS
;
SDSTA:
	LD	A,$0C			; was 00F90E 3E 0C
	OUT	(CRT6545ADST),A
	LD	A,H
	OUT	(CRT6545DATA),A
	LD	A,$0D
	OUT	(CRT6545ADST),A
	LD	A,L
	OUT	(CRT6545DATA),A
	LD	A,$1F
	OUT	(CRT6545ADST),A
	RET
;;
; 	nop
; 	nop
; 	nop
; 	nop
;;
;; DOPROMPT - display prompt and wait for first key (uppercase)
;
DOPROMPT:
	CALL	MPROMPT			; was 00F925 CD 5F FA
;; get a char in uppercase, and display too...
DOGETCHR:
	CALL	COIUPC			; was 00F928 CD 89 FA
COUTCH:	PUSH	BC
	LD	C,A
	CALL	OUTCHR
	LD	A,C
	POP	BC
	RET
;
POP3NUM:
	INC	B			; was 00F933 04
	CALL	GETHNUM
	POP	BC
	POP	DE
	JP	OCRLF1
;;
;; inc HL and do a 16 bit compare between HL and DE
CHKEOR:
	INC	HL			; was 00F93C 23
	LD	A,H
	OR	L
	SCF
	RET	Z
	LD	A,E
	SUB	L
	LD	A,D
	SBC	A,H
	RET
;;
CBKEND:	POP	DE
	RET
;;
;; inc pointer BC and check kbd
IPTRCKBD:
	INC	BC
;;
CHKBRK:
	CALL	CHKEOR			; was 00F949 CD 3C F9
	JR	C,CBKEND
	CALL	BCONST
	OR	A
	RET	Z
	CALL	COIUPC
	CP	$13
	JR	NZ,CBKEND
	JP	COIUPC
;;
;; CHKHEX - check for hex ascii char in A
;
CHKHEX:
	SUB	$30			; was 00F95D D6 30
	RET	C
	CP	$17
	CCF
	RET	C
	CP	$0A
	CCF
	RET	NC
	SUB	$07
	CP	$0A
	RET
;; get chr and validate
VALGETCHR:
	CALL	DOGETCHR		; was 00F96D CD 28 F9
;;
;; CHKCTR: check for valid char in string (space,comma,<CR>)
;
CHKCTR:
	CP	$20			; was 00F970 FE 20
	RET	Z
	CP	$2C
	RET	Z
	CP	$0D
	SCF
	RET	Z
	CCF
	RET
;;
;; This seem an unreferenced piece of code
;;
; 	push   hl              ; was 00F97C E5
; 	push   de
; 	push   bc
; 	push   af
; 	call   FMEMSIZ
; 	ex     de,hl
; 	ld     hl,$000a
; 	add    hl,sp
; 	ld     b,$04
; 	ex     de,hl
; CCJP1:	dec    hl
; 	ld     (hl),d
; 	dec    hl
; 	ld     (hl),e
; 	pop    de
; 	djnz   CCJP1
; 	pop    bc
; 	dec    bc
; 	ld     sp,hl
; 	ld     hl,APPBUF
; 	add    hl,sp
; 	push   de
; 	ld     d,$02
; CCJP3:	ld     a,(hl)
; 	sub    c
; 	inc    hl
; 	ld     a,(hl)
; 	sbc    a,b
; 	jr     z,CCJP2
; 	inc    hl
; 	inc    hl
; 	dec    d
; 	jr     nz,CCJP3
; 	inc    bc
; CCJP2:	ld     hl,$0020
; 	pop    de
; 	add    hl,sp
; 	ld     (hl),e
; 	inc    hl
; 	ld     (hl),d
; 	push   bc
; 	ld     c,$2a
; 	call   OUTCHR
; 	pop    de
; 	ld     a,$e5
; 	cp     d
; 	jr     z,CCJP4
; 	inc    hl
; 	inc    hl
; 	ld     (hl),e
; 	inc    hl
; 	ld     (hl),d
; 	ex     de,hl
; 	call   H2AEN1
; CCJP4:	ld     hl,APPBUF
; 	add    hl,sp
; 	ld     bc,$0200
; CCJP6:	ld     e,(hl)
; 	ld     (hl),c
; 	inc    hl
; 	ld     d,(hl)
; 	ld     (hl),c
; 	inc    hl
; 	ld     a,e
; 	or     d
; 	jr     z,CCJP5
; 	ld     a,(hl)
; 	ld     (de),a
; CCJP5:	inc    hl
; 	djnz   CCJP6
; 	ex     af,af'
; 	exx
; 	push   hl
; 	push   de
; 	push   bc
; 	push   af
; 	push   ix
; 	push   iy
; 	ld     a,i
; 	ld     b,a
; 	ld     a,r
; 	ld     c,a
; 	push   bc
; 	jp     $f307
; 	push   hl
; 	rst    08h
;;
;; Questo blocco di istruzioni viene copiato nell'ultima pagina di memoria ram
;; nei suoi ultimi byte (dfdd della pagina df00-dfff)
;; ... perche'???
;
; RAMBLK:
; 	POP	BC              ; was 00F9F2 C1
; 	LD	A,C
; 	LD	R,A
; 	LD	A,B
; 	LD	I,A
; 	POP	IX
; 	POP	IY
; 	POP	AF
; 	POP	BC
; 	POP	DE
; 	POP	HL
; 	EX	AF,AF'
; 	EXX
; 	POP	DE
; 	POP	BC
; 	POP	AF
; 	POP	HL
; 	LD	SP,HL
; 	NOP
; 	LD	HL,$0000
; 	JP	$0000
;
;; User command reject string
URESTR:
	DB	$AA			; was 00FA0F AA
;
;; TOGPRNIO - toggle i/o on prn/crt
TOGPRNIO:
	LD	HL,MIOBYTE		; was 00FA10 21 47 00
	BIT	5,(HL)
	JR	Z,TOGPR
	RES	5,(HL)
	JR	TOGJU
TOGPR:	SET	5,(HL)
TOGJU:	JP	USRCMD
;;
;; SCRTST - Verify if we need video scroll
;
SCRTST:
	LD	DE,(CURPBUF)		; was 00FA20 ED 5B 48 00
	XOR	A
	SBC	HL,DE
	LD	A,H
	CP	$07
	RET	C
	LD	A,L
	CP	$CF
	RET
;;
;; unreferenced piece of code
;;
;	nop
;	or     a
;	ld     a,h
;	rra
;	ld     h,a
;	ld     a,l
;	rra
;	ld     l,a
;	ret
;;
;; CALCHLDE - perform 16 bit add & sub between HL and DE
;
CALCHLDE:
	CALL	POP2PRM           ; was 00FA38 CD AB FA
	PUSH	HL
	ADD	HL,DE
	CALL	HL2ASCB
	POP	HL
	OR	A
	SBC	HL,DE
	JR	H2AEN1
;;
;; HL2ASC - convert & display HL 2 ascii
HL2ASC:
	CALL	OUTCRLF           ; was 00FA46 CD B0 FA
H2AEN1:	LD	A,H
	CALL	H2AJ1
	LD	A,L
H2AJ1:	PUSH	AF
	RRCA
	RRCA
	RRCA
	RRCA
	CALL	H2AJ2
	POP	AF
H2AJ2:	CALL	NIB2ASC
	JR	OUTCHR
H2AJ3:	CALL	H2AJ1           ; entry point to display HEX and a "-"
MPROMPT:
	LD	C,$2D
	JR	OUTCHR
;;
;; HL2ASCB - convert & display HL 2 ascii leave a blank after
HL2ASCB:
	CALL	HL2ASC           ; was 00FA63 CD 46 FA
SPACER:	LD	C,$20
;;
;; OUTCHR - send a char to the output
;; switch CRT/PRINTER depending of bit 5 of MIOBYTE
;
OUTCHR:
	LD	A,(MIOBYTE)		; was 00FA68 3A 47 00
	BIT	5,A			; printer or video ?
	JR	Z,OCJPV
	CALL	JPRNCH
OCJPV:
	JP	JCONOU
;;
;; PRNCHR - send a char to printer port (from C)
;
PRNCHR:
	IN	A,(CRTSERVDAT)         ; was 00FA75 DB 89
	BIT	PRNTBUSYBIT,A
	JR	NZ,PRNCHR
	LD	A,C
	OUT	(CRTPRNTDAT),A
	RET
;;
; 	nop
; 	nop
; 	nop
; 	nop
; 	nop
; 	nop
; 	nop
; 	nop
; 	nop
; 	nop
;;
;; COIUPC- convert reg A uppercase
COIUPC:
	CALL	JCONIN           ; was 00FA89 CD 03 F0
	CP	$60
	JP	M,COIRE
	CP	$7B
	JP	P,COIRE
	RES	5,A
COIRE:	RET
;;
;;
;; GREET - ...comes here from boot...
;
GREET:
	CALL	OUTCRLF           ; was 00FA99 CD B0 FA
;;
;; CONSTR print a string using OUTCHR -> BCONOUT
CONSTR:
	PUSH	BC              ; was 00FA9C C5
CSLP0:	LD	C,(HL)
	LD	B,(HL)
	RES	7,C
	CALL	OUTCHR
	INC	HL
	LD	A,B
	RLCA
	JR	NC,CSLP0
	POP	BC
	RET
;;
POP2PRM:
	CALL	GETHNUM           ; was 00FAAB CD DE F6
	POP	DE
	POP	HL
;;
;; OUTCRLF - CR/LF through BCONOUT
;
OUTCRLF:
	PUSH	HL              ; was 00FAB0 E5
OCRLF1:	LD	HL,CRLFTAB
	CALL	CONSTR
	POP	HL
	RET
;;
BCONST:
	IN	A,(CRTKEYBDAT)         ; was 00FAB9 DB 85
	CPL
	BIT	7,A
	LD	A,$00
; 	JR	BCONSTJ
; BCONSTJ:
	RET	Z                  ; was 00FB07 C8
	CPL
	RET
;;
;; ???
;; called by monitor with key command "Z"
;; loop until you press two times CTRL+G
;; ???   8-?
; BLOOP:
; 	LD	B,$02           ; was 00FAC2 06 02
; BLP1:	CALL	COIUPC
; 	CP	$07
; 	JR	NZ,BLOOP
; 	CALL	COUTCH
; 	DJNZ	BLP1
; 	RET
;
;	nop
UCMDTAB:
	DW	UCREJ           ; (A) n/a
	DW	JCPMBT          ; (B) cp/m boot
	DW	UCREJ           ; (C) n/a
	DW	MEMDUMP         ; (D) dump memory
	DW	UCREJ           ; (E) n/a
	DW	FILLMEM         ; (F) fill memory
	DW	GOEXEC          ; (G) go exec a sub
	DW	CALCHLDE        ; (H) sum & subtract HL, DE
	DW	PORTIN          ; (I) port input
	DW	INIT0           ; (J) init, clear screen
	DW	JBOOT           ; (K) restart system
	DW	FLOPPYREAD      ; (L) read floppy,track,sec to ram
	DW	MEMMOVE         ; (M) move memory block
;	dw     NEDOSINI        ; (N) NEDOS boot page
	DW	UCREJ           ; (N) n/a
	DW	PORTOUT         ; (O) output to a port
	DW	TOGPRNIO        ; (P) toggle prn/crt i/o
	DW	UCREJ           ; (Q) n/a
	DW	FLOPPYWRIT      ; (R) write floppy,track,sec to ram
	DW	RWMEM           ; (S) alter memory
	DW	MEMTEST         ; (T) test ram region
;	dw     UCREJ           ; (U) n/a
	DW	UPLOAD          ; (U) Parallel Upload
	DW	MEMCOMP         ; (V) compare mem blocks
	DW	PDNLOAD         ; (W) Parallel DoWnload
	DW	VCPMBT          ; (X) n/a
	DW	INICRTREG       ; (Y) reinit 6545
;	DW	BLOOP           ; (Z) bloop - crazy routine
	DW	UCREJ           ; (Z) n/a
;;
;	nop
;
; BCONSTJ:
; 	RET	Z                  ; was 00FB07 C8
; 	CPL
; 	RET
;
; 	nop
; 	nop
; 	nop
; 	nop
; 	nop
; 	nop
;;
;; BCONOUT print out the char in reg C
;
BCONOUT:
	PUSH	AF			; was 00FB10 F5
	PUSH	BC
	PUSH	DE
	PUSH	HL
	; force jump to register restore and exit in stack
	LD	HL,VCRESREG
	PUSH	HL
; 	nop
; 	nop
; 	nop
; 	nop
; 	nop
; 	nop
; 	nop
; 	nop
	LD	A,C
	LD	HL,MIOBYTE
	BIT	7,(HL)			; alternate char processing ?
	EX	DE,HL
	JP	NZ,CONOU2		; yes: do alternate
	CP	$20			; no: is less then 0x20 (space) ?
	JR	NC,COJP1		; no: go further
	LD	HL,IOCVEC		; yes: is a special char
	ADD	A,L
	LD	L,A
	LD	C,(HL)
	LD	B,$00
	OR	A
	LD	HL,IOCBASE
	ADD	HL,BC
	JP	(HL)			; jump to IOCVEC handler
COJP1:	EX	DE,HL
	BIT	6,(HL)			; auto ctrl chars ??
	JR	Z,COJP2			; no
	CP	$40			; yes: convert
	JR	C,COJP2
	CP	$60
	JR	NC,COJP2
	SUB	$40
COJP2:	CALL	DISPCH			; display char
	; move cursor right
CURRGT:
	CALL	GDCUA			; update cursor position
	CALL	SDCUAE
	LD	A,(COLBUF)
	INC	A
	CP	$50
	JR	Z,MOVDN			; go down if needed
;;
SAVCOLB:
	LD	(COLBUF),A		; save cursor position
	RET
CONOU2:					; alternate processing....
	CP	$20			; is a ctrl char ??
	JR	NC,CURADR		; no: will set cursor pos
	LD	HL,IOCVEC2		; yes
	ADD	A,L
	LD	L,A
	LD	C,(HL)
	LD	B,$00
	OR	A
	LD	HL,IOCBAS2
	ADD	HL,BC
	NOP
	JP	(HL)			; jump to service routine... (IOCVEC2)
;; cursor addressing service routine
;; address is ESC + (COL # + 32) + (ROW # + 32)
;CURADR:	EX	DE,HL
CURADR:	LD	HL,TMPBYTE
	BIT	0,(HL)
	JR	NZ,SETROW
	CP	$70			; greater then 80 ?
	RET	NC			; yes: error
	SUB	$20			; no: ok
	LD	(APPBUF),A		; store column
	SET	0,(HL)			; switch row/col flag
	RET
SETROW:	CP	$39			; greater than 24 ?
	RET	NC			; yes: error
	SUB	$1F			; no: ok
	RES	0,(HL)			; resets flags
	LD	HL,MIOBYTE
	RES	7,(HL)			; done reset
	LD	B,A
	LD	HL,$FFB0
	LD	DE,$0050
CUROFS:	ADD	HL,DE			; calc. new offset
	DJNZ	CUROFS
	LD	A,(APPBUF)
	LD	(COLBUF),A
	LD	E,A
	ADD	HL,DE
	EX	DE,HL
	LD	HL,(CURPBUF)
	ADD	HL,DE
	JP	SDCUAE			; update position
VCRESREG:
	POP	HL
	POP	DE
	POP	BC
	POP	AF
	RET
;;
;; MOVDN: down one line, scroll, home, clreol
;
MOVDN:
	XOR	A               ; was 00FB60 AF
	LD	(COLBUF),A
MOVDN1:	CALL	SCRTST
	RET	C
	LD	HL,MIOBYTE
	BIT	2,(HL)
	LD	DE,$F830
	CALL	GDCUA
	DEC	HL
	JR	Z,MDJMP0
	ADD	HL,DE
	JP	SDCUAE
MDJMP0:	PUSH	HL
	CALL	CLRLIN
	LD	HL,(CURPBUF)
	LD	DE,$0050
	ADD	HL,DE
	LD	DE,$0820
	PUSH	HL
	SBC	HL,DE
	POP	HL
	JR	C,MDJMP1
	RES	3,H
MDJMP1:	LD	(CURPBUF),HL
	CALL	SDSTA
; 	JR	MOVEND
; MOVEND:
	POP	HL              ; was 00FBE3 E1
	JR	C,MEJP
	RES	3,H
MEJP:	JP	SDCUAE

; CONOU2:
; 	CP	$20             ; was 00FB98 FE 20
; 	JR	NC,CURADR
; 	LD	HL,IOCVEC2
; 	ADD	A,L
; 	LD	L,A
; 	LD	C,(HL)
; 	LD	B,$00
; 	OR	A
; 	LD	HL,IOCBAS2
; 	ADD	HL,BC
; 	NOP
; 	JP	(HL)
; CURADR:	EX	DE,HL
; 	BIT	0,(HL)
; 	JR	NZ,SETROW
; 	CP	$70
; 	RET	NC
; 	SUB	$20
; 	LD	(APPBUF),A
; 	SET	0,(HL)
; 	RET
; SETROW:	CP	$39
; 	RET	NC
; 	SUB	$1F
; 	RES	7,(HL)
; 	RES	0,(HL)
; 	LD	B,A
; UKR14:	LD	HL,$FFB0
; 	LD	DE,$0050
; CUROFS:	ADD	HL,DE
; 	DJNZ CUROFS
; 	LD	A,(APPBUF)
; 	LD	(COLBUF),A
; 	LD	E,A
; 	ADD	HL,DE
; 	EX	DE,HL
; 	LD	HL,(CURPBUF)
; 	ADD	HL,DE
; 	JP	SDCUAE
; VCRESREG:
; 	POP	HL
; 	POP	DE
; 	POP	BC
; 	POP	AF
; 	RET
;; MOVEND
;
; MOVEND:
; 	POP	HL              ; was 00FBE3 E1
; 	JR	C,MEJP
; 	RES	3,H
; MEJP:	JP	SDCUAE
;
; 	nop
; 	nop
; 	nop
; 	nop
; 	nop
CURBLB:
	LD	L,$40           ; (0 10 00000) 1/16 blink scan 0
	JR	CURSETMODE
CURBLL:
	LD	L,$4A           ; (0 10 01010) 1/16 blink scan 10
	JR	CURSETMODE
CURBFB:
	LD	L,$60           ; (0 11 00000) 1/32 blink scan 0
	JR	CURSETMODE
CURBFL:
	LD	L,$6A           ; (0 11 01010) 1/32 blink scan 10
	JR	CURSETMODE
CUROFB:
	LD	L,$20           ; (0 01 00000) no cursor scan 0
	JR	CURSETMODE
CURFXB:
	LD	L,$00           ; (0 00 00000) fixed scan 0
	JR	CURSETMODE
CURFXL:
	LD	L,$0A           ; (0 00 01010) fixed scan 10
CURSETMODE:
	LD	A,$0A           ; was 00FC0A 3E 0A
	OUT	(CRT6545ADST),A
	LD	A,L
	OUT	(CRT6545DATA),A
	LD	A,$1F
	OUT	(CRT6545ADST),A
	RET
;;
;; DLIGHT
;; fill video ram (2k) with ff's
;
DLIGHT:
	LD	HL,$FFFF        ; was 00FC16 21 FF FF
	LD	(RAM0BUF),HL
	LD	A,$FF
	LD	(RAM2BUF),A
	JP	CRTFIL
;;
;; DISMVC display char and move cursor
;
DISMVC:
	CALL	DISPCH           ; was 00FC24 CD D0 F7
	JP	SDCUAE
;;
; 	nop
; 	nop
; 	nop
; 	nop
; 	nop
; 	nop
;;
;; IOCBASE (a void routine) from here a list of routines to handle
;; console char output
;
IOCBASE:
	RET	; was 00FC30 C9
;
IOCSOH:
	EX	DE,HL
	SET	3,(HL)
	RET
IOCSTX:
	EX	DE,HL
	RES	3,(HL)
	RET
;;
;; INICRTCUR - init CRT cursor at CURPBUF
;
INICRTCUR:
	LD	HL,(CURPBUF)
	CALL	SDCUAE
	XOR	A
	JP	SAVCOLB
;;
;; IOCBEL - sound beep
IOCBEL:
	OUT	(CRTBEEPPORT),A
	RET
;;
;;
;
IOCBS:
	CALL	GDCUA
	DEC	HL
	LD	DE,(CURPBUF)
	XOR	A
	SBC	HL,DE
	CP	H
	JR	NZ,IOCBS1
	CP	L
	RET	Z
IOCBS1:	DEC	HL
	ADD	HL,DE
	CALL	SDCUAE
	PUSH	HL
	LD	A,(COLBUF)
	DEC	A
	CP	$FF
	JR	NZ,IOCBS2
	LD	A,$4F
IOCBS2:	LD	(COLBUF),A
	LD	HL,MIOBYTE
	BIT	4,(HL)
	POP	HL
	RET	NZ
	LD	A,$20
	JP	DISMVC
;;
;; CHOME - move cursor at col 0
;
CHOME:
	LD	HL,COLBUF
	LD	E,(HL)
	XOR	A
	LD	(HL),A
	LD	D,A
	CALL	GDCUA
	DEC	HL
	SBC	HL,DE
	CALL	SDCUAE
	RET
;;
;; CLRSCR - clear screen (ASCII mode)
;
CLRSCR:
	LD	HL,$0000
	XOR	A
	LD	(COLBUF),A
	CPL
	LD	(RAM3BUF),A
	LD	(CURPBUF),HL
	CALL	SDCUAE
	CALL	SDSTA
	PUSH	HL
CLSNC:	LD	A,$20
	CALL	DISPCH
	INC	HL
	LD	A,H
	CP	$08
	JR	NZ,CLSNC
	POP	HL
	JP	SDCUAE
;; IOCCR - handle carriage return (0x0d)
;; should position the cursor at col 0
;
IOCCR:
	EX	DE,HL
	BIT	3,(HL)
	JR	Z,IOCCR1
	CALL	CLREOL
IOCCR1:	JP	CHOME
;;
IOCSO:
	XOR	A
	LD	HL,(CURPBUF)
	LD	DE,$07D0
	ADD	HL,DE
	EX	DE,HL
	CALL	GDCUA
	DEC	HL
	EX	DE,HL
	SBC	HL,DE
	PUSH	HL
	POP	BC
CLRJ0:	CALL	CLRLIN1
	EX	DE,HL
	JP	SDCUAE
IOCENQ:
	JP	CURBFL
IOCUS:
	JP	SET3MIOB
;
; 	nop
; 	nop
;;
;; CLREOL - clear to end of line
;
CLREOL:
	LD	A,(COLBUF)
	LD	B,A
	LD	A,$50
	SUB	B
	LD	B,$00
	LD	C,A
	CALL	GDCUA
	DEC	HL
	EX	DE,HL
	JP	CLRJ0
;;
IOCSYN:
	EX	DE,HL
	SET	2,(HL)
	RET
IOCETB:
	EX	DE,HL
	RES	2,(HL)
	RET
IOCFS:
	EX	DE,HL
	RES	1,(HL)
	RET
IOCGS:
	EX	DE,HL
	SET	1,(HL)
	RET
IOCESC:
	EX	DE,HL
	SET	7,(HL)
	RET
;;
;; IOCLF - line feed handle
IOCLF:
	JP	LINDN
;;
;; RESATTR - reset all attributes
;
RESATTR:
	LD	A,$FF
	LD	(RAM3BUF),A
	RET
;;
IOCCAN:
	JP	INIT0
IOCRS:
	JP	OUTGRBUF
IOCEOT:
	JP	CURBFB

; 	nop
;;
;; IOCBASE2 (a void routine) from here a list of routines to handle
;; console char output
;; This is the same as IOCBASE but when bit 7 of MIOBYTE is set
;
IOCBAS2:
	RET	; was 00FD0F C9
IOCNAK:
	JP	CURRGT
IOCSY2:
	CALL	GDCUA
	LD	DE,$FFAF
	ADD	HL,DE
	EX	DE,HL
	LD	HL,(CURPBUF)
	EX	DE,HL
	XOR	A
	SBC	HL,DE
	CPL
	CP	H
	ADD	HL,DE
	RET	Z
	JP	SDCUAE
IOCUS2:
	JP	RES3MIOB
; 	nop
; 	nop
; 	nop
IOCCA2:
	EX	DE,HL
	RES	6,(HL)
	RET
IOCEM:
	EX	DE,HL
	SET	4,(HL)
	RET
IOCSUB:
	EX	DE,HL
	RES	4,(HL)
	RET
IOCSO2:
	LD	HL,RAM3BUF
	SET	0,(HL)
	RET
IOCFS2:
	LD	HL,RAM3BUF
	SET	1,(HL)
	RET
IOCETX:
	LD	HL,RAM3BUF
	SET	2,(HL)
	RET
IOCEN2:
	LD	HL,RAM3BUF
	SET	3,(HL)
	RET
IOCBE2:
	LD	HL,RAM3BUF
	SET	4,(HL)
	RET
IOCS2:
	LD	HL,RAM3BUF
	SET	5,(HL)
	RET
IOCDLE:
	LD	HL,RAM3BUF
	SET	6,(HL)
	RET
IOCGS2:
	LD	HL,RAM3BUF
	SET	7,(HL)
	RET
IOCST2:
	LD	HL,RAM3BUF
	RES	0,(HL)
	RET
IOCES2:
	LD	HL,RAM3BUF
	RES	1,(HL)
	RET
IOCEO2:
	LD	HL,RAM3BUF
	RES	2,(HL)
	RET
IOCAC2:
	LD	HL,RAM3BUF
	RES	3,(HL)
	RET
IOCHT:
	LD	HL,RAM3BUF
	RES	4,(HL)
	RET
IOCSI2:
	LD	HL,RAM3BUF
	RES	5,(HL)
	RET
IOCD12:
	LD	HL,RAM3BUF
	RES	6,(HL)
	RET
IOCRS2:
	LD	HL,RAM3BUF
	RES	7,(HL)
	RET
;;
;; LINDN - cursor down one line
;
LINDN:
	CALL	GDCUA
	DEC	HL
	LD	DE,$0050
	ADD	HL,DE
	CALL	SDCUAE
	JP	MOVDN1
;;
IOCNUL:
	EX	DE,HL
	RES	7,(HL)
	RET
;
IOCDC2:
	JP	CURBLB
IOCDC3:
	JP	CURBLL
IOCET2:
	EX	DE,HL
	SET	6,(HL)
	RET

; 	nop
; 	nop
; 	nop
; 	nop
; 	nop
; 	nop
; 	nop
; 	nop
; 	nop
;;
;; CLRLIN - clear current line
;
CLRLIN:
	LD	BC,$0050        ; was 00FDC0 01 50 00
CLRLIN1:
	LD	A,(RAM3BUF)
	PUSH	AF
	LD	A,$FF
	LD	(RAM3BUF),A
CLRLP1:	LD	A,$20
	CALL	DISPCH
	DEC	BC
	LD	A,B
	OR	C
	JR	NZ,CLRLP1
	POP	AF
	LD	(RAM3BUF),A
	RET
;;
; 	nop
; 	nop
; 	nop
; 	nop
; 	nop
;;
;; NIB2ASC convert lower nibble in reg A to ascii in reg C
;
NIB2ASC:
	AND	$0F             ; was 00FDE0 E6 0F
	ADD	A,$90
	DAA
	ADC	A,$40
	DAA
	LD	C,A
	RET
IOCVT2:
	JP	CURFXL
; 	nop
; 	nop
; 	nop
IOCFF2:
	JP	DBLANK
; 	nop
; 	nop
; 	nop
; 	nop
; 	nop
; 	nop
; 	nop
; 	nop
; 	nop
; 	nop
; 	nop
; 	nop
; 	nop
;; This table define the offsets to jump from
;; IOCBASE (IOCBASE+IOCVEC) to a set fo routines that
;; handles cntrl char < 0x20 when we are in BCONOUT
IOCVEC:
	DB	IOCBASE-IOCBASE          ; NUL 0x00 (00)  no-op
	DB	IOCSOH-IOCBASE           ; SOH 0x01 (01)  set bit 3 (de)
	DB	IOCSTX-IOCBASE           ; STX 0x02 (05)  res bit 3 (de)
	DB	IOCBASE-IOCBASE          ; ETX 0x03 (00)  no-op
	DB	IOCEOT-IOCBASE           ; EOT 0x04 (db)  cursor blink fast block
	DB	IOCENQ-IOCBASE           ; ENQ 0x05 (9e)  cursor blink fast line
	DB	IOCACK-IOCBASE           ; ACK 0x06 (09)  locate cursor at CURPBUF
	DB	IOCBEL-IOCBASE           ; BEL 0x07 (13)  beep
	DB	IOCBS-IOCBASE            ; BS  0x08 (16)  cursor back
	DB	IOCBASE-IOCBASE          ; HT  0x09 (00)  no-op
	DB	IOCLF-IOCBASE            ; LF  0x0a (cc)  cursor down one line
	DB	IOCVT-IOCBASE            ; VT  0x0b (45)  cursor home
	DB	IOCFF-IOCBASE            ; FF  0x0c (56)  page down (clear screen)
	DB	IOCCR-IOCBASE            ; CR  0x0d (7a)  cursor home
	DB	IOCSO-IOCBASE            ; SO  0x0e (85)  to end of page clear line
	DB	IOCSI-IOCBASE            ; SI  0x0f (a6)  clear to EOL
	DB	IOCBASE-IOCBASE          ; DLE 0x10 (00)  no-op
	DB	IOCDC1-IOCBASE           ; DC1 0x11 (cf)  reset all attributes
	DB	IOCBASE-IOCBASE          ; DC2 0x12 (00)  no-op
	DB	IOCBASE-IOCBASE          ; DC3 0x13 (00)  no-op
	DB	IOCBASE-IOCBASE          ; DC4 0x14 (00)  no-op
	DB	IOCBASE-IOCBASE          ; NAK 0x15 (00)  no-op
	DB	IOCSYN-IOCBASE           ; SYN 0x16 (b8) set bit 2 of (de)
	DB	IOCETB-IOCBASE           ; ETB 0x17 (bc) res bit 2 of (de)
	DB	IOCCAN-IOCBASE           ; CAN 0x18 (d5) hard crt reset and clear
	DB	IOCBASE-IOCBASE          ; EM  0x19 (00)  no-op
	DB	IOCBASE-IOCBASE          ; SUB 0x1a (00)  no-op
	DB	IOCESC-IOCBASE           ; ESC 0x1b (c8) set bit 7 of (de)
	DB	IOCFS-IOCBASE            ; FS  0x1c (c0) res bit 1 of (de)
	DB	IOCGS-IOCBASE            ; GS  0x1d (c4) set bit 1 of (de)
	DB	IOCRS-IOCBASE            ; RS  0x1e (d8) display graphic buffer (ram[012]buf)
	DB	IOCUS-IOCBASE            ; US  0x1f (a1) set bit 1 of (de)
;; This table define the offsets to jump from
;; IOCBAS2 (IOCBAS2+IOCVEC2) to a set fo routines that
;; handles cntrl char < 0x20 when we are in BCONOUT
IOCVEC2:
	DB	IOCNUL-IOCBAS2           ; NUL 0x00 (9a)  res bit 7 (de)
	DB	IOCSO2-IOCBAS2           ; SOH 0x01 (2c)  set bit 0 RAM3BUF
	DB	IOCST2-IOCBAS2           ; STX 0x02 (5c)  res bit 0 RAM3BUF
	DB	IOCETX-IOCBAS2           ; ETX 0x03 (38)  set bit 2 RAM3BUF
	DB	IOCEO2-IOCBAS2           ; EOT 0x04 (68)  res bit 2 RAM3BUF
	DB	IOCEN2-IOCBAS2           ; ENQ 0x05 (3e)  set bit 3 RAM3BUF
	DB	IOCAC2-IOCBAS2           ; ACK 0x06 (6e)  res bit 3 RAM3BUF
	DB	IOCBE2-IOCBAS2           ; BEL 0x07 (44)  set bit 4 RAM3BUF
	DB	IOCBAS2-IOCBAS2          ; BS  0x08 (00)  no-op
	DB	IOCHT-IOCBAS2            ; HT  0x09 (74)  res bit 4 RAM3BUF
	DB	IOCBAS2-IOCBAS2          ; LF  0x0a (00)  no-op
	DB	IOCVT2-IOCBAS2           ; VT  0x0b (db)  cursor fixed line
	DB	IOCFF2-IOCBAS2           ; FF  0x0c (e1)  clear screen
	DB	IOCBAS2-IOCBAS2          ; CR  0x0d (00)  no-op
	DB	IOCS2-IOCBAS2            ; SO  0x0e (4a)  set bit 4 RAM3BUF
	DB	IOCSI2-IOCBAS2           ; SI  0x0f (7a)  res bit 4 RAM3BUF
	DB	IOCDLE-IOCBAS2           ; DLE 0x10 (50)  set bit 6 RAM3BUF
	DB	IOCD12-IOCBAS2           ; DC1 0x11 (80)  res bit 6 RAM3BUF
	DB	IOCDC2-IOCBAS2           ; DC2 0x12 (9e)  cursor blink slow block
	DB	IOCDC3-IOCBAS2           ; DC3 0x13 (a1)  cursor blink slow line
	DB	IOCDC4-IOCBAS2           ; DC4 0x14 (8c)  cursor down one line
	DB	IOCNAK-IOCBAS2           ; NAK 0x15 (01)  cursor right
	DB	IOCSY2-IOCBAS2           ; SYN 0x16 (04)  cursor up one line
	DB	IOCET2-IOCBAS2           ; ETB 0x17 (a4)  set bit 6 of (de)
	DB	IOCCA2-IOCBAS2           ; CAN 0x18 (20)  res bit 6 of (de)
	DB	IOCEM-IOCBAS2            ; EM  0x19 (24)  set bit 4 of (de)
	DB	IOCSUB-IOCBAS2           ; SUB 0x1a (28)  res bit 4 of (de)
	DB	IOCES2-IOCBAS2           ; ESC 0x1b (62)  res bit 1 RAM3BUF
	DB	IOCFS2-IOCBAS2           ; FS  0x1c (32)  set bit 1 RAM3BUF
	DB	IOCGS2-IOCBAS2           ; GS  0x1d (56)  set bit 7 RAM3BUF
	DB	IOCRS2-IOCBAS2           ; RS  0x1e (86)  res bit 7 RAM3BUF
	DB	IOCUS2-IOCBAS2           ; US  0x1f (1a)  res bit 3 of MIOBYTE
;;
;; DBLANK
;; fill video ram (2k) with 0's
;
DBLANK:
	LD	HL,$0000        ; was 00FE40 21 00 00
	LD	(RAM0BUF),HL
	XOR	A
	LD	(RAM2BUF),A
;;
;; CRTFIL - Fill video ram with ram buffer chrs
;
CRTFIL:
	LD	A,$EF           ; was 00FE4A 3E EF
	LD	(RAM3BUF),A
	LD	HL,$0000
	LD	(CURPBUF),HL
	CALL	RDRR19R12
CFIL1:	PUSH	HL
	CALL	DISPGR
	POP	HL
	INC	HL
	LD	A,H
	CP	$08
	JR	NZ,CFIL1
	JP	RDRR19R12
;;
;; DISPGR - absolutely the same of DISPGR but takes chars from locs
;; 002a/b/c WHY THIS???
;
DISPGR:
	IN	A,(CRT6545ADST)         ; was 00FE66 DB 8C
	BIT	7,A
	JR	Z,DISPGR
DISPNORTR:
	LD	HL,RAM0BUF
	LD	A,(HL)
	OUT	(CRTRAM0DAT),A
	INC	HL
	LD	A,(HL)
	OUT	(CRTRAM1DAT),A
	INC	HL
	LD	A,(HL)
	OUT	(CRTRAM2DAT),A
	LD	A,(RAM3BUF)
	OUT	(CRTRAM3PORT),A
	XOR	A
	OUT	(CRT6545DATA),A
	RET

;;
; 	nop
; UKR13:	call   GDCUA
; 	push   hl
; 	ld     a,(COLBUF)
; 	push   af
; 	jp     UKR04
; 	nop
; UKR03:	ld     a,($002d)
; 	cp     $a0
; 	ret    nc
; 	ld     b,a
; 	xor    a
; 	bit    7,b
; 	jr     z,UKR05
; 	ld     a,$20
; UKR05:	bit    6,b
; 	jr     z,UKR06
; 	add    a,$10
; UKR06:	bit    5,b
; 	jr     z,UKR07
; 	add    a,$08
; UKR07:	bit    4,b
; 	jr     z,UKR08
; 	add    a,$04
; UKR08:	bit    3,b
; 	jr     z,UKR09
; 	add    a,$02
; UKR09:	bit    2,b
; 	jr     z,UKR10
; 	add    a,$01
; UKR10:	ld     hl,$002f
; 	bit    0,(hl)
; 	jr     z,UKR11
; 	add    a,$28
; UKR11:	ld     (APPBUF),a
; 	ld     a,b
; 	and    $03
; 	ld     e,a
; 	ld     a,($002e)
; 	cp     $95
; 	ret    nc
; 	ld     b,$01
; UKR12:	sub    $06
; 	jr     c,UKR20
; 	inc    b
; 	jr     UKR12
; UKR20:	add    a,$06
; 	ld     d,a
; 	jp     UKR13
; UKR04:	nop
; 	push   de
; 	call   UKR14
; 	pop    de
; 	ld     hl,RAM0BUF
; UKR15:	in     a,(CRT6545ADST)
; 	bit    7,a
; 	jr     z,UKR15
; 	in     a,(CRTRAM0DAT)
; 	ld     (hl),a
; 	inc    hl
; 	in     a,(CRTRAM1DAT)
; 	ld     (hl),a
; 	inc    hl
; 	in     a,(CRTRAM2DAT)
; 	ld     (hl),a
; 	ld     a,(RAM3BUF)
; 	res    4,a
; 	ld     (RAM3BUF),a
; 	ld     hl,RAM0BUF
; 	bit    1,d
; 	jr     z,UKR16
; 	inc    hl
; 	jr     UKR17
; UKR16:	bit    2,d
; 	jr     z,UKR17
; 	inc    hl
; 	inc    hl
; UKR17:	ld     a,e
; 	bit    0,d
; 	jr     z,UKR18
; 	add    a,$04
; UKR18:	rlca
; 	rlca
; 	rlca
; 	ex     de,hl
; 	ld     hl,$002f
; 	bit    1,(hl)
; 	jr     z,UKR21
; 	set    6,a
; UKR21:	or     $86
; 	ld     hl,UR200
; 	push   hl
; 	ld     ($002d),sp
; 	ld     hl,($002d)
; 	dec    hl
; 	ld     (hl),$c9
; 	dec    hl
; 	ld     (hl),a
; 	dec    hl
; 	ld     (hl),$cb
; 	dec    hl
; 	ld     (hl),$eb
; 	jp     (hl)
; ;;
; ;; CIGRTOG - toggle graphic mode on
; ;
; CIGRTOG:
; 	IN	A,(CRT6545ADST)         ; was 00FF40 DB 8C
; 	BIT	7,A
; 	JR	Z,CIGRTOG
; 	IN	A,(CRTRAM3PORT)
; 	SET	4,A
; 	LD	(RAM3BUF),A
; 	IN	A,(CRTRAM0DAT)
; 	POP	HL
; 	POP	HL
; 	RET
;
; 	nop
; 	nop
; 	nop
; 	nop
; 	nop
; 	nop
; 	nop
;;
;; OUTGRBUF - set graphic mode, display RAM[012]BUF and revert to ascii
;
OUTGRBUF:
	CALL	GDCUA           ; was 00FF59 CD B0 F7
	DEC	HL
	LD	A,(RAM3BUF)
	PUSH	AF
	PUSH	HL
	RES	4,A
	LD	(RAM3BUF),A
	CALL	DISPGR
	POP	HL
	POP	AF
	LD	(RAM3BUF),A
	JP	SDCUAE
;
; 	nop
; 	nop
; UR200:
; 	call   DISPGR
; 	pop    af
; 	ld     (COLBUF),a
; 	pop    hl
; 	dec    hl
; 	jp     SDCUAE
; 	call   GDCUA
; 	dec    hl
; 	push   hl
; 	ld     hl,$0000
; UR206:	ld     b,$19
; 	push   bc
; 	ld     b,$50
; UR205:	call   SDCUAE
; UR201:	in     a,(CRT6545ADST)
; 	bit    7,a
; 	jr     z,UR201
; 	in     a,(CRTRAM3PORT)
; 	bit    4,a
; 	jr     nz,UR202
; UR204:	ld     a,$20
; 	jr     UR203
; UR202:	in     a,(CRTRAM0DAT)
; 	cp     $20
; 	jr     c,UR204
; UR203:	call   PRNCHR
; 	call   GDCUA
; 	djnz   UR205
; 	ld     a,$0d
; 	call   PRNCHR
; 	ld     a,$0a
; 	call   PRNCHR
; 	pop    bc
; 	djnz   UR206
; 	pop    hl
; 	jp     SDCUAE
; 	nop
;;
;; UKROUT - unknow routine probably related to graphic output
;; wiped out for now....
;
; UKROUT:
; 	push   de
; 	ld     e,(hl)
; 	inc    hl
; 	ld     d,(hl)
; 	ld     hl,$00a0
; 	ex     de,hl
; 	xor    a
; 	ld     a,$01
; 	sbc    hl,de
; 	jr     nc,UKR01
; 	add    hl,de
; 	dec    a
; UKR01:	ld     ($002f),a
; 	ld     a,l
; 	ld     ($002d),a
; 	pop    de
; 	ld     a,(de)
; 	ld     ($002e),a
; 	ld     a,(bc)
; 	bit    0,a
; 	ld     hl,$002f
; 	jr     nz,UKR02
; 	set    1,(hl)
; 	jr     UKR19
; UKR02:	res    1,(hl)
; UKR19:	jp     UKR03
; 	nop
; 	nop

SET3MIOB:
	LD	HL,MIOBYTE		; was 00FFF0 21 47 00
	SET	3,(HL)
	RET
RES3MIOB:
	LD	HL,MIOBYTE		; was 00FFF6 21 47 00
	RES	3,(HL)
	RET
;;
;; Here the routines hard disk management
;;
HDBOOT:
	LD	HL,MNOHD		; still unimplemented...
	CALL	CONSTR
	JP	USRCMD
	;
	;       character i/o handlers
	;	This are moved here from BIOS since we need to keep
	;	space...
	;
MCONIN:
	LD	A,(IOBYTE)		;
	AND	$03			;
	JP	Z,BCONIN		;
	CP	$02			;
	JP	M,BCONIN		;
	JP	Z,NDEVMSG		;
	JP	NDEVMSG			;
MCONOUT:
	LD	A,(IOBYTE)		;
	AND	$03			;
	JP	Z,BCONOUT		;
	CP	$02			;
	JP	M,BCONOUT		;
	JP	Z,NDEVMSG		;
	JP	NDEVMSG			;
MCONST:
	LD	A,(IOBYTE)		;
	AND	$03			;
	JP	Z,BCONST		;
	CP	$02			;
	JP	M,BCONST		;
	JP	Z,NDEVMSG		;
	JP	NDEVMSG			;
MCBLIST:
	LD	A,(IOBYTE)		;
	AND	$C0			;
	JP	Z,BCONOUT		;
	CP	$80			;
	JP	M,BCONOUT		;
	JP	Z,PRNCHR		;
	JP	NDEVMSG			;
MLISTST:
	LD	A,(IOBYTE)		;
	AND	$C0			;
	JP	Z,BCONST		;
	CP	$80			;
	JP	M,BCONST		;
	JP	Z,HLISTST		;
	JP	NDEVMSG			;
MPUNCH:
	LD	A,(IOBYTE)		;
	AND	$30			;
	JP	Z,BCONOUT		;
	CP	$20			;
	RET	M			;
	JP	Z,NDEVMSG		;
	JP	NDEVMSG			;

MREADER:
	LD	A,(IOBYTE)		;
	AND	$0C			;
	JP	Z,BCONIN		;
	CP	$08			;
	JP	M,NULFN2		;
	JP	Z,NDEVMSG		;
	JP	NDEVMSG			;
	; Test printer busy status
HLISTST:
	IN	A,(CRTSERVDAT)		;
	BIT	PRNTBUSYBIT,A		;
	LD	A,$00			;
	RET	NZ			;
	CPL				;
	RET				;
	;
NULFN2:	LD	A,$1A			;
	RET				;
	; Display a no device message
NDEVMSG:
	XOR	A			;
	LD	(IOBYTE),A		; reset IOBYTE
	LD	HL,MSNODEV		; load msg
	CALL	CONSTR			; display
	CALL	BCONIN			; wait for user...
	JP	$0000			; do a WBOOT
	;
MSNODEV:				;
	DEFB	CR,LF,"*NO DEVIC",'E'+$80


MNOHD:	DEFB	CR,LF,"NO HARD DISK!",CR,LF+$80
;;
;; DIV16 - 16 BY 16 BIT DIVISION
;;
;; in BC = dividend
;; in DE = divisor
;; ----
;; out BC = quotient
;; out HL = remainder
DIV16:	LD	A,B
	LD	B,16
	LD	HL,0
DIVLO:	RL	C
	RLA
	ADC	HL,HL
	SBC	HL,DE
	JR	NC,$+3
	ADD	HL,DE
	CCF
	DJNZ	DIVLO
	RL	C
	RLA
	LD	B,A
	RET
;;
;;	TRANSK - calculate skew factor on-the-fly
;;
;; input	E = current sec
;;	 	C = # secs/track
;; output 	A = trans. sec
TRANSK:	INC	C		; need for comparison
	LD	B,E		; init B as sec. counter
	LD	A,1		; start #
TRASK1:	DEC	B		; end ?
	RET	Z		; yes
	ADD	A,6		; apply skew factor
	CP	C		; # overflow ?
	JR	C,TRASK1	; no: next
	SUB	C		; correct to lowest
	INC	A		; done
	CP	1		; overflow ?
	JR	NZ,TRASK1	; no, next
	INC	A		; yes, adjust
	JR	TRASK1		; next


;;
;;	MUL16 - 16x16 bit multiplication
;;
;; 	in  DE = multiplicand
;;	    BC = multiplier
;;	out HL = result
MUL16:	LD	A,C		; A = low mpler
	LD	C,B		; C = high mpler
	LD	B,16		; counter
	LD	HL,0
ML1601:	SRL	C		; right shift mpr high
	RRA			; rot. right mpr low
	JR	NC,ML1602	; test carry
	ADD	HL,DE		; add mpd to result
ML1602:	EX	DE,HL
	ADD	HL,HL		; double shift mpd
	EX	DE,HL
	DJNZ	ML1601
	RET
;;
;;	OFFCAL - apply a read skew factor to sequential written
;;	         floppies. Used by bootloader and CP/M WBOOT.
;;
;;	in   E = current sector counter
OFFCAL:
	LD	C,(IX+0)	; loads sec./track
	CALL	TRANSK		; trans. sec. (in A)
	LD	(FSECBUF),A	; directly sets sector (no more then 255 secs/track !!)
	PUSH	DE		; saves DE
	LD	E,A		; now E has trans. value
	LD	A,(FTRKBUF)	; load track, no more than 255 system tracks !!
	LD	B,A		; counter
	OR	A		; zero ?
	JR	Z,OFFZER	; no
OFFGTZ:	XOR	A		; clear
OFFGT1:	ADD	A,(IX+0)	; shift index one track
	DJNZ	OFFGT1		; next
	ADD	A,E		; add sec. index
	LD	E,A		; reload on E
OFFZER: DEC	E		; correct index to zero base
	DEC	E
	LD	D,0		; DE now is dma offset
	PUSH	HL		; save base
	LD	C,(IX+2)	; sector len in BC
	LD	B,(IX+3)
	CALL	MUL16		; calc relative offset (sec len x offset)
	EX	DE,HL		; move result (rel.offset) in DE
	POP	HL		; restore base address
	PUSH	HL		; re-save
	ADD	HL,DE		; calc final address
	LD	(FRDPBUF),HL	; apply dma
	POP	HL		; re-restore base address
	POP	DE		; restore secs counters
	RET

EPFILL:
	DEFS	JBOOT + $0FFF - EPFILL + 1
;;
;; end of monitor code - this will fill with zeroes to the end of
;; the eprom

;
WSYM darkstar.sym
;
;
