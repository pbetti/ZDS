;
;
; Z80 Nuova Elettronica Monitor 390 su eprom 2532 (4k)
;
; Disassemblato e ricostruito da Piergiorgio Betti <pbetti@lpconsul.net>
; 2005 01 26


; Defines for the i/o ports
;
; *** LX529 VIDEO BOARD:
CRTBASE		equ	$80
	; RAM0 for ascii chars & semi6. Combined with RAM1 and RAM2 for graphics
CRTRAM0DAT	equ	CRTBASE		; RAM0 access: PIO0 port A data register
CRTRAM0CNT	equ	CRTBASE+2	; RAM0 access: PIO0 port A control register
	; Printer port
CRTPRNTDAT	equ	CRTBASE+1	; PRINTER (output): PIO0 port B data register
CRTPRNTCNT	equ	CRTBASE+3	; PRINTER (output): PIO0 port B control register
					; STROBE is generated by hardware
	; RAM1 for graphics. (pixel index by RAM0+RAM1+RAM2)
CRTRAM1DAT	equ	CRTBASE+4	; RAM1 access: PIO1 port A data register
CRTRAM1CNT	equ	CRTBASE+6	; RAM1 access: PIO1 port A control register
	; Keyboard port (negated). Bit 7 is for strobe
CRTKEYBDAT	equ	CRTBASE+5	; KEYBOARD (input): PIO1 port B data register
CRTKEYBCNT	equ	CRTBASE+7	; KEYBOARD (input): PIO1 port B control register
KEYBSTRBBIT	equ	7		; Strobe bit
	; RAM2 for graphics. (pixel index by RAM0+RAM1+RAM2)
CRTRAM2DAT	equ	CRTBASE+8	; RAM2 access: PIO2 port A data register
CRTRAM2CNT	equ	CRTBASE+10	; RAM2 access: PIO2 port A control register
	; Service/User port
CRTSERVDAT	equ	CRTBASE+9	; Service (i/o): PIO2 port B data register
CRTSERVCNT	equ	CRTBASE+11	; Service (i/o): PIO2 port B control register
PRNTBUSYBIT	equ	0		; Printer BUSY bit
CRTWIDTHBIT	equ	1		; Set 40/80 chars per line
					; Other bits available to user
	; RAM3 control chars/graphics attributes
CRTRAM3PORT	equ	CRTBASE+14	; RAM3 port
CRTBLINKBIT	equ	0		; Blink
CRTREVRSBIT	equ	1		; Reverse
CRTUNDERBIT	equ	2		; Underline
CRTHILITBIT	equ	3		; Highlight
CRTMODEBIT	equ	4		; ASCII/GRAPHIC mode
	; Beeper port
CRTBEEPPORT	equ	CRTBASE+15	; Beeper port
	; 6545 CRT controller ports
CRT6545ADST	equ	CRTBASE+12	; Address & Status register
CRT6545DATA	equ	CRTBASE+13	; Data register
;
; *** LX390 FDC CONTROLLER:
FDCBASE	equ	$d0
FDCCMDSTATR	equ	FDCBASE		; Command and status register
FDCTRAKREG	equ	FDCBASE+1	; Track register
FDCSECTREG	equ	FDCBASE+2	; Sector register
FDCDATAREG	equ	FDCBASE+7	; Data register *** Verificare che sia $d7
FDCDRVRCNT	equ	FDCBASE+6	; Driver select/control register
FSECLEN		equ	$80		; 128 bytes sector
FRWWORD		equ	((FSECLEN * $100) + FDCDATAREG) ; $80d7 in other words
;
; alternate printer port
ALTPRNPRT	equ	$03
; Ram addresses labels
KBDBYTE		equ	$0026
CIOBYTE		equ	$0027
COLBUF		equ	$0029
RAM3BUF		equ	$0028
RAM0BUF		equ	$002a
RAM1BUF		equ	$002b
RAM2BUF		equ	$002c
MIOBYTE		equ	$0047
CURPBUF		equ	$0048
CURPBUFH	equ	$0049
GRAM0BUF	equ	$3040
GRAM1BUF	equ	$3041
GRAM2BUF	equ	$3042
GRAM3BUF	equ	$3043
CRTTABUF	equ	$0010
FCMDBUF		equ	$0043
FSTABUF		equ	$0044
FTRKBUF		equ	$004a
FRDPBUF		equ	$0045
FSECBUF		equ	$0042
FDRVBUF		equ	$0040
FNTRBUF		equ	$0041

;
; aliases
IOCACK		equ	INICRTCUR
IOCVT		equ	CHOME
IOCFF		equ	CLRSCR
IOCSI		equ	CLREOL
IOCDC1		equ	RESATTR
IOCDC4		equ	LINDN

	org $f000

JBOOT:	jp     BOOT            ; 00F000 C3 30 F6	- BOOT
JCONIN:	jp     CONIN           ; 00F003 C3 66 F8	- WBOOT
JCONOU:	jp     CONOUT           ; 00F006 C3 10 FB	- CONST
JMTRK0:	jp     MTRAK0           ; 00F009 C3 C2 F4	- CONIN
JCURTR:	jp     ICURTRBUF           ; 00F00C C3 98 F4	- CONOUT
JNXTTR:	jp     INXTTRBUF           ; 00F00F C3 89 F4	- LIST
JSECBF:	jp     SAVSECBUF           ; 00F012 C3 8E F4	- PUNCH
JREADB:	jp     INIRDPBUF           ; 00F015 C3 93 F4	- READER
JREADS:	jp     FREADSEC           ; 00F018 C3 0D F5	- HOME
JWRITS:	jp     FWRITSEC           ; 00F01B C3 14 F5	- SELDSK
JFSTAT:	jp     GFDCSTAT           ; 00F01E C3 AF F4	- SETTRK
JFDCMD:	jp     SFDCCMD           ; 00F021 C3 9D F4	- SETSEC
JTRKOF:	jp     FTRKOFF           ; 00F024 C3 B9 F4	- SETDMA
JFSEEK:	jp     FSEEK           ; 00F027 C3 DC F4	- READ
JDRVSL:	jp     DRVSEL           ; 00F02A C3 50 F4	- WRITE
JDISPN:	jp     DISPNORTR           ; 00F02D C3 6C FE	- LISTST
JUSRCM:	jp     UCREJ           ; 00F030 C3 FD F6	- SECTRAN
;; Questi *DOVREBBERO* essere i 17 entry point del CPM
;; ... ma non lo sono....
JCPMBO:	jp     CPMBOOT           ; 00F033 C3 61 F4
JGETHN:	jp     GETHNUM           ; 00F036 C3 DE F6
JCHKKB:	jp     CHKKBD           ; 00F039 C3 B9 FA
JPRNCH:	jp     PRNCHR           ; 00F03C C3 75 FA
;	what is this?
	jp     UKROUT           ; 00F03F C3 C0 FF
	nop                    ; 00F042 00
	nop                    ; 00F043 00
;;
;; DISPGR - Display a full graphic char frpm GRAMBUF
;
DISPGR:
	in     a,(CRT6545ADST)         ; 00F044 DB 8C
	bit    7,a             ; 00F046 CB 7F
	jr     z,DISPGR         ; 00F048 28 FA
	ld     hl,GRAM0BUF        ; 00F04A 21 40 30
	ld     a,(hl)          ; 00F04D 7E
	out    (CRTRAM0DAT),a         ; 00F04E D3 80
	inc    hl              ; 00F050 23
	ld     a,(hl)          ; 00F051 7E
	out    (CRTRAM1DAT),a         ; 00F052 D3 84
	inc    hl              ; 00F054 23
	ld     a,(hl)          ; 00F055 7E
	out    (CRTRAM2DAT),a         ; 00F056 D3 88
	inc    hl              ; 00F058 23
	ld     a,(hl)          ; 00F059 7E
	out    (CRTRAM3PORT),a         ; 00F05A D3 8E
	xor    a               ; 00F05C AF
	out    (CRT6545DATA),a         ; 00F05D D3 8D
	ret                    ; 00F05F C9
;;
;; SET DISPLAY CURSOR ADDRESS EXTENDED
;; I'm unable to map 6545 (nor 6845) register $12 and $13
;; since register range is R0-R17 ($0-$11)
;
SDCUAE:
	ld     a,$0e           ; 00F060 3E 0E
	out    (CRT6545ADST),a         ; 00F062 D3 8C
	ld     a,h             ; 00F064 7C
	out    (CRT6545DATA),a         ; 00F065 D3 8D
	ld     a,$0f           ; 00F067 3E 0F
	out    (CRT6545ADST),a         ; 00F069 D3 8C
	ld     a,l             ; 00F06B 7D
	out    (CRT6545DATA),a         ; 00F06C D3 8D
SDCUAE1:
	ld     a,$12           ; 00F06E 3E 12
	out    (CRT6545ADST),a         ; 00F070 D3 8C
	ld     a,h             ; 00F072 7C
	out    (CRT6545DATA),a         ; 00F073 D3 8D
	ld     a,$13           ; 00F075 3E 13
	out    (CRT6545ADST),a         ; 00F077 D3 8C
	ld     a,l             ; 00F079 7D
	out    (CRT6545DATA),a         ; 00F07A D3 8D
	jr     CRTPRGEND           ; 00F07C 18 08
;;
;; SCUROF - turn off cursor
;
SCUROF:
	ld     a,$0a           ; 00F07E 3E 0A
	out    (CRT6545ADST),a         ; 00F080 D3 8C
	ld     a,$20           ; 00F082 3E 20
	out    (CRT6545DATA),a         ; 00F084 D3 8D
;;
;; CRTPRGEND
;; resets 6545 register pointer
;
CRTPRGEND:
	ld     a,$1f           ; 00F086 3E 1F
	out    (CRT6545ADST),a         ; 00F088 D3 8C
	ret                    ; 00F08A C9
;;
;; SCURON - turn on cursor
;
SCURON:
	ld     a,$0a           ; 00F08B 3E 0A
	out    (CRT6545ADST),a         ; 00F08D D3 8C
	xor    a               ; 00F08F AF
	out    (CRT6545DATA),a         ; 00F090 D3 8D
	jr     CRTPRGEND           ; 00F092 18 F2
;;
;; GETKBD - wait for a key and return in A
;
GETKBD:
		; wait for strobe clean
	in     a,(CRTKEYBDAT)         ; 00F094 DB 85
	cpl                    ; 00F096 2F
	bit    7,a             ; 00F097 CB 7F
	jr     nz,GETKBD        ; 00F099 20 F9
		; wait for keypress
GKLP0:	in     a,(CRTKEYBDAT)         ; 00F09B DB 85
	cpl                    ; 00F09D 2F
	bit    7,a             ; 00F09E CB 7F
	jr     z,GKLP0         ; 00F0A0 28 F9
	and    $7f             ; 00F0A2 E6 7F
	ret                    ; 00F0A4 C9
;;
;; INICRT - should be
;
INICRT:
	in     a,(CRTSERVDAT)         ; 00F0A5 DB 89
	res    1,a             ; 00F0A7 Modo 40/80 colonne (80)
	ld     hl,CRTTAB        ; 00F0A9 21 F5 F2
	out    (CRTSERVDAT),a         ; 00F0AC D3 89
	ld     a,$8f           ; 00F0AE 3E 8F
	out    (CRTRAM0CNT),a         ; 00F0B0 D3 82
	out    (CRTRAM1CNT),a         ; 00F0B2 D3 86
	out    (CRTRAM2CNT),a         ; 00F0B4 D3 8A
	ld     a,$cf           ; 00F0B6 3E CF
	out    (CRTPRNTCNT),a         ; 00F0B8 D3 83
	ex     af,af'          ; 00F0BA 08
	xor    a               ; 00F0BB AF
	out    (CRTPRNTCNT),a         ; 00F0BC D3 83
	ex     af,af'          ; 00F0BE 08
	out    (CRTKEYBCNT),a         ; 00F0BF D3 87
	ex     af,af'          ; 00F0C1 08
	dec    a               ; 00F0C2 3D
	out    (CRTKEYBCNT),a         ; 00F0C3 D3 87
	ex     af,af'          ; 00F0C5 08
	out    (CRTSERVCNT),a         ; 00F0C6 D3 8B
	ld     a,$f1           ; 00F0C8 3E F1
	out    (CRTSERVCNT),a         ; 00F0CA D3 8B
SDRR11R0:
	ld     b,$0c           ; 00F0CC 06 0C
ICLP0:	ld     a,b             ; 00F0CE 78
	dec    a               ; 00F0CF 3D
	out    (CRT6545ADST),a         ; 00F0D0 D3 8C
	ld     a,(hl)          ; 00F0D2 7E
	out    (CRT6545DATA),a         ; 00F0D3 D3 8D
	inc    hl              ; 00F0D5 23
	djnz   ICLP0           ; 00F0D6 10 F6
RDRR19R12:
	ld     b,$08           ; 00F0D8 06 08
ICLP1:	ld     a,b             ; 00F0DA 78
	add    a,$0b           ; 00F0DB C6 0B
	out    (CRT6545ADST),a         ; 00F0DD D3 8C
	xor    a               ; 00F0DF AF
	out    (CRT6545DATA),a         ; 00F0E0 D3 8D
	djnz   ICLP1           ; 00F0E2 10 F6
	jp     CRTPRGEND           ; 00F0E4 C3 86 F0
;;
;; CLRSCRGR - Clear screen (80x24)
;
CLRSCRGR:
	call   SCUROF           ; 00F0E7 CD 7E F0
	ld     hl,$0020        ; 00F0EA 21 20 00
	ld     (GRAM0BUF),hl      ; 00F0ED 22 40 30
	ld     hl,$ff00        ; 00F0F0 21 00 FF
	ld     (GRAM2BUF),hl      ; 00F0F3 22 42 30
	call   RDRR19R12           ; 00F0F6 CD D8 F0
	ld     hl,$0000        ; 00F0F9 21 00 00
CSGLP0:	ld     a,(GRAM0BUF)       ; 00F0FC 3A 40 30
	call   DISPGRCH           ; 00F0FF CD 13 F1
	inc    hl              ; 00F102 23
	ld     a,h             ; 00F103 7C
	cp     $07             ; 00F104 FE 07
	jr     nz,CSGLP0        ; 00F106 20 F4
	ld     a,l             ; 00F108 7D
	cp     $80             ; 00F109 FE 80
	jr     nz,CSGLP0        ; 00F10B 20 EF
	call   RDRR19R12           ; 00F10D CD D8 F0
	jp     SCURON           ; 00F110 C3 8B F0
;;
;; DISPGRCH - Display a char (from A reg.) atrributed from GRAM3BUF
;
DISPGRCH:
	push   af              ; 00F113 F5
DGCLP0:	in     a,(CRT6545ADST)         ; 00F114 DB 8C
	bit    7,a             ; 00F116 CB 7F
	jr     z,DGCLP0         ; 00F118 28 FA
	pop    af              ; 00F11A F1
	out    (CRTRAM0DAT),a         ; 00F11B D3 80
	ld     a,(GRAM3BUF)       ; 00F11D 3A 43 30
	out    (CRTRAM3PORT),a         ; 00F120 D3 8E
	xor    a               ; 00F122 AF
	out    (CRT6545DATA),a         ; 00F123 D3 8D
	ret                    ; 00F125 C9
;;
;; FILVRAMG - Fill the video ram in graphic mode (from GRAMBUF)
;
FILVRAMG:
	ld     hl,$0000        ; 00F126 21 00 00
	call   RDRR19R12           ; 00F129 CD D8 F0
FVLP0:	push   hl              ; 00F12C E5
	call   DISPGR           ; 00F12D CD 44 F0
	pop    hl              ; 00F130 E1
	inc    hl              ; 00F131 23
	ld     a,h             ; 00F132 7C
	cp     $07             ; 00F133 FE 07
	jr     nz,FVLP0        ; 00F135 20 F5
	ld     a,l             ; 00F137 7D
	cp     $80             ; 00F138 FE 80
	jr     nz,FVLP0        ; 00F13A 20 F0
	ret                    ; 00F13C C9
;;
;; NEDOSCR - NEDOS boot screen
;
NEDOSCR:
	call   CLRSCRGR           ; 00F13D CD E7 F0
	ld     hl,STR005        ; 00F140 21 56 F3
	call   DISPSTR           ; 00F143 CD E1 F2
	ld     hl,STR006        ; 00F146 21 75 F3
	call   DISPSTR           ; 00F149 CD E1 F2
	ld     hl,STR007        ; 00F14C 21 A4 F3
	call   DISPSTR           ; 00F14F CD E1 F2
NDSLP3:	ld     a,$ff           ; 00F152 3E FF
	ld     (GRAM3BUF),a       ; 00F154 32 43 30
	ld     hl,STR009        ; 00F157 21 D3 F3
	call   DISPSTR           ; 00F15A CD E1 F2
	ld     hl,$0526        ; 00F15D 21 26 05
	call   SDCUAE           ; 00F160 CD 60 F0
	call   GETKBD           ; 00F163 CD 94 F0
	ld     hl,(STR008)      ; 00F166 2A B6 F3
	push   hl              ; 00F169 E5
	call   SDCUAE           ; 00F16A CD 60 F0
	pop    hl              ; 00F16D E1
	; blank str008 space
	ld     b,$1a           ; 00F16E 06 1A
NDSLP0:	ld     a,$20           ; 00F170 3E 20
	call   DISPGRCH           ; 00F172 CD 13 F1
	djnz   NDSLP0           ; 00F175 10 F9
	ld     hl,$0526        ; 00F177 21 26 05
	call   SDCUAE           ; 00F17A CD 60 F0
	xor    a               ; 00F17D AF
	out    (FDCDRVRCNT),a         ; 00F17E D3 D6
	out    (FDCCMDSTATR),a         ; 00F180 D3 D0
NDSLP2:
	ex     (sp),hl         ; 00F182 E3
	ex     (sp),hl         ; 00F183 E3
	in     a,(FDCCMDSTATR)         ; 00F184 DB D0
	bit    1,a             ; 00F186 CB 4F
	jr     z,NDSLP1         ; 00F188 28 06
	ld     a,FDCCMDSTATR           ; 00F18A 3E D0
	out    (FDCCMDSTATR),a         ; 00F18C D3 D0
	jr     NDSLP2           ; 00F18E 18 F2
NDSLP1:
	ld     hl,$0000        ; 00F190 21 00 00
	ld     ($9000),hl      ; 00F193 22 00 90
	ld     hl,$1500        ; 00F196 21 00 15
	ld     ($9002),hl      ; 00F199 22 02 90
	ld     a,$01           ; 00F19C 3E 01
	out    (FDCDRVRCNT),a         ; 00F19E D3 D6
	ld     b,$05           ; 00F1A0 06 05
NDSJ1:	ld     a,$0b           ; 00F1A2 3E 0B
	out    (FDCCMDSTATR),a         ; 00F1A4 D3 D0
	ex     (sp),hl         ; 00F1A6 E3
	ex     (sp),hl         ; 00F1A7 E3
	djnz   NDSJ1           ; 00F1A8 10 F8
NDSJ2:	in     a,(FDCCMDSTATR)         ; 00F1AA DB D0
	bit    0,a             ; 00F1AC CB 47
	jr     nz,NDSJ2        ; 00F1AE 20 FA
NDSJ5:	ld     de,($9002)      ; 00F1B0 ED 5B 02 90
	ld     hl,($9000)      ; 00F1B4 2A 00 90
	call   NDSRDSEC           ; 00F1B7 CD F5 F1
	ld     a,($9002)       ; 00F1BA 3A 02 90
	inc    a               ; 00F1BD 3C
	cp     $0a             ; 00F1BE FE 0A
	jr     nz,NDSJ3        ; 00F1C0 20 08
	ld     a,($9003)       ; 00F1C2 3A 03 90
	inc    a               ; 00F1C5 3C
	ld     ($9003),a       ; 00F1C6 32 03 90
	xor    a               ; 00F1C9 AF
NDSJ3:	ld     ($9002),a       ; 00F1CA 32 02 90
	dec    hl              ; 00F1CD 2B
	ld     a,(hl)          ; 00F1CE 7E
	ld     ($9001),a       ; 00F1CF 32 01 90
	dec    hl              ; 00F1D2 2B
	ld     a,(hl)          ; 00F1D3 7E
	ld     ($9000),a       ; 00F1D4 32 00 90
	dec    hl              ; 00F1D7 2B
	ld     a,(hl)          ; 00F1D8 7E
	cp     $01             ; 00F1D9 FE 01
	jr     nz,NDSJ4        ; 00F1DB 20 07
	dec    hl              ; 00F1DD 2B
	ld     a,(hl)          ; 00F1DE 7E
	cp     $01             ; 00F1DF FE 01
	jr     z,NDSJ5         ; 00F1E1 28 CD
	rst    00h             ; 00F1E3 C7
NDSJ4:	ld     hl,STR008        ; 00F1E4 21 B6 F3
	xor    a               ; 00F1E7 AF
	out    (FDCDRVRCNT),a         ; 00F1E8 D3 D6
	ld     a,$f0           ; 00F1EA 3E F0
	ld     (GRAM3BUF),a       ; 00F1EC 32 43 30
	call   DISPSTR           ; 00F1EF CD E1 F2
	jp     NDSLP3           ; 00F1F2 C3 52 F1
;;
NDSRDSEC:
	ld     a,e             ; 00F1F5 7B
	out    (FDCSECTREG),a         ; 00F1F6 D3 D2
	ld     a,d             ; 00F1F8 7A
	out    (FDCDATAREG),a         ; 00F1F9 D3 D7
	ld     a,$1a           ; 00F1FB 3E 1A
	out    (FDCCMDSTATR),a         ; 00F1FD D3 D0
	ex     (sp),hl         ; 00F1FF E3
	ex     (sp),hl         ; 00F200 E3
NRD1:	in     a,(FDCCMDSTATR)         ; 00F201 DB D0
	rrca                   ; 00F203 0F
	jr     c,NRD1         ; 00F204 38 FB
	ld     a,$88           ; 00F206 3E 88
	out    (FDCCMDSTATR),a         ; 00F208 D3 D0
	push   bc              ; 00F20A C5
	pop    bc              ; 00F20B C1
	jr     NRD2           ; 00F20C 18 03
NRD4:	rrca                   ; 00F20E 0F
	jr     nc,NRD3        ; 00F20F 30 0C
NRD2:	in     a,(FDCCMDSTATR)         ; 00F211 DB D0
	bit    1,a             ; 00F213 CB 4F
	jr     z,NRD4         ; 00F215 28 F7
	in     a,(FDCDATAREG)         ; 00F217 DB D7
	ld     (hl),a          ; 00F219 77
	inc    hl              ; 00F21A 23
	jr     NRD2           ; 00F21B 18 F4
NRD3:	in     a,(FDCCMDSTATR)         ; 00F21D DB D0
	and    $5c             ; 00F21F E6 5C
	ret    z               ; 00F221 C8
	ld     a,FDCCMDSTATR           ; 00F222 3E D0
	out    (FDCCMDSTATR),a         ; 00F224 D3 D0
	ret                    ; 00F226 C9
;;
;; NDSHW - test video hardware for nedos
NDSHW:
	ld     hl,$7f00        ; 00F227 21 00 7F
	ld     ($9006),hl      ; 00F22A 22 06 90
	xor    a               ; 00F22D AF
	ex     af,af'          ; 00F22E 08
	ld     hl,$ffff        ; 00F22F 21 FF FF
	ld     (GRAM0BUF),hl      ; 00F232 22 40 30
	ld     hl,$efff        ; 00F235 21 FF EF
	ld     (GRAM2BUF),hl      ; 00F238 22 42 30
	call   FILVRAMG           ; 00F23B CD 26 F1
	call   RDRR19R12           ; 00F23E CD D8 F0
	ld     hl,$0780        ; 00F241 21 80 07
NDH1:	in     a,(CRT6545ADST)         ; 00F244 DB 8C
	bit    7,a             ; 00F246 CB 7F
	jr     z,NDH1         ; 00F248 28 FA
	in     a,(CRTRAM0DAT)         ; 00F24A DB 80
	inc    a               ; 00F24C 3C
	jr     nz,NDH2        ; 00F24D 20 0A
	in     a,(CRTRAM1DAT)         ; 00F24F DB 84
	inc    a               ; 00F251 3C
	jr     nz,NDH2        ; 00F252 20 05
	in     a,(CRTRAM2DAT)         ; 00F254 DB 88
	inc    a               ; 00F256 3C
	jr     z,NDH3         ; 00F257 28 15
NDH2:	ld     ($9004),sp      ; 00F259 ED 73 04 90
	ld     sp,($9006)      ; 00F25D ED 7B 06 90
	push   hl              ; 00F261 E5
	ld     ($9006),sp      ; 00F262 ED 73 06 90
	ld     sp,($9004)      ; 00F266 ED 7B 04 90
	ex     af,af'          ; 00F26A 08
	ld     a,$01           ; 00F26B 3E 01
	ex     af,af'          ; 00F26D 08
NDH3:	dec    hl              ; 00F26E 2B
	xor    a               ; 00F26F AF
	out    (CRT6545DATA),a         ; 00F270 D3 8D
	ld     a,h             ; 00F272 7C
	or     l               ; 00F273 B5
	jr     nz,NDH1        ; 00F274 20 CE
	call   RDRR19R12           ; 00F276 CD D8 F0
	ex     af,af'          ; 00F279 08
	or     a               ; 00F27A B7
	jr     z,NDH4         ; 00F27B 28 61
	call   CLRSCRGR           ; 00F27D CD E7 F0
	ld     hl,STR010        ; 00F280 21 D9 F3
	call   DISPSTR           ; 00F283 CD E1 F2
	ld     hl,$0140        ; 00F286 21 40 01
	call   SDCUAE           ; 00F289 CD 60 F0
	ld     ($9004),sp      ; 00F28C ED 73 04 90
NDH7:	ld     a,$20           ; 00F290 3E 20
	call   DISPGRCH           ; 00F292 CD 13 F1
	ld     sp,($9006)      ; 00F295 ED 7B 06 90
	pop    hl              ; 00F299 E1
	ld     ($9006),sp      ; 00F29A ED 73 06 90
	ld     a,h             ; 00F29E 7C
	add    a,$30           ; 00F29F C6 30
	call   DISPGRCH           ; 00F2A1 CD 13 F1
	ld     h,$00           ; 00F2A4 26 00
	add    hl,hl           ; 00F2A6 29
	add    hl,hl           ; 00F2A7 29
	add    hl,hl           ; 00F2A8 29
	add    hl,hl           ; 00F2A9 29
	ld     a,h             ; 00F2AA 7C
	cp     $0a             ; 00F2AB FE 0A
	jr     c,NDH5         ; 00F2AD 38 02
	add    a,$07           ; 00F2AF C6 07
NDH5:	add    a,$30           ; 00F2B1 C6 30
	call   DISPGRCH           ; 00F2B3 CD 13 F1
	or     a               ; 00F2B6 B7
	ld     a,l             ; 00F2B7 7D
	rra                    ; 00F2B8 1F
	rra                    ; 00F2B9 1F
	rra                    ; 00F2BA 1F
	rra                    ; 00F2BB 1F
	cp     $0a             ; 00F2BC FE 0A
	jr     c,NDH6         ; 00F2BE 38 02
	add    a,$07           ; 00F2C0 C6 07
NDH6:	add    a,$30           ; 00F2C2 C6 30
	call   DISPGRCH           ; 00F2C4 CD 13 F1
	ld     a,($9007)       ; 00F2C7 3A 07 90
	cp     $7f             ; 00F2CA FE 7F
	jr     nz,NDH7        ; 00F2CC 20 C2
	ld     sp,($9004)      ; 00F2CE ED 7B 04 90
	ld     hl,STR011        ; 00F2D2 21 E9 F3
	call   DISPSTR           ; 00F2D5 CD E1 F2
	call   SCUROF           ; 00F2D8 CD 7E F0
	call   GETKBD           ; 00F2DB CD 94 F0
NDH4:	jp     CLRSCRGR           ; 00F2DE C3 E7 F0
;;
;; DISPSTR - Display a string of format:
;; R,C,"STRING",$00
;
DISPSTR:
	ld     c,(hl)          ; 00F2E1 4E
	inc    hl              ; 00F2E2 23
	ld     b,(hl)          ; 00F2E3 46
	push   hl              ; 00F2E4 E5
	push   bc              ; 00F2E5 C5
	pop    hl              ; 00F2E6 E1
	call   SDCUAE1           ; 00F2E7 CD 6E F0
	pop    hl              ; 00F2EA E1
DSLP0:	inc    hl              ; 00F2EB 23
	ld     a,(hl)          ; 00F2EC 7E
	cp     $00             ; 00F2ED FE 00
	ret    z               ; 00F2EF C8
	call   DISPGRCH           ; 00F2F0 CD 13 F1
	jr     DSLP0           ; 00F2F3 18 F6
;; CRTTAB - 6545 Register setup values
CRTTAB:                        ; 00F2F5
	db    $0b,$00,$0b,$48
	db    $18,$18,$00,$1a
	db    $28,$57,$50,$6f
;	                       ; 00F2F5 0B
;	                       ; 00F2F6 00
;	                       ; 00F2F7 0B
;	                       ; 00F2F8 48
;	                       ; 00F2F9 18
;	                       ; 00F2FA 18
;	                       ; 00F2FB 00
;	                       ; 00F2FC 1A
;	                       ; 00F2FD 28
;	                       ; 00F2FE 57
;	                       ; 00F2FF 50
;	                       ; 00F300 6F
;;
STR001:                        ; 00F301
	db    $0b,$01
	db    "GRAFIC - MONITOR 1.0",$00
STR002:                        ; 00F318
	db    $04,$02
	db    "type",$00
STR003:                        ; 00F31F
	db    $3a,$03
	db    $22,"ESC",$22," for BOOTSTRAPPING",$00
STR004:                        ; 00F339
        db    $d9,$03
	db    $22,"RETURN",$22," for testing VIDEO",$00
STR005:                        ; 00F356
	db    $08,$01
	db    "BOOTSTRAP Version GRAFIC 1.0",$00
STR006:                        ; 00F375
	db    $9f,$01
	db    "Insert NE-DOS-DISK Version GRAFIC in drive 0",$00
STR007:                        ; 00F3A4
	db    $4e,$02
	db    "then type a key",$00
STR008:                        ; 00F3B6
	db    $89,$03
	db    " No NE-DOS Version GRAFIC ",$00
STR009:                        ; 00F3D3
	db    $25,$05
	db    "> <",$00
STR010:                        ; 00F3D9
	db    $0e,$00
	db    "Errorpoints :",$00
STR011:                        ; 00F3E9
	db    $28,$00
	db    "Please type a key",$00
;;
;;
JNDSTA:	jp     NDOSSTA           ; 00F3FD C3 03 F4
JJNDST:	jp     JNDSTA           ; 00F400 C3 FD F3
NDOSSTA:
	in     a,(CRT6545ADST)         ; 00F403 DB 8C
	xor    a               ; 00F405 AF
	out    (FDCDRVRCNT),a         ; 00F406 D3 D6
	di                     ; 00F408 F3
	ld     sp,$7000        ; 00F409 31 00 70
	call   INICRT           ; 00F40C CD A5 F0
NDST1:	call   NDSHW           ; 00F40F CD 27 F2
	ld     hl,STR001        ; 00F412 21 01 F3
	call   DISPSTR           ; 00F415 CD E1 F2
	ld     hl,STR002        ; 00F418 21 18 F3
	call   DISPSTR           ; 00F41B CD E1 F2
	ld     hl,STR003        ; 00F41E 21 1F F3
	call   DISPSTR           ; 00F421 CD E1 F2
	ld     hl,STR004        ; 00F424 21 39 F3
	call   DISPSTR           ; 00F427 CD E1 F2
	ld     hl,STR009        ; 00F42A 21 D3 F3
	call   DISPSTR           ; 00F42D CD E1 F2
	ld     hl,$0526        ; 00F430 21 26 05
	call   SDCUAE           ; 00F433 CD 60 F0
KBLP0:
	call   GETKBD           ; 00F436 CD 94 F0
	cp     $1b             ; 00F439 FE 1B
	jp     z,NEDOSCR         ; 00F43B CA 3D F1
	cp     $0d             ; 00F43E FE 0D
	jr     z,NDST1         ; 00F440 28 CD
	jr     KBLP0           ; 00F442 18 F2
	nop                    ; 00F444 00
	nop                    ; 00F445 00
	nop                    ; 00F446 00
	nop                    ; 00F447 00
	nop                    ; 00F448 00
	nop                    ; 00F449 00
	nop                    ; 00F44A 00
	nop                    ; 00F44B 00
	nop                    ; 00F44C 00
	nop                    ; 00F44D 00
	nop                    ; 00F44E 00
	nop                    ; 00F44F 00
;;
;; DRVSEL - select drive for r/w ops
;
DRVSEL:
	push   af              ; 00F450 F5
	push   bc              ; 00F451 C5
	ld     a,(FDRVBUF)       ; 00F452 3A 40 00
	inc    a               ; 00F455 3C
	ld     b,a             ; 00F456 47
	xor    a               ; 00F457 AF
	scf                    ; 00F458 37
DSHFT:	rla                    ; 00F459 17
	djnz   DSHFT           ; 00F45A 10 FD
	out    (FDCDRVRCNT),a         ; 00F45C D3 D6
	pop    bc              ; 00F45E C1
	pop    af              ; 00F45F F1
	ret                    ; 00F460 C9
;;
;; CPMBOOT - boostrap cp/m
;
CPMBOOT:
	ld     sp,$0080        ; 00F461 31 80 00
	ld     c,$00           ; 00F464 0E 00
	call   INXTTRBUF       ; 00F466 CD 89 F4
	call   ICURTRBUF       ; 00F469 CD 98 F4
	inc    a               ; 00F46C 3C
	out    (FDCDRVRCNT),a  ; 00F46D D3 D6
	call   MTRAK0          ; 00F46F CD C2 F4
	jp     nz,UCREJ        ; 00F472 C2 FD F6
	ld     bc,$0080        ; read in loader at $0080
	call   INIRDPBUF       ; 00F478 CD 93 F4
	ld     c,$01           ; 00F47B 0E 01
	call   SAVSECBUF       ; 00F47D CD 8E F4
	call   FREADSEC        ; 00F480 CD 0D F5
	jp     nz,UCREJ        ; 00F483 C2 FD F6
	jp     $0080           ; jump to the loader if all ok
INXTTRBUF:
	ld     a,c             ; 00F489 79
	ld     (FNTRBUF),a       ; 00F48A 32 41 00
	ret                    ; 00F48D C9
SAVSECBUF:
	ld     a,c             ; 00F48E 79
	ld     (FSECBUF),a       ; 00F48F 32 42 00
	ret                    ; 00F492 C9
INIRDPBUF:
	ld     (FRDPBUF),bc      ; 00F493 ED 43 45 00
	ret                    ; 00F497 C9
ICURTRBUF:
	ld     a,c             ; 00F498 79
	ld     (FDRVBUF),a       ; 00F499 32 40 00
	ret                    ; 00F49C C9
;;
;; SFDCCMD - send 1771 a command
;
SFDCCMD:
	push   af              ; 00F49D F5
SNDCL:
	in     a,(FDCCMDSTATR)         ; 00F49E DB D0
	bit    0,a             ; check busy
	jr     nz,SNDCL        ; 00F4A2 20 FA
	pop    af              ; 00F4A4 F1
	ld     (FCMDBUF),a       ; 00F4A5 32 43 00
	out    (FDCCMDSTATR),a         ; 00F4A8 D3 D0
	ex     (sp),hl         ; 00F4AA E3
	ex     (sp),hl         ; 00F4AB E3
	ex     (sp),hl         ; 00F4AC E3
	ex     (sp),hl         ; 00F4AD E3
	ret                    ; 00F4AE C9
;;
;; GFDCSTAT - get 1771 status and copy on buffer
;
GFDCSTAT:
	in     a,(FDCCMDSTATR)         ; 00F4AF DB D0
	bit    0,a             ; 00F4B1 CB 47
	jr     nz,GFDCSTAT        ; 00F4B3 20 FA
	ld     (FSTABUF),a       ; 00F4B5 32 44 00
	ret                    ; 00F4B8 C9
;
FTRKOFF:
	ld     hl,FTRKBUF        ; 00F4B9 21 4A 00
	ld     a,(FDRVBUF)       ; 00F4BC 3A 40 00
	add    a,l             ; 00F4BF 85
	ld     l,a             ; 00F4C0 6F
	ret                    ; 00F4C1 C9
;
MTRAK0:
	push   bc              ; 00F4C2 C5
	ld     b,$03           ; number of retries
FRETR0:	ld     a,$07           ; move to trak 0 cmd
	call   SFDCCMD           ; 00F4C7 CD 9D F4
	call   GFDCSTAT           ; 00F4CA CD AF F4
	and    $18             ; check for errors
	jr     z,FOK0         ; go no
	djnz   FRETR0           ; retry
	ld     a,$82           ; 00F4D3 3E 82
	jr     FTERR           ; error handle
FOK0:	call   FTRKOFF           ; proceed
	jr     FGTRK           ; 00F4DA 18 2A
;;
;; FSEEK - seek to specific track/sector
;
FSEEK:
	push   bc              ; 00F4DC C5
	ld     b,$03           ; 00F4DD 06 03
	call   FTRKOFF           ; 00F4DF CD B9 F4
	ld     a,(hl)          ; 00F4E2 7E
	out    (FDCTRAKREG),a         ; 00F4E3 D3 D1
FRETR1:	ld     a,(FSECBUF)       ; 00F4E5 3A 42 00
	out    (FDCSECTREG),a         ; 00F4E8 D3 D2
	ld     a,(FNTRBUF)       ; 00F4EA 3A 41 00
	out    (FDCDATAREG),a         ; 00F4ED D3 D7
	ld     a,$17           ; seek cmd
	call   SFDCCMD           ; 00F4F1 CD 9D F4
	call   GFDCSTAT           ; 00F4F4 CD AF F4
	and    $18             ; 00F4F7 E6 18
	jr     z,FGTRK         ; 00F4F9 28 0B
	call   MTRAK0           ; 00F4FB CD C2 F4
	jr     nz,FTERR        ; 00F4FE 20 09
	djnz   FRETR1           ; 00F500 10 E3
	ld     a,$83           ; 00F502 3E 83
	jr     FTERR           ; 00F504 18 03
FGTRK:	in     a,(FDCTRAKREG)         ; 00F506 DB D1
	ld     (hl),a          ; 00F508 77
FTERR:	pop    bc              ; 00F509 C1
	bit    7,a             ; test if drive not ready
	ret                    ; 00F50C C9
;;
;; FREADSEC - read a sector
;
FREADSEC:
	ld     a,(MIOBYTE)       ; 00F50D 3A 47 00
	set    0,a             ; 00F510 CB C7
	jr     FRWSEC           ; 00F512 18 05
;;
;; FWRITSEC - write a sector
;
FWRITSEC:
	ld     a,(MIOBYTE)       ; 00F514 3A 47 00
	res    0,a             ; 00F517 CB 87
;;
;; FRWSEC - read or write a sector depending on MIOBYTE
;
FRWSEC:
	ld     (MIOBYTE),a       ; 00F519 32 47 00
FRWLP:	call   FSEEK           ; 00F51C CD DC F4
	jr     nz,FSHTM        ; 00F51F 20 4D
	ld     b,$0a           ; 10 retries
FRWNXT:	ld     hl,(FRDPBUF)      ; 00F523 2A 45 00
	push   bc              ; 00F526 C5
	ld     bc,FRWWORD        ; 00F527 01 D7 80
	ld     a,(MIOBYTE)       ; 00F52A 3A 47 00
	bit    0,a             ; 00F52D CB 47
	jr     z,FRWWRO         ; 00F52F 28 11
	ld     a,$88           ; read command
	call   SFDCCMD           ; 00F533 CD 9D F4
FRRDY:	in     a,(FDCCMDSTATR)         ; 00F536 DB D0
	bit    1,a             ; sec found
	jr     z,FRRDY         ; 00F53A 28 FA
	ini                    ; 00F53C ED A2
	jr     nz,FRRDY        ; 00F53E 20 F6
	jr     FWEND           ; 00F540 18 0F
FRWWRO:	ld     a,$a8           ; 00F542 3E A8
	call   SFDCCMD           ; 00F544 CD 9D F4
FWRDY:	in     a,(FDCCMDSTATR)         ; 00F547 DB D0
	bit    1,a             ; 00F549 CB 4F
	jr     z,FWRDY         ; 00F54B 28 FA
	outi                   ; 00F54D ED A3
	jr     nz,FWRDY        ; 00F54F 20 F6
FWEND:	call   GFDCSTAT           ; 00F551 CD AF F4
	pop    bc              ; 00F554 C1
	and    $1f             ; test fo errors
	jr     z,FSHTM         ; 00F557 28 15
	djnz   FRWNXT           ; 00F559 10 C8
	ld     a,(MIOBYTE)       ; 00F55B 3A 47 00
	bit    7,a             ; 00F55E CB 7F
	jr     nz,FSHTM        ; 00F560 20 0C
	set    7,a             ; 00F562 CB FF
	ld     (MIOBYTE),a       ; 00F564 32 47 00
	call   MTRAK0           ; 00F567 CD C2 F4
	jr     nz,FSHTM        ; 00F56A 20 02
	jr     FRWLP           ; 00F56C 18 AE
FSHTM:	push   af              ; 00F56E F5
	xor    a               ; 00F56F AF
	out    (FDCDRVRCNT),a         ; 00F570 D3 D6
	pop    af              ; 00F572 F1
	ret                    ; 00F573 C9
;;
;; FLOPPYREAD - read from given drv,track,sector,ram address
;
FLOPPYREAD:
	ld     a,(MIOBYTE)       ; 00F574 3A 47 00
	set    0,a             ; 00F577 CB C7
	jr     FLOPIO           ; 00F579 18 05
;;
;; FLOPPYWRIT - write to give drv,track.sector,ram address
;
FLOPPYWRIT:
	ld     a,(MIOBYTE)       ; 00F57B 3A 47 00
	res    0,a             ; 00F57E CB 87
FLOPIO:	ld     (MIOBYTE),a       ; 00F580 32 47 00
	ld     b,$04           ; 00F583 06 04
	call   GETHNUM           ; 00F585 CD DE F6
	pop    bc              ; 00F588 C1
	call   INIRDPBUF           ; 00F589 CD 93 F4
	pop    bc              ; 00F58C C1
	call   SAVSECBUF           ; 00F58D CD 8E F4
	pop    bc              ; 00F590 C1
	call   INXTTRBUF           ; 00F591 CD 89 F4
	pop    bc              ; 00F594 C1
	call   ICURTRBUF           ; 00F595 CD 98 F4
	call   DRVSEL           ; 00F598 CD 50 F4
	call   FRWLP           ; 00F59B CD 1C F5
	jp     USRCMD           ; 00F59E C3 03 F7
;; Image to initalize location 0010H; 00F5A1
CRTTAB1:
	db    $6f,$50,$57,$28,$1a,0,$19,$19,$48,$0b
	db    0,$0b,0,0,0,0,0,0,0,0
				; 00F5A1 6F
				; 00F5A2 50
				; 00F5A3 57
				; 00F5A4 28
				; 00F5A5 1A
				; 00F5A6 00
				; 00F5A7 19
				; 00F5A8 19
				; 00F5A9 48
				; 00F5AA 0B
				; 00F5AB 00
				; 00F5AC 0B
				; 00F5AD 00
				; 00F5AE 00
				; 00F5AF 00
				; 00F5B0 00
				; 00F5B1 00
				; 00F5B2 00
				; 00F5B3 00
				; 00F5B4 00
;;
;;
NEDOSINI:
	ld     c,$00           ; 00F5B5 0E 00
	call   JNXTTR           ; 00F5B7 CD 0F F0
	inc    a               ; 00F5BA 3C
	out    (FDCDRVRCNT),a         ; 00F5BB D3 D6
	call   JMTRK0           ; 00F5BD CD 09 F0
	jp     nz,UCREJ        ; 00F5C0 C2 FD F6
	jp     JJNDST           ; 00F5C3 C3 00 F4
	nop                    ; 00F5C6 00
	nop                    ; 00F5C7 00
;;
; INIT0 - init buffers,6545,test vram,clear,leave cursor at home
;
INIT0:
	call   INICRT           ; 00F5C8 CD A5 F0
	call   INICRTREG        ; 00F5CB CD 06 F6
	call   DLIGHT           ; 00F5CE CD 16 FC
	call   DBLANK           ; 00F5D1 CD 40 FE
	ld     a,$ff           ; 00F5D4 3E FF
	ld     (RAM3BUF),a       ; 00F5D6 32 28 00
	ld     hl,$0000        ; 00F5D9 21 00 00
	ld     (CURPBUF),hl      ; 00F5DC 22 48 00
	jp     INICRTCUR           ; 00F5DF C3 39 FC
;;
STR100:                        ; 00F5E2
	db    "ELETTRO design * Monitor V. 1.0x"

;;
CRLFTAB:
	db $0d,$8a,$00,$01
	                       ; 00F602 0D
	                       ; 00F603 8A
	                       ; 00F604 00
	                       ; 00F605 01
;;
;; INICRTREG
;;
INICRTREG:
	call   GDCUA           ; 00F606 CD B0 F7
	push   hl              ; 00F609 E5
	ld     hl,CRTTABUF        ; 00F60A 21 10 00
	ld     b,$00           ; 00F60D 06 00
	ld     a,b             ; 00F60F 78
ICTLP0:	out    (CRT6545ADST),a         ; 00F610 D3 8C
	ld     a,(hl)          ; 00F612 7E
	out    (CRT6545DATA),a         ; 00F613 D3 8D
	inc    hl              ; 00F615 23
	inc    b               ; 00F616 04
	ld     a,b             ; 00F617 78
	cp     $14             ; 00F618 FE 14
	jr     nz,ICTLP0        ; 00F61A 20 F4
	ld     hl,(CURPBUF)      ; 00F61C 2A 48 00
	call   SDSTA           ; 00F61F CD 0E F9
	pop    hl              ; 00F622 E1
	dec    hl              ; 00F623 2B
	jp     SDCUAE           ; 00F624 C3 60 F0
	nop                    ; 00F627 00
	nop                    ; 00F628 00
	nop                    ; 00F629 00
	nop                    ; 00F62A 00
	nop                    ; 00F62B 00
	nop                    ; 00F62C 00
	nop                    ; 00F62D 00
	nop                    ; 00F62E 00
; 	nop                    ; 00F62F 00
BOOT:
	di
	; Reset bios position after reset
	in     a,(FDCDRVRCNT)  ; 00F630 DB D6
	ld     sp,$0080        ; 00F632 31 80 00
	ld     hl,CRTTAB1        ; 00F635 21 A1 F5
	ld     de,CRTTABUF        ; 00F638 11 10 00
	ld     bc,$0014        ; 00F63B 01 14 00
	ldir                   ; 00F63E ED B0
	ld     hl,$0000        ; 00F640 21 00 00
	ld     (CURPBUF),hl      ; 00F643 22 48 00
	xor    a               ; 00F646 AF
	ld     (CIOBYTE),a       ; 00F647 32 27 00
	ld     (COLBUF),a       ; 00F64A 32 29 00
	ld     (MIOBYTE),a       ; 00F64D 32 47 00
	cpl                    ; 00F650 2F
	ld     (RAM3BUF),a       ; 00F651 32 28 00
	call   INIT0           ; 00F654 CD C8 F5
	ld     hl,$ffff        ; 00F657 21 FF FF
	ld     (FTRKBUF),hl      ; 00F65A 22 4A 00
	ld     ($004c),hl      ; 00F65D 22 4C 00
	xor    a               ; 00F660 AF
	out    (CRTPRNTDAT),a         ; 00F661 D3 81
	out    (ALTPRNPRT),a         ; 00F663 D3 03
	cpl                    ; 00F665 2F
	out    (CRTPRNTDAT),a         ; 00F666 D3 81
	out    (ALTPRNPRT),a         ; 00F668 D3 03
	ld     a,$c3           ; 00F66A 3E C3
	ld     ($0008),a       ; 00F66C 32 08 00
	ld     ($0066),a       ; 00F66F 32 66 00
	ld     hl,JBOOT        ; 00F672 21 00 F0
	ld     ($0067),hl      ; 00F675 22 67 00
	ld     sp,BJMP5        ; 00F678 31 A2 F6
	db	$3e
;;
;; FMEMSIZ - cerca l'ultima pagina di memoria disponibile
;
FMEMSIZ:
	push   bc              ; 00F67C C5 !!! NOT EXECUTED IF HERE FROM BOOT
	ld     bc,$ff00        ; 00F67D 01 00 FF
	ld     hl,$ffff        ; 00F680 21 FF FF
BJMP2:
	inc    h               ; 00F683 24
	ld     a,(hl)          ; 00F684 7E
	cpl                    ; 00F685 2F
	ld     (hl),a          ; 00F686 77
	cp     (hl)            ; 00F687 BE
	cpl                    ; 00F688 2F
	ld     (hl),a          ; 00F689 77
	jr     nz,BJMP1        ; 00F68A 20 04
	ld     a,h             ; 00F68C 7C
	cp     b               ; 00F68D B8
	jr     nz,BJMP2        ; 00F68E 20 F3
BJMP1:
	dec    h               ; 00F690 25
	ld     bc,$ffde        ; 00F691 01 DE FF should be a number in 2 compl.
	add    hl,bc           ; 00F694 09
	pop    bc              ; 00F695 C1
	ret                    ; 00F696 C9 !!! GO TO BJMP6 IF HERE FROM BOOT
;;
;; LPAGE - Find ram last page and return in B
LPAGE:
	push   hl              ; 00F697 E5
	call   FMEMSIZ           ; 00F698 CD 7C F6
	ld     a,l             ; 00F69B 7D
	sub    $3d             ; 00F69C D6 3D
	jr     nc,BJMP6        ; 00F69E 30 01
	dec    h               ; 00F6A0 25
BJMP6:
	ld     b,h             ; 00F6A1 44
BJMP5:
	pop    hl              ; 00F6A2 E1
	ret                    ; 00F6A3 C9
;
BJTAB:                         ; 00F6A4
	dw    BJTAB+2         ; ovvero f6a6
;
BJMP3:
	;; copy 29 bytes of bios code from RAMBLK to last page of available ram
	ld     sp,hl           ; 00F6A6 F9
	ld     de,RAMBLK        ; 00F6A7 11 F2 F9
	ex     de,hl           ; 00F6AA EB
	ld     bc,$001d        ; 00F6AB 01 1D 00
	ldir                   ; 00F6AE ED B0
	ld     bc,$0006        ; 00F6B0 01 06 00
	push   de              ; 00F6B3 D5
	pop    hl              ; 00F6B4 E1
	dec    hl              ; 00F6B5 2B
	ldir                   ; 00F6B6 ED B0
	ld     hl,$ffe8        ; 00F6B8 21 E8 FF should be a number in 2 compl.
	add    hl,sp           ; 00F6BB 39
	push   hl              ; 00F6BC E5
	inc    hl              ; 00F6BD 23
	inc    hl              ; 00F6BE 23
	ld     ($0006),hl      ; 00F6BF 22 06 00
	ld     d,$0a           ; 00F6C2 16 0A
BJMP4:
	push   bc              ; 00F6C4 C5
	dec    d               ; 00F6C5 15
	jr     nz,BJMP4        ; 00F6C6 20 FC
	nop                    ; 00F6C8 00
	nop                    ; 00F6C9 00
	nop                    ; 00F6CA 00
	;; print bios greetings
	ld     hl,STR100        ; 00F6CB 21 E2 F5
	call   GREET           ; 00F6CE CD 99 FA
	jr     USRCMD           ; 00F6D1 18 30
;;
GET1HNUM:
	ld     b,$01           ; 00F6D3 06 01
	ld     hl,$0000        ; 00F6D5 21 00 00
	jr     GENTR           ; 00F6D8 18 0A
HEHEX:	jr     nz,UCREJ        ; 00F6DA 20 21
POP1PRM:
	dec    b               ; 00F6DC 05
	ret    z               ; 00F6DD C8
;;
;; GETHNUM - get an hexadecimal string
;
GETHNUM:
	ld     hl,$0000        ; 00F6DE 21 00 00
GNXTC:	call   DOGETCHR           ; 00F6E1 CD 28 F9
GENTR:	ld     c,a             ; 00F6E4 4F
	call   CHKHEX           ; 00F6E5 CD 5D F9
	jr     c,HNHEX         ; if not hex digit
	add    hl,hl           ; 00F6EA 29
	add    hl,hl           ; 00F6EB 29
	add    hl,hl           ; 00F6EC 29
	add    hl,hl           ; 00F6ED 29
	or     l               ; 00F6EE B5
	ld     l,a             ; 00F6EF 6F
	jr     GNXTC           ; 00F6F0 18 EF
HNHEX:	ex     (sp),hl         ; 00F6F2 E3
	push   hl              ; 00F6F3 E5
	ld     a,c             ; 00F6F4 79
	call   CHKCTR           ; 00F6F5 CD 70 F9
	jr     nc,HEHEX        ; 00F6F8 30 E0
	djnz   UCREJ           ; 00F6FA 10 01
	ret                    ; 00F6FC C9
;;
;; USRCMD - display prompt and process user commands
;;
UCREJ:
	ld     hl,URESTR        ; 00F6FD 21 0F FA
	call   CONSTR           ; 00F700 CD 9C FA
USRCMD:
	ld     hl,($0006)      ; 00F703 2A 06 00
	ld     sp,hl           ; 00F706 F9
	ld     hl,USRCMD        ; 00F707 21 03 F7
	push   hl              ; 00F70A E5
	ld     ($0001),hl      ; 00F70B 22 01 00
	ld     a,$c3           ; 00F70E 3E C3
	ld     ($0000),a       ; 00F710 32 00 00
	call   OUTCRLF           ; 00F713 CD B0 FA
	call   DOPROMPT           ; 00F716 CD 25 F9
	sub    $41             ; convert to number
	jr     c,UCREJ         ; minor 0
	cp     $1a             ; 00F71D FE 1A
	jr     nc,UCREJ        ; greater than jump table
	add    a,a             ; 00F721 87
	ld     e,a             ; 00F722 5F
	ld     d,$00           ; 00F723 16 00
	ld     b,$02           ; 00F725 06 02
	ld     hl,UCMDTAB        ; 00F727 21 D2 FA
	add    hl,de           ; 00F72A 19
	ld     a,(hl)          ; 00F72B 7E
	inc    hl              ; 00F72C 23
	ld     h,(hl)          ; 00F72D 66
	ld     l,a             ; 00F72E 6F
	jp     (hl)            ; 00F72F E9
;;
;; FILLMEM - fill memory with a given values
;
FILLMEM:
	call   POP3NUM           ; 00F730 CD 33 F9
FLME1:	ld     (hl),c          ; 00F733 71
	call   CHKEOR           ; 00F734 CD 3C F9
	jr     nc,FLME1        ; 00F737 30 FA
	pop    de              ; 00F739 D1
	jr     USRCMD           ; 00F73A 18 C7
;;
;; MEMCOMP - compare two ram regions
MEMCOMP:
	call   POP3NUM           ; 00F73C CD 33 F9
MCONX:	ld     a,(bc)          ; 00F73F 0A
	push   bc              ; 00F740 C5
	ld     b,(hl)          ; 00F741 46
	cp     b               ; 00F742 B8
	jr     z,MCO1         ; 00F743 28 0C
	push   af              ; 00F745 F5
	call   HL2ASCB           ; 00F746 CD 63 FA
	ld     a,b             ; 00F749 78
	call   H2AJ3           ; 00F74A CD 5C FA
	pop    af              ; 00F74D F1
	call   H2AJ1           ; 00F74E CD 4E FA
MCO1:	pop    bc              ; 00F751 C1
	call   IPTRCKBD           ; 00F752 CD 48 F9
	jr     MCONX           ; 00F755 18 E8
;;
;; MEMDUMP - prompt user and dump memory area
;
MEMDUMP:
	call   POP2PRM           ; 00F757 CD AB FA
MDP6:	call   HL2ASCB           ; 00F75A CD 63 FA
	ld     a,l             ; 00F75D 7D
	call   DMPALIB           ; 00F75E CD 9B F7
	push   hl              ; 00F761 E5
MDP2:	ld     a,(hl)          ; 00F762 7E
	call   H2AJ1           ; 00F763 CD 4E FA
	call   CHKEOR           ; 00F766 CD 3C F9
	jr     c,MDP1         ; 00F769 38 2A
	call   SPACER           ; 00F76B CD 66 FA
	ld     a,l             ; 00F76E 7D
	and    $0f             ; 00F76F E6 0F
	jr     nz,MDP2        ; 00F771 20 EF
MDP7:	pop    hl              ; 00F773 E1
	ld     a,l             ; 00F774 7D
	and    $0f             ; 00F775 E6 0F
	call   DMPALIA           ; 00F777 CD A0 F7
MDP5:	ld     a,(hl)          ; 00F77A 7E
	nop                    ; 00F77B 00
	nop                    ; 00F77C 00
	ld     c,a             ; 00F77D 4F
	cp     $20             ; 00F77E FE 20
	jr     c,MDP3         ; 00F780 38 04
	nop                    ; 00F782 00
	nop                    ; 00F783 00
	jr     MDP4           ; 00F784 18 02
MDP3:	ld     c,$2e           ; 00F786 0E 2E
MDP4:	call   OUTCHR           ; 00F788 CD 68 FA
	call   CHKBRK           ; 00F78B CD 49 F9
	ld     a,l             ; 00F78E 7D
	and    $0f             ; 00F78F E6 0F
	jr     nz,MDP5        ; 00F791 20 E7
	jr     MDP6           ; 00F793 18 C5
MDP1:	sub    e               ; 00F795 93
	call   DMPALIB           ; 00F796 CD 9B F7
	jr     MDP7           ; 00F799 18 D8
;;
;; DMPALIB - beginning align (spacing) for a memdump
DMPALIB:
	and    $0f             ; 00F79B E6 0F
	ld     b,a             ; 00F79D 47
	add    a,a             ; 00F79E 87
	add    a,b             ; 00F79F 80
;;
;; DMPALIB - ascii align (spacing) for a memdump
DMPALIA:
	ld     b,a             ; 00F7A0 47
	inc    b               ; 00F7A1 04
ALIBN:	call   SPACER           ; 00F7A2 CD 66 FA
	djnz   ALIBN           ; 00F7A5 10 FB
	ret                    ; 00F7A7 C9
;;
;; GOEXEC - execute from user address
;
GOEXEC:
	call   POP1PRM           ; 00F7A8 CD DC F6
	pop    hl              ; 00F7AB E1
	jp     (hl)            ; 00F7AC E9
;
	nop                    ; 00F7AD 00
	nop                    ; 00F7AE 00
	nop                    ; 00F7AF 00
;;
;; GET DISPLAY CURSOR POSITION and return in HL
;
GDCUA:
	ld     a,$0e           ; 00F7B0 3E 0E
	out    (CRT6545ADST),a         ; 00F7B2 D3 8C
	in     a,(CRT6545DATA)         ; 00F7B4 DB 8D
	ld     h,a             ; 00F7B6 67
	ld     a,$0f           ; 00F7B7 3E 0F
	out    (CRT6545ADST),a         ; 00F7B9 D3 8C
	in     a,(CRT6545DATA)         ; 00F7BB DB 8D
	ld     l,a             ; 00F7BD 6F
	inc    hl              ; 00F7BE 23
	ld     a,$1f           ; 00F7BF 3E 1F
	out    (CRT6545ADST),a         ; 00F7C1 D3 8C
	ret                    ; 00F7C3 C9
;;
CIJP2:
	out    (CRT6545ADST),a         ; 00F7C4 D3 8C
	in     a,(CRT6545DATA)         ; 00F7C6 DB 8D
	ld     l,a             ; 00F7C8 6F
	call   SDCUAE           ; 00F7C9 CD 60 F0
	ex     de,hl           ; 00F7CC EB
	jp     CIJP3           ; 00F7CD C3 EE F8
;;
;; DISPCH - Display a char on CRT at current position
;
DISPCH:
	push   af              ; 00F7D0 F5
	ld     a,$1f           ; 00F7D1 3E 1F
	out    (CRT6545ADST),a         ; 00F7D3 D3 8C
	ld     a,(RAM3BUF)       ; 00F7D5 3A 28 00
	out    (CRTRAM3PORT),a         ; 00F7D8 D3 8E
	pop    af              ; 00F7DA F1
	out    (CRTRAM0DAT),a         ; 00F7DB D3 80
DCLP0:
	in     a,(CRT6545ADST)         ; 00F7DD DB 8C
	bit    7,a             ; 00F7DF CB 7F
	jr     z,DCLP0         ; 00F7E1 28 FA
	xor    a               ; 00F7E3 AF
	out    (CRT6545DATA),a         ; 00F7E4 D3 8D
	ret                    ; 00F7E6 C9

CIJP1:
	in     a,(CRT6545ADST)         ; 00F7E7 DB 8C
	bit    6,a             ; 00F7E9 CB 77
	ret    z               ; 00F7EB C8
	ld     a,$10           ; 00F7EC 3E 10
	out    (CRT6545ADST),a         ; 00F7EE D3 8C
	in     a,(CRT6545DATA)         ; 00F7F0 DB 8D
	ld     h,a             ; 00F7F2 67
	ld     a,$11           ; 00F7F3 3E 11
	jp     CIJP2           ; 00F7F5 C3 C4 F7
;;
;; PORTIN - input a byte from given port (display it in binary)
;
PORTIN:
	call   POP1PRM           ; 00F7F8 CD DC F6
	pop    bc              ; 00F7FB C1
	in     e,(c)           ; 00F7FC ED 58
	jr     BINDISP           ; 00F7FE 18 51
;;
;; PORTOUT - output a byte to a give port
PORTOUT:
	call   GETHNUM           ; 00F800 CD DE F6
	pop    de              ; 00F803 D1
	pop    bc              ; 00F804 C1
	out    (c),e           ; 00F805 ED 59
	ret                    ; 00F807 C9
;;
;; MEMMOVE - move data in memory
;
MEMMOVE:
	call   POP3NUM           ; 00F808 CD 33 F9
MMNXT:	ld     a,(hl)          ; 00F80B 7E
	ld     (bc),a          ; 00F80C 02
	call   IPTRCKBD           ; 00F80D CD 48 F9
	jr     MMNXT           ; 00F810 18 F9
;;
;; RWMEM - lets user alter memory content
;
RWMEM:
	call   POP1PRM         ; 00F812 CD DC F6
	pop    hl              ; 00F815 E1
RWM3:	ld     a,(hl)          ; 00F816 7E
	call   H2AJ3           ; 00F817 CD 5C FA
	call   VALGETCHR        ; 00F81A CD 6D F9
	ret    c               ; 00F81D D8
	jr     z,RWM1         ; 00F81E 28 0F
	cp     $0a             ; 00F820 FE 0A
	jr     z,RWM2         ; 00F822 28 0D
	push   hl              ; 00F824 E5
	call   GET1HNUM           ; 00F825 CD D3 F6
	pop    de              ; 00F828 D1
	pop    hl              ; 00F829 E1
	ld     (hl),e          ; 00F82A 73
	ld     a,c             ; 00F82B 79
	cp     $0d             ; 00F82C FE 0D
	ret    z               ; 00F82E C8
RWM1:	inc    hl              ; 00F82F 23
	inc    hl              ; 00F830 23
RWM2:	dec    hl              ; 00F831 2B
	ld     a,l             ; 00F832 7D
	and    $07             ; 00F833 E6 07
	call   z,HL2ASCB         ; 00F835 CC 63 FA
	jr     RWM3           ; 00F838 18 DC
;;
;; MEMTEST - test ram region
MEMTEST:
	call   POP2PRM           ; 00F83A CD AB FA
MTNXT:	ld     a,(hl)          ; 00F83D 7E
	push   af              ; 00F83E F5
	cpl                    ; 00F83F 2F
	ld     (hl),a          ; 00F840 77
	xor    (hl)            ; 00F841 AE
	call   nz,MTERR        ; 00F842 C4 4C F8
	pop    af              ; 00F845 F1
	ld     (hl),a          ; 00F846 77
	call   CHKBRK           ; 00F847 CD 49 F9
	jr     MTNXT           ; 00F84A 18 F1
MTERR:	push   de              ; 00F84C D5
	ld     e,a             ; 00F84D 5F
	call   HL2ASCB           ; 00F84E CD 63 FA
;;
;; BINDISP - display E in binary form
;
BINDISP:
	ld     b,$08           ; 00F851 06 08
BDNXT:	ld     a,e             ; 00F853 7B
	rlca                   ; 00F854 07
	ld     e,a             ; 00F855 5F
	ld     a,$18           ; 00F856 3E 18
	rla                    ; 00F858 17
	ld     c,a             ; 00F859 4F
	call   OUTCHR           ; 00F85A CD 68 FA
	djnz   BDNXT           ; 00F85D 10 F4
	pop    de              ; 00F85F D1
	ret                    ; 00F860 C9
;;
;; CONIN - main keyboard input handle
;
CIRBF:	ld     a,$00           ; 00F861 3E 00
	ld     (KBDBYTE),a       ; 00F863 32 26 00
CONIN:
	in     a,(CRTKEYBDAT)         ; 00F866 DB 85
	cpl                    ; 00F868 2F
	bit    7,a             ; 00F869 CB 7F
	jr     z,CIRBF         ; 00F86B 28 F4
	push   hl              ; 00F86D E5
	ld     hl,KBDBYTE        ; 00F86E 21 26 00
	cp     (hl)            ; 00F871 BE
	jr     z,CIEQB         ; 00F872 28 05
	ld     hl,$a0ff        ; 00F874 21 FF A0
	jr     CIPRC           ; 00F877 18 03
CIEQB:	ld     hl,$0400        ; 00F879 21 00 04
CIPRC:	push   af              ; 00F87C F5
CISTI:	in     a,(CRTKEYBDAT)         ; 00F87D DB 85
	cpl                    ; 00F87F 2F
	bit    7,a             ; is still pressed?
	jr     z,CIGON         ; no, go on
	dec    hl              ; 00F884 2B
	ld     a,l             ; 00F885 7D
	or     h               ; 00F886 B4
	jr     nz,CISTI        ; 00F887 20 F4
CIGON:	pop    af              ; 00F889 F1
	ld     (KBDBYTE),a       ; 00F88A 32 26 00
	res    7,a             ; 00F88D CB BF
	ld     hl,CIOBYTE        ; 00F88F 21 27 00
	bit    1,(hl)          ; 00F892 CB 4E
	ld     hl,MIOBYTE        ; 00F894 21 47 00
	jr     nz,CIBT1        ; 00F897 20 0D
CILOP:	bit    3,(hl)          ; 00F899 CB 5E
	pop    hl              ; 00F89B E1
	ret    z               ; 00F89C C8
	cp     $61             ; 00F89D FE 61
	ret    m               ; 00F89F F8
	cp     $7b             ; 00F8A0 FE 7B
	ret    p               ; 00F8A2 F0
	res    5,a             ; 00F8A3 CB AF
	ret                    ; 00F8A5 C9
CIBT1:	ld     hl,CIREN        ; 00F8A6 21 DB F8
	push   hl              ; 00F8A9 E5
	ld     hl,MIOBYTE        ; 00F8AA 21 47 00
	cp     $5e             ; test == ^
	jr     nz,CITC1        ; 00F8AF 20 03
	set    3,(hl)          ; 00F8B1 CB DE
	ret                    ; 00F8B3 C9
CITC1:	cp     $5c             ; test == \
	jr     nz,CITC2        ; 00F8B6 20 03
	res    3,(hl)          ; 00F8B8 CB 9E
	ret                    ; 00F8BA C9
CITC2:	cp     $07             ; test == CTRL+G
	jp     z,CIGRTOG         ; 00F8BD CA 40 FF
	cp     $05             ; test ==CTRL+E
	jp     z,LINDN         ; 00F8C2 CA 9B FD
	cp     $13             ; test == CTRL+S
	jp     z,CIHCR         ; 00F8C7 CA DF F8
	cp     $04             ; test == CTRL+D
	jp     z,CURRGT         ; 00F8CC CA 4E FB
	cp     $18             ; test == CTRL+X
	jp     z,IOCSY2         ; 00F8D1 CA 13 FD
	pop    hl              ; 00F8D4 E1
	ld     hl,MIOBYTE        ; 00F8D5 21 47 00
	jp     CISTP           ; 00F8D8 C3 03 F9
CIREN:	pop    hl              ; 00F8DB E1
	jp     CONIN           ; 00F8DC C3 66 F8
CIHCR:	ld     hl,CIOBYTE        ; 00F8DF 21 27 00
	ld     a,(hl)          ; 00F8E2 7E
	push   af              ; 00F8E3 F5
	push   hl              ; 00F8E4 E5
	set    4,(hl)          ; 00F8E5 CB E6
	call   IOCBS           ; 00F8E7 CD 46 FC
	pop    hl              ; 00F8EA E1
	pop    af              ; 00F8EB F1
	ld     (hl),a          ; 00F8EC 77
	ret                    ; 00F8ED C9
CIJP3:
	ld     hl,(CURPBUF)      ; 00F8EE 2A 48 00
	ex     de,hl           ; 00F8F1 EB
	xor    a               ; 00F8F2 AF
	sbc    hl,de           ; 00F8F3 ED 52
	ld     de,$0050        ; 00F8F5 11 50 00
CIJP4:	xor    a               ; 00F8F8 AF
	sbc    hl,de           ; 00F8F9 ED 52
	jr     nc,CIJP4        ; 00F8FB 30 FA
	add    hl,de           ; 00F8FD 19
	ld     a,l             ; 00F8FE 7D
	ld     (COLBUF),a       ; 00F8FF 32 29 00
	ret                    ; 00F902 C9
;
CISTP:	push   af              ; 00F903 F5
	push   de              ; 00F904 D5
	call   CIJP1           ; 00F905 CD E7 F7
	pop    de              ; 00F908 D1
	pop    af              ; 00F909 F1
	jp     CILOP           ; 00F90A C3 99 F8
	nop                    ; 00F90D 00
;;
;; SET DISPLAY START ADDRESS
;
SDSTA:
	ld     a,$0c           ; 00F90E 3E 0C
	out    (CRT6545ADST),a         ; 00F910 D3 8C
	ld     a,h             ; 00F912 7C
	out    (CRT6545DATA),a         ; 00F913 D3 8D
	ld     a,$0d           ; 00F915 3E 0D
	out    (CRT6545ADST),a         ; 00F917 D3 8C
	ld     a,l             ; 00F919 7D
	out    (CRT6545DATA),a         ; 00F91A D3 8D
	ld     a,$1f           ; 00F91C 3E 1F
	out    (CRT6545ADST),a         ; 00F91E D3 8C
	ret                    ; 00F920 C9
;;
	nop                    ; 00F921 00
	nop                    ; 00F922 00
	nop                    ; 00F923 00
	nop                    ; 00F924 00
;;
;; DOPROMPT - display prompt and wait for first key (uppercase)
;
DOPROMPT:
	call   MPROMPT           ; 00F925 CD 5F FA
DOGETCHR:
	call   COIUPC           ; 00F928 CD 89 FA
COUTCH:	push   bc              ; 00F92B C5
	ld     c,a             ; 00F92C 4F
	call   OUTCHR           ; 00F92D CD 68 FA
	ld     a,c             ; 00F930 79
	pop    bc              ; 00F931 C1
	ret                    ; 00F932 C9
;
POP3NUM:
	inc    b               ; 00F933 04
	call   GETHNUM           ; 00F934 CD DE F6
	pop    bc              ; 00F937 C1
	pop    de              ; 00F938 D1
	jp     OCRLF1           ; 00F939 C3 B1 FA
;;
CHKEOR:
	inc    hl              ; 00F93C 23
	ld     a,h             ; 00F93D 7C
	or     l               ; 00F93E B5
	scf                    ; 00F93F 37
	ret    z               ; 00F940 C8
	ld     a,e             ; 00F941 7B
	sub    l               ; 00F942 95
	ld     a,d             ; 00F943 7A
	sbc    a,h             ; 00F944 9C
	ret                    ; 00F945 C9
;;
CBKEND:	pop    de              ; 00F946 D1
	ret                    ; 00F947 C9
;;
;; inc pointer BC and check kbd
IPTRCKBD:
	inc    bc              ; 00F948 03
;;
CHKBRK:
	call   CHKEOR           ; 00F949 CD 3C F9
	jr     c,CBKEND         ; 00F94C 38 F8
	call   CHKKBD           ; 00F94E CD B9 FA
	or     a               ; 00F951 B7
	ret    z               ; 00F952 C8
	call   COIUPC           ; 00F953 CD 89 FA
	cp     $13             ; 00F956 FE 13
	jr     nz,CBKEND        ; 00F958 20 EC
	jp     COIUPC           ; 00F95A C3 89 FA
;;
;; CHKHEX - check for hex ascii char in A
;
CHKHEX:
	sub    $30             ; 00F95D D6 30
	ret    c               ; 00F95F D8
	cp     $17             ; 00F960 FE 17
	ccf                    ; 00F962 3F
	ret    c               ; 00F963 D8
	cp     $0a             ; 00F964 FE 0A
	ccf                    ; 00F966 3F
	ret    nc              ; 00F967 D0
	sub    $07             ; 00F968 D6 07
	cp     $0a             ; 00F96A FE 0A
	ret                    ; 00F96C C9
;; get chr and validate
VALGETCHR:
	call   DOGETCHR           ; 00F96D CD 28 F9
;;
;; CHKCTR: check for valid char in string (space,comma,<CR>)
;
CHKCTR:
	cp     $20             ; 00F970 FE 20
	ret    z               ; 00F972 C8
	cp     $2c             ; 00F973 FE 2C
	ret    z               ; 00F975 C8
	cp     $0d             ; 00F976 FE 0D
	scf                    ; 00F978 37
	ret    z               ; 00F979 C8
	ccf                    ; 00F97A 3F
	ret                    ; 00F97B C9
	push   hl              ; 00F97C E5
	push   de              ; 00F97D D5
	push   bc              ; 00F97E C5
	push   af              ; 00F97F F5
	call   FMEMSIZ           ; 00F980 CD 7C F6
	ex     de,hl           ; 00F983 EB
	ld     hl,$000a        ; 00F984 21 0A 00
	add    hl,sp           ; 00F987 39
	ld     b,$04           ; 00F988 06 04
	ex     de,hl           ; 00F98A EB
CCJP1:	dec    hl              ; 00F98B 2B
	ld     (hl),d          ; 00F98C 72
	dec    hl              ; 00F98D 2B
	ld     (hl),e          ; 00F98E 73
	pop    de              ; 00F98F D1
	djnz   CCJP1           ; 00F990 10 F9
	pop    bc              ; 00F992 C1
	dec    bc              ; 00F993 0B
	ld     sp,hl           ; 00F994 F9
	ld     hl,$0025        ; 00F995 21 25 00
	add    hl,sp           ; 00F998 39
	push   de              ; 00F999 D5
	ld     d,$02           ; 00F99A 16 02
CCJP3:	ld     a,(hl)          ; 00F99C 7E
	sub    c               ; 00F99D 91
	inc    hl              ; 00F99E 23
	ld     a,(hl)          ; 00F99F 7E
	sbc    a,b             ; 00F9A0 98
	jr     z,CCJP2         ; 00F9A1 28 06
	inc    hl              ; 00F9A3 23
	inc    hl              ; 00F9A4 23
	dec    d               ; 00F9A5 15
	jr     nz,CCJP3        ; 00F9A6 20 F4
	inc    bc              ; 00F9A8 03
CCJP2:	ld     hl,$0020        ; 00F9A9 21 20 00
	pop    de              ; 00F9AC D1
	add    hl,sp           ; 00F9AD 39
	ld     (hl),e          ; 00F9AE 73
	inc    hl              ; 00F9AF 23
	ld     (hl),d          ; 00F9B0 72
	push   bc              ; 00F9B1 C5
	ld     c,$2a           ; 00F9B2 0E 2A
	call   OUTCHR           ; 00F9B4 CD 68 FA
	pop    de              ; 00F9B7 D1
	ld     a,$e5           ; 00F9B8 3E E5
	cp     d               ; 00F9BA BA
	jr     z,CCJP4         ; 00F9BB 28 09
	inc    hl              ; 00F9BD 23
	inc    hl              ; 00F9BE 23
	ld     (hl),e          ; 00F9BF 73
	inc    hl              ; 00F9C0 23
	ld     (hl),d          ; 00F9C1 72
	ex     de,hl           ; 00F9C2 EB
	call   hl2as1           ; 00F9C3 CD 49 FA
CCJP4:	ld     hl,$0025        ; 00F9C6 21 25 00
	add    hl,sp           ; 00F9C9 39
	ld     bc,$0200        ; 00F9CA 01 00 02
xf9cd:	ld     e,(hl)          ; 00F9CD 5E
	ld     (hl),c          ; 00F9CE 71
	inc    hl              ; 00F9CF 23
	ld     d,(hl)          ; 00F9D0 56
	ld     (hl),c          ; 00F9D1 71
	inc    hl              ; 00F9D2 23
	ld     a,e             ; 00F9D3 7B
	or     d               ; 00F9D4 B2
	jr     z,xf9d9         ; 00F9D5 28 02
	ld     a,(hl)          ; 00F9D7 7E
	ld     (de),a          ; 00F9D8 12
xf9d9:	inc    hl              ; 00F9D9 23
	djnz   xf9cd           ; 00F9DA 10 F1
	ex     af,af'          ; 00F9DC 08
	exx                    ; 00F9DD D9
	push   hl              ; 00F9DE E5
	push   de              ; 00F9DF D5
	push   bc              ; 00F9E0 C5
	push   af              ; 00F9E1 F5
	push   ix              ; 00F9E2 DD E5
	push   iy              ; 00F9E4 FD E5
	ld     a,i             ; 00F9E6 ED 57
	ld     b,a             ; 00F9E8 47
	ld     a,r             ; 00F9E9 ED 5F
	ld     c,a             ; 00F9EB 4F
	push   bc              ; 00F9EC C5
	jp     $f307           ; 00F9ED C3 07 F3
	push   hl              ; 00F9F0 E5
	rst    08h             ; 00F9F1 CF
;;
;; Questo blocco di istruzioni viene copiato nell'ultima pagina di memoria ram
;; nei suoi ultimi byte (dfdd della pagina df00-dfff)
;; ... perche'???
;
RAMBLK:
	pop    bc              ; 00F9F2 C1
	ld     a,c             ; 00F9F3 79
	ld     r,a             ; 00F9F4 ED 4F
	ld     a,b             ; 00F9F6 78
	ld     i,a             ; 00F9F7 ED 47
	pop    ix              ; 00F9F9 DD E1
	pop    iy              ; 00F9FB FD E1
	pop    af              ; 00F9FD F1
	pop    bc              ; 00F9FE C1
	pop    de              ; 00F9FF D1
	pop    hl              ; 00FA00 E1
	ex     af,af'          ; 00FA01 08
	exx                    ; 00FA02 D9
	pop    de              ; 00FA03 D1
	pop    bc              ; 00FA04 C1
	pop    af              ; 00FA05 F1
	pop    hl              ; 00FA06 E1
	ld     sp,hl           ; 00FA07 F9
	nop                    ; 00FA08 00
	ld     hl,$0000        ; 00FA09 21 00 00
	jp     $0000           ; 00FA0C C3 00 00
;
;; User command reject string
URESTR:
	db     $aa               ; 00FA0F AA
;
;; TOGPRNIO - toggle i/o on prn/crt
TOGPRNIO:
	ld     hl,MIOBYTE        ; 00FA10 21 47 00
	bit    4,(hl)          ; 00FA13 CB 66
	jr     z,TOGPR         ; 00FA15 28 04
	res    4,(hl)          ; 00FA17 CB A6
	jr     TOGJU           ; 00FA19 18 02
TOGPR:	set    4,(hl)          ; 00FA1B CB E6
TOGJU:	jp     USRCMD           ; 00FA1D C3 03 F7
;;
;; SCRTST - Verify uf we need video scroll
;
SCRTST:
	ld     de,(CURPBUF)      ; 00FA20 ED 5B 48 00
	xor    a               ; 00FA24 AF
	sbc    hl,de           ; 00FA25 ED 52
	ld     a,h             ; 00FA27 7C
	cp     $07             ; 00FA28 FE 07
	ret    c               ; 00FA2A D8
	ld     a,l             ; 00FA2B 7D
	cp     $cf             ; 00FA2C FE CF
	ret                    ; 00FA2E C9
;
	nop                    ; 00FA2F 00
	or     a               ; 00FA30 B7
	ld     a,h             ; 00FA31 7C
	rra                    ; 00FA32 1F
	ld     h,a             ; 00FA33 67
	ld     a,l             ; 00FA34 7D
	rra                    ; 00FA35 1F
	ld     l,a             ; 00FA36 6F
	ret                    ; 00FA37 C9
;;
;; CALCHLDE - perform 16 bit add & sub between HL and DE
;
CALCHLDE:
	call   POP2PRM           ; 00FA38 CD AB FA
	push   hl              ; 00FA3B E5
	add    hl,de           ; 00FA3C 19
	call   HL2ASCB           ; 00FA3D CD 63 FA
	pop    hl              ; 00FA40 E1
	or     a               ; 00FA41 B7
	sbc    hl,de           ; 00FA42 ED 52
	jr     hl2as1           ; 00FA44 18 03
;;
;; HL2ASC - convert & display HL 2 ascii
HL2ASC:
	call   OUTCRLF           ; 00FA46 CD B0 FA
hl2as1:	ld     a,h             ; 00FA49 7C
	call   H2AJ1           ; 00FA4A CD 4E FA
	ld     a,l             ; 00FA4D 7D
H2AJ1:	push   af              ; 00FA4E F5
	rrca                   ; 00FA4F 0F
	rrca                   ; 00FA50 0F
	rrca                   ; 00FA51 0F
	rrca                   ; 00FA52 0F
	call   H2AJ2           ; 00FA53 CD 57 FA
	pop    af              ; 00FA56 F1
H2AJ2:	call   NIB2ASC           ; 00FA57 CD E0 FD
	jr     OUTCHR           ; 00FA5A 18 0C
H2AJ3:	call   H2AJ1           ; entry point to display HEX and a "-"
MPROMPT:
	ld     c,$2d           ; 00FA5F 0E 2D
	jr     OUTCHR           ; 00FA61 18 05
;;
;; HL2ASCB - convert & display HL 2 ascii leave a blank after
HL2ASCB:
	call   HL2ASC           ; 00FA63 CD 46 FA
SPACER:	ld     c,$20           ; 00FA66 0E 20
;;
;; OUTCHR - send a char to the output
;; switch CRT/PRINTER depending of bit 4 of MIOBYTE
;
OUTCHR:
	ld     a,(MIOBYTE)       ; 00FA68 3A 47 00
	bit    4,a             ; 00FA6B CB 67
	jr     z,OCJPV         ; 00FA6D 28 03
	call   JPRNCH           ; 00FA6F CD 3C F0
OCJPV:
	jp     JCONOU           ; 00FA72 C3 06 F0
;;
;; PRNCHR - send a char to printer port (from C)
;
PRNCHR:
	in     a,(CRTSERVDAT)         ; 00FA75 DB 89
	bit    PRNTBUSYBIT,a             ; 00FA77 CB 47
	jr     nz,PRNCHR        ; 00FA79 20 FA
	ld     a,c             ; 00FA7B 79
	out    (CRTPRNTDAT),a         ; 00FA7C D3 81
	ret                    ; 00FA7E C9
;;
	nop                    ; 00FA7F 00
	nop                    ; 00FA80 00
	nop                    ; 00FA81 00
	nop                    ; 00FA82 00
	nop                    ; 00FA83 00
	nop                    ; 00FA84 00
	nop                    ; 00FA85 00
	nop                    ; 00FA86 00
	nop                    ; 00FA87 00
	nop                    ; 00FA88 00
;;
;; COIUPC- convert reg A uppercase
COIUPC:
	call   JCONIN           ; 00FA89 CD 03 F0
	cp     $60             ; 00FA8C FE 60
	jp     m,COIRE         ; 00FA8E FA 98 FA
	cp     $7b             ; 00FA91 FE 7B
	jp     p,COIRE         ; 00FA93 F2 98 FA
	res    5,a             ; 00FA96 CB AF
COIRE:	ret                    ; 00FA98 C9
;;
;;
;; GREET - ...comes here from boot...
;
GREET:
	call   OUTCRLF           ; 00FA99 CD B0 FA
;;
;; CONSTR print a string using OUTCHR -> CONOUT
CONSTR:
	push   bc              ; 00FA9C C5
CSLP0:	ld     c,(hl)          ; 00FA9D 4E
	ld     b,(hl)          ; 00FA9E 46
	res    7,c             ; 00FA9F CB B9
	call   OUTCHR           ; 00FAA1 CD 68 FA
	inc    hl              ; 00FAA4 23
	ld     a,b             ; 00FAA5 78
	rlca                   ; 00FAA6 07
	jr     nc,CSLP0        ; 00FAA7 30 F4
	pop    bc              ; 00FAA9 C1
	ret                    ; 00FAAA C9
;;
POP2PRM:
	call   GETHNUM           ; 00FAAB CD DE F6
	pop    de              ; 00FAAE D1
	pop    hl              ; 00FAAF E1
;;
;; OUTCRLF - CR/LF through CONOUT
;
OUTCRLF:
	push   hl              ; 00FAB0 E5
OCRLF1:	ld     hl,CRLFTAB        ; 00FAB1 21 02 F6
	call   CONSTR           ; 00FAB4 CD 9C FA
	pop    hl              ; 00FAB7 E1
	ret                    ; 00FAB8 C9
;;
CHKKBD:
	in     a,(CRTKEYBDAT)         ; 00FAB9 DB 85
	cpl                    ; 00FABB 2F
	bit    7,a             ; 00FABC CB 7F
	ld     a,$00           ; 00FABE 3E 00
	jr     CHKKBDJ           ; 00FAC0 18 45
;;
BLOOP:
	ld     b,$02           ; 00FAC2 06 02
BLP1:	call   COIUPC           ; 00FAC4 CD 89 FA
	cp     $07             ; 00FAC7 FE 07
	jr     nz,BLOOP        ; 00FAC9 20 F7
	call   COUTCH           ; 00FACB CD 2B F9
	djnz   BLP1           ; 00FACE 10 F4
	ret                    ; 00FAD0 C9
;
	nop                    ; 00FAD1 00
UCMDTAB:
	dw     UCREJ           ; (A) n/a
	dw     JCPMBO          ; (B) cp/m boot
	dw     UCREJ           ; (C) n/a
	dw     MEMDUMP         ; (D) dump memory
	dw     UCREJ           ; (E) n/a
	dw     FILLMEM         ; (F) fill memory
	dw     GOEXEC          ; (G) go exec a sub
	dw     CALCHLDE        ; (H) sum & subtract HL, DE
	dw     PORTIN          ; (I) port input
	dw     INIT0           ; (J) init, clear screen
	dw     JBOOT           ; (K) restart system
	dw     FLOPPYREAD      ; (L) read floppy,track,sec to ram
	dw     MEMMOVE         ; (M) move memory block
	dw     NEDOSINI        ; (N) NEDOS boot page
	dw     PORTOUT         ; (O) output to a port
	dw     TOGPRNIO        ; (P) toggle prn/crt i/o
	dw     UCREJ           ; (Q) n/a
	dw     FLOPPYWRIT      ; (R) write floppy,track,sec to ram
	dw     RWMEM           ; (S) alter memory
	dw     MEMTEST         ; (T) test ram region
	dw     UCREJ           ; (U) n/a
	dw     MEMCOMP         ; (V) compare mem blocks
	dw     UCREJ           ; (W) n/a
	dw     UCREJ           ; (X) n/a
	dw     INICRTREG       ; (Y) reinit 6545
	dw     BLOOP           ; (Z)
;;
	nop                    ; 00FB06 00
;
CHKKBDJ:
	ret z                  ; 00FB07 C8
	cpl                    ; 00FB08 2F
	ret                    ; 00FB09 C9
;
	nop                    ; 00FB0A 00
	nop                    ; 00FB0B 00
	nop                    ; 00FB0C 00
	nop                    ; 00FB0D 00
	nop                    ; 00FB0E 00
	nop                    ; 00FB0F 00
;;
;; CONOUT print out the char in reg C
;
CONOUT:
	push   af              ; 00FB10 F5
	push   bc              ; 00FB11 C5
	push   de              ; 00FB12 D5
	push   hl              ; 00FB13 E5
	; force jump to register restore and exit in stack
	ld     hl,VCRESREG        ; 00FB14 21 DE FB
	push   hl              ; 00FB17 E5
	nop                    ; 00FB18 00
	nop                    ; 00FB19 00
	nop                    ; 00FB1A 00
	nop                    ; 00FB1B 00
	nop                    ; 00FB1C 00
	nop                    ; 00FB1D 00
	nop                    ; 00FB1E 00
	nop                    ; 00FB1F 00
	ld     a,c             ; 00FB20 79
	ld     hl,CIOBYTE        ; 00FB21 21 27 00
;; bit 7 ??
	bit    7,(hl)          ; 00FB24 CB 7E
	ex     de,hl           ; 00FB26 EB
	jp     nz,CONOU2        ; 00FB27 C2 98 FB
	cp     $20             ; is less then 0x20 (space)
	jr     nc,COJP1        ; no..
	ld     hl,IOCVEC        ; 00FB2E 21 00 FE
	add    a,l             ; 00FB31 85
	ld     l,a             ; 00FB32 6F
	ld     c,(hl)          ; 00FB33 4E
	ld     b,$00           ; 00FB34 06 00
	or     a               ; 00FB36 B7
	ld     hl,IOCBASE        ; 00FB37 21 30 FC
	add    hl,bc           ; 00FB3A 09
	jp     (hl)            ; jump to IOCVEC handler
COJP1:	ex     de,hl           ; 00FB3C EB
	bit    6,(hl)          ; 00FB3D CB 76 bit 6 set mean convert to uppercase
	jr     z,COJP2         ; 00FB3F 28 0A
	cp     $40             ; 00FB41 FE 40 less then 64 ?
	jr     c,COJP2         ; 00FB43 38 06
	cp     $60             ; 00FB45 FE 60 great then 96 ?
	jr     nc,COJP2        ; 00FB47 30 02
	sub    $40             ; 00FB49 D6 40 convert to upper
COJP2:	call   DISPCH           ; 00FB4B CD D0 F7
	; move cursor right
CURRGT:
	call   GDCUA           ; 00FB4E CD B0 F7
	call   SDCUAE           ; 00FB51 CD 60 F0
	ld     a,(COLBUF)       ; 00FB54 3A 29 00
	inc    a               ; 00FB57 3C
	cp     $50             ; 00FB58 FE 50
	jr     z,MOVDN         ; 00FB5A 28 04
;;
SAVCOLB:
	ld     (COLBUF),a       ; 00FB5C 32 29 00
	ret                    ; 00FB5F C9
;;
;; MOVDN: down one line, scroll, home, clreol
;
MOVDN:
	xor    a               ; 00FB60 AF
	ld     (COLBUF),a       ; 00FB61 32 29 00
MOVDN1:	call   SCRTST           ; 00FB64 CD 20 FA
	ret    c               ; 00FB67 D8
	ld     hl,CIOBYTE        ; 00FB68 21 27 00
	bit    2,(hl)          ; 00FB6B CB 56
	ld     de,$f830        ; 00FB6D 11 30 F8
	call   GDCUA           ; 00FB70 CD B0 F7
	dec    hl              ; 00FB73 2B
	jr     z,MDJMP0         ; 00FB74 28 04
	add    hl,de           ; 00FB76 19
	jp     SDCUAE           ; 00FB77 C3 60 F0
MDJMP0:	push   hl              ; 00FB7A E5
	call   CLRLIN           ; 00FB7B CD C0 FD
	ld     hl,(CURPBUF)      ; 00FB7E 2A 48 00
	ld     de,$0050        ; 00FB81 11 50 00
	add    hl,de           ; 00FB84 19
	ld     de,$0820        ; 00FB85 11 20 08
	push   hl              ; 00FB88 E5
	sbc    hl,de           ; 00FB89 ED 52
	pop    hl              ; 00FB8B E1
	jr     c,MDJMP1         ; 00FB8C 38 02
	res    3,h             ; 00FB8E CB 9C
MDJMP1:	ld     (CURPBUF),hl      ; 00FB90 22 48 00
	call   SDSTA           ; 00FB93 CD 0E F9
	jr     MOVEND           ; 00FB96 18 4B
CONOU2:
	cp     $20             ; 00FB98 FE 20
	jr     nc,C2JP1        ; 00FB9A 30 0F
	ld     hl,IOCVEC2        ; 00FB9C 21 20 FE
	add    a,l             ; 00FB9F 85
	ld     l,a             ; 00FBA0 6F
	ld     c,(hl)          ; 00FBA1 4E
	ld     b,$00           ; 00FBA2 06 00
	or     a               ; 00FBA4 B7
	ld     hl,IOCBAS2        ; 00FBA5 21 0F FD
	add    hl,bc           ; 00FBA8 09
	nop                    ; 00FBA9 00
	jp     (hl)            ; 00FBAA E9
C2JP1:	ex     de,hl           ; 00FBAB EB
	bit    0,(hl)          ; 00FBAC CB 46
	jr     nz,C2JP2        ; 00FBAE 20 0B
	cp     $70             ; 00FBB0 FE 70
	ret    nc              ; 00FBB2 D0
	sub    $20             ; 00FBB3 D6 20
	ld     ($0025),a       ; 00FBB5 32 25 00
	set    0,(hl)          ; 00FBB8 CB C6
	ret                    ; 00FBBA C9
C2JP2:	cp     $39             ; 00FBBB FE 39
	ret    nc              ; 00FBBD D0
	sub    $1f             ; 00FBBE D6 1F
	res    7,(hl)          ; 00FBC0 CB BE
	res    0,(hl)          ; 00FBC2 CB 86
	ld     b,a             ; 00FBC4 47
UKR14:	ld     hl,$ffb0        ; 00FBC5 21 B0 FF
	ld     de,$0050        ; 00FBC8 11 50 00
C2JP3:	add    hl,de           ; 00FBCB 19
	djnz   C2JP3           ; 00FBCC 10 FD
	ld     a,($0025)       ; 00FBCE 3A 25 00
	ld     (COLBUF),a       ; 00FBD1 32 29 00
	ld     e,a             ; 00FBD4 5F
	add    hl,de           ; 00FBD5 19
	ex     de,hl           ; 00FBD6 EB
	ld     hl,(CURPBUF)      ; 00FBD7 2A 48 00
	add    hl,de           ; 00FBDA 19
	jp     SDCUAE           ; 00FBDB C3 60 F0
VCRESREG:
	pop    hl              ; 00FBDE E1
	pop    de              ; 00FBDF D1
	pop    bc              ; 00FBE0 C1
	pop    af              ; 00FBE1 F1
	ret                    ; 00FBE2 C9
;; MOVEND
;
MOVEND:
	pop    hl              ; 00FBE3 E1
	jr     c,MEJP          ; 00FBE4 38 02
	res    3,h             ; 00FBE6 CB 9C
MEJP:	jp     SDCUAE           ; 00FBE8 C3 60 F0
;
	nop                    ; 00FBEB 00
	nop                    ; 00FBEC 00
	nop                    ; 00FBED 00
	nop                    ; 00FBEE 00
	nop                    ; 00FBEF 00
CURBLB:
	ld     l,$40           ; 00FBF0 2E 40 (0 10 00000) 1/16 blink scan 0
	jr     CURSETMODE           ; 00FBF2 18 16
CURBLL:
	ld     l,$4a           ; 00FBF4 2E 4A (0 10 01010) 1/16 blink scan 10
	jr     CURSETMODE           ; 00FBF6 18 12
CURBFB:
	ld     l,$60           ; 00FBF8 2E 60 (0 11 00000) 1/32 blink scan 0
	jr     CURSETMODE           ; 00FBFA 18 0E
CURBFL:
	ld     l,$6a           ; 00FBFC 2E 6A (0 11 01010) 1/32 blink scan 10
	jr     CURSETMODE           ; 00FBFE 18 0A
CUROFB:
	ld     l,$20           ; 00FC00 2E 20 (0 01 00000) no cursor scan 0
	jr     CURSETMODE           ; 00FC02 18 06
CURFXB:
	ld     l,$00           ; 00FC04 2E 00 (0 00 00000) fixed scan 0
	jr     CURSETMODE           ; 00FC06 18 02
CURFXL:
	ld     l,$0a           ; 00FC08 2E 0A (0 00 01010) fixed scan 10
CURSETMODE:
	ld     a,$0a           ; 00FC0A 3E 0A
	out    (CRT6545ADST),a         ; 00FC0C D3 8C
	ld     a,l             ; 00FC0E 7D
	out    (CRT6545DATA),a         ; 00FC0F D3 8D
	ld     a,$1f           ; 00FC11 3E 1F
	out    (CRT6545ADST),a         ; 00FC13 D3 8C
	ret                    ; 00FC15 C9
;;
;; DLIGHT
;; fill video ram (2k) with ff's
;
DLIGHT:
	ld     hl,$ffff        ; 00FC16 21 FF FF
	ld     (RAM0BUF),hl      ; 00FC19 22 2A 00
	ld     a,$ff           ; 00FC1C 3E FF
	ld     (RAM2BUF),a       ; 00FC1E 32 2C 00
	jp     CRTFIL           ; 00FC21 C3 4A FE
;;
;; DISMVC display char and move cursor
;
DISMVC:
	call   DISPCH           ; 00FC24 CD D0 F7
	jp     SDCUAE           ; 00FC27 C3 60 F0
;;
	nop                    ; 00FC2A 00
	nop                    ; 00FC2B 00
	nop                    ; 00FC2C 00
	nop                    ; 00FC2D 00
	nop                    ; 00FC2E 00
	nop                    ; 00FC2F 00
;;
;; IOCBASE (a void routine) from here a list of routines to handle
;; console char output
;
IOCBASE:
	ret                    ; 00FC30 C9
;
IOCSOH:
	ex     de,hl           ; 00FC31 EB
	set    3,(hl)          ; 00FC32 CB DE
	ret                    ; 00FC34 C9
IOCSTX:
	ex     de,hl           ; 00FC35 EB
	res    3,(hl)          ; 00FC36 CB 9E
	ret                    ; 00FC38 C9
;;
;; INICRTCUR - init CRT cursor at CURPBUF
;
INICRTCUR:
	ld     hl,(CURPBUF)      ; 00FC39 2A 48 00
	call   SDCUAE           ; 00FC3C CD 60 F0
	xor    a               ; 00FC3F AF
	jp     SAVCOLB           ; 00FC40 C3 5C FB
;;
;; IOCBEL - sound beep
IOCBEL:
	out    (CRTBEEPPORT),a         ; 00FC43 D3 8F
	ret                    ; 00FC45 C9
;;
;;
;
IOCBS:
	call   GDCUA           ; 00FC46 CD B0 F7
	dec    hl              ; 00FC49 2B
	ld     de,(CURPBUF)      ; 00FC4A ED 5B 48 00
	xor    a               ; 00FC4E AF
	sbc    hl,de           ; 00FC4F ED 52
	cp     h               ; 00FC51 BC
	jr     nz,IOCBS1        ; 00FC52 20 02
	cp     l               ; 00FC54 BD
	ret    z               ; 00FC55 C8
IOCBS1:	dec    hl              ; 00FC56 2B
	add    hl,de           ; 00FC57 19
	call   SDCUAE           ; 00FC58 CD 60 F0
	push   hl              ; 00FC5B E5
	ld     a,(COLBUF)       ; 00FC5C 3A 29 00
	dec    a               ; 00FC5F 3D
	cp     $ff             ; 00FC60 FE FF
	jr     nz,IOCBS2        ; 00FC62 20 02
	ld     a,$4f           ; 00FC64 3E 4F
IOCBS2:	ld     (COLBUF),a       ; 00FC66 32 29 00
	ld     hl,CIOBYTE        ; 00FC69 21 27 00
	bit    4,(hl)          ; 00FC6C CB 66
	pop    hl              ; 00FC6E E1
	ret    nz              ; 00FC6F C0
	ld     a,$20           ; 00FC70 3E 20
	jp     DISMVC           ; 00FC72 C3 24 FC
;;
;; CHOME - move cursor at col 0
;
CHOME:
	ld     hl,COLBUF        ; 00FC75 21 29 00
	ld     e,(hl)          ; 00FC78 5E
	xor    a               ; 00FC79 AF
	ld     (hl),a          ; 00FC7A 77
	ld     d,a             ; 00FC7B 57
	call   GDCUA           ; 00FC7C CD B0 F7
	dec    hl              ; 00FC7F 2B
	sbc    hl,de           ; 00FC80 ED 52
	call   SDCUAE           ; 00FC82 CD 60 F0
	ret                    ; 00FC85 C9
;;
;; CLRSCR - clear screen (ASCII mode)
;
CLRSCR:
	ld     hl,$0000        ; 00FC86 21 00 00
	xor    a               ; 00FC89 AF
	ld     (COLBUF),a       ; 00FC8A 32 29 00
	cpl                    ; 00FC8D 2F
	ld     (RAM3BUF),a       ; 00FC8E 32 28 00
	ld     (CURPBUF),hl      ; 00FC91 22 48 00
	call   SDCUAE           ; 00FC94 CD 60 F0
	call   SDSTA           ; 00FC97 CD 0E F9
	push   hl              ; 00FC9A E5
CLSNC:	ld     a,$20           ; 00FC9B 3E 20
	call   DISPCH           ; 00FC9D CD D0 F7
	inc    hl              ; 00FCA0 23
	ld     a,h             ; 00FCA1 7C
	cp     $08             ; 00FCA2 FE 08
	jr     nz,CLSNC        ; 00FCA4 20 F5
	pop    hl              ; 00FCA6 E1
	jp     SDCUAE           ; 00FCA7 C3 60 F0
;; IOCCR - handle carriage return (0x0d)
;; should position the cursor at col 0
;
IOCCR:
	ex     de,hl           ; 00FCAA EB
	bit    3,(hl)          ; 00FCAB CB 5E
	jr     z,IOCCR1         ; 00FCAD 28 03
	call   CLREOL           ; 00FCAF if bit 3 == 0 (???)
IOCCR1:	jp     CHOME           ; 00FCB2 C3 75 FC
;;
IOCSO:
	xor    a               ; 00FCB5 AF
	ld     hl,(CURPBUF)      ; 00FCB6 2A 48 00
	ld     de,$07d0        ; 00FCB9 11 D0 07
	add    hl,de           ; 00FCBC 19
	ex     de,hl           ; 00FCBD EB
	call   GDCUA           ; 00FCBE CD B0 F7
	dec    hl              ; 00FCC1 2B
	ex     de,hl           ; 00FCC2 EB
	sbc    hl,de           ; 00FCC3 ED 52
	push   hl              ; 00FCC5 E5
	pop    bc              ; 00FCC6 C1
CLRJ0:	call   CLRLIN1           ; 00FCC7 CD C3 FD
	ex     de,hl           ; 00FCCA EB
	jp     SDCUAE           ; 00FCCB C3 60 F0
IOCENQ:
	jp     CURBFL           ; 00FCCE C3 FC FB
IOCUS:
	jp     SET3MIOB           ; 00FCD1 C3 F0 FF
;
	nop                    ; 00FCD4 00
	nop                    ; 00FCD5 00
;;
;; CLREOL - clear to end of line
;
CLREOL:
	ld     a,(COLBUF)       ; 00FCD6 3A 29 00
	ld     b,a             ; 00FCD9 47
	ld     a,$50           ; 00FCDA 3E 50
	sub    b               ; 00FCDC 90
	ld     b,$00           ; 00FCDD 06 00
	ld     c,a             ; 00FCDF 4F
	call   GDCUA           ; 00FCE0 CD B0 F7
	dec    hl              ; 00FCE3 2B
	ex     de,hl           ; 00FCE4 EB
	jp     CLRJ0           ; 00FCE5 C3 C7 FC
;;
IOCSYN:
	ex     de,hl           ; 00FCE8 EB
	set    2,(hl)          ; 00FCE9 CB D6
	ret                    ; 00FCEB C9
IOCETB:
	ex     de,hl           ; 00FCEC EB
	res    2,(hl)          ; 00FCED CB 96
	ret                    ; 00FCEF C9
IOCFS:
	ex     de,hl           ; 00FCF0 EB
	res    1,(hl)          ; 00FCF1 CB 8E
	ret                    ; 00FCF3 C9
IOCGS:
	ex     de,hl           ; 00FCF4 EB
	set    1,(hl)          ; 00FCF5 CB CE
	ret                    ; 00FCF7 C9
IOCESC:
	ex     de,hl           ; 00FCF8 EB
	set    7,(hl)          ; 00FCF9 CB FE
	ret                    ; 00FCFB C9
;;
;; IOCLF - line feed handle
IOCLF:
	jp     LINDN           ; 00FCFC C3 9B FD
;;
;; RESATTR - reset all attributes
;
RESATTR:
	ld     a,$ff           ; 00FCFF 3E FF
	ld     (RAM3BUF),a       ; 00FD01 32 28 00
	ret                    ; 00FD04 C9
;;
IOCCAN:
	jp     INIT0           ; 00FD05 C3 C8 F5
IOCRS:
	jp     OUTGRBUF           ; 00FD08 C3 59 FF
IOCEOT:
	jp     CURBFB           ; 00FD0B C3 F8 FB

	nop                    ; 00FD0E 00
;;
;; IOCBASE2 (a void routine) from here a list of routines to handle
;; console char output
;; This is the same as IOCBASE but when bit 7 of CIOBYTE is set
;
IOCBAS2:
	ret                    ; 00FD0F C9
IOCNAK:
	jp     CURRGT           ; 00FD10 C3 4E FB
IOCSY2:
	call   GDCUA           ; 00FD13 CD B0 F7
	ld     de,$ffaf        ; 00FD16 11 AF FF
	add    hl,de           ; 00FD19 19
	ex     de,hl           ; 00FD1A EB
	ld     hl,(CURPBUF)      ; 00FD1B 2A 48 00
	ex     de,hl           ; 00FD1E EB
	xor    a               ; 00FD1F AF
	sbc    hl,de           ; 00FD20 ED 52
	cpl                    ; 00FD22 2F
	cp     h               ; 00FD23 BC
	add    hl,de           ; 00FD24 19
	ret    z               ; 00FD25 C8
	jp     SDCUAE           ; 00FD26 C3 60 F0
IOCUS2:
	jp     RES3MIOB           ; 00FD29 C3 F6 FF
	nop                    ; 00FD2C 00
	nop                    ; 00FD2D 00
	nop                    ; 00FD2E 00
IOCCA2:
	ex     de,hl           ; 00FD2F EB
	res    6,(hl)          ; 00FD30 CB B6
	ret                    ; 00FD32 C9
IOCEM:
	ex     de,hl           ; 00FD33 EB
	set    4,(hl)          ; 00FD34 CB E6
	ret                    ; 00FD36 C9
IOCSUB:
	ex     de,hl           ; 00FD37 EB
	res    4,(hl)          ; 00FD38 CB A6
	ret                    ; 00FD3A C9
IOCSO2:
	ld     hl,RAM3BUF        ; 00FD3B 21 28 00
	set    0,(hl)          ; 00FD3E CB C6
	ret                    ; 00FD40 C9
IOCFS2:
	ld     hl,RAM3BUF        ; 00FD41 21 28 00
	set    1,(hl)          ; 00FD44 CB CE
	ret                    ; 00FD46 C9
IOCETX:
	ld     hl,RAM3BUF        ; 00FD47 21 28 00
	set    2,(hl)          ; 00FD4A CB D6
	ret                    ; 00FD4C C9
IOCEN2:
	ld     hl,RAM3BUF        ; 00FD4D 21 28 00
	set    3,(hl)          ; 00FD50 CB DE
	ret                    ; 00FD52 C9
IOCBE2:
	ld     hl,RAM3BUF        ; 00FD53 21 28 00
	set    4,(hl)          ; 00FD56 CB E6
	ret                    ; 00FD58 C9
IOCS2:
	ld     hl,RAM3BUF        ; 00FD59 21 28 00
	set    5,(hl)          ; 00FD5C CB EE
	ret                    ; 00FD5E C9
IOCDLE:
	ld     hl,RAM3BUF        ; 00FD5F 21 28 00
	set    6,(hl)          ; 00FD62 CB F6
	ret                    ; 00FD64 C9
IOCGS2:
	ld     hl,RAM3BUF        ; 00FD65 21 28 00
	set    7,(hl)          ; 00FD68 CB FE
	ret                    ; 00FD6A C9
IOCST2:
	ld     hl,RAM3BUF        ; 00FD6B 21 28 00
	res    0,(hl)          ; 00FD6E CB 86
	ret                    ; 00FD70 C9
IOCES2:
	ld     hl,RAM3BUF        ; 00FD71 21 28 00
	res    1,(hl)          ; 00FD74 CB 8E
	ret                    ; 00FD76 C9
IOCEO2:
	ld     hl,RAM3BUF        ; 00FD77 21 28 00
	res    2,(hl)          ; 00FD7A CB 96
	ret                    ; 00FD7C C9
IOCAC2:
	ld     hl,RAM3BUF        ; 00FD7D 21 28 00
	res    3,(hl)          ; 00FD80 CB 9E
	ret                    ; 00FD82 C9
IOCHT:
	ld     hl,RAM3BUF        ; 00FD83 21 28 00
	res    4,(hl)          ; 00FD86 CB A6
	ret                    ; 00FD88 C9
IOCSI2:
	ld     hl,RAM3BUF        ; 00FD89 21 28 00
	res    5,(hl)          ; 00FD8C CB AE
	ret                    ; 00FD8E C9
IOCD12:
	ld     hl,RAM3BUF        ; 00FD8F 21 28 00
	res    6,(hl)          ; 00FD92 CB B6
	ret                    ; 00FD94 C9
IOCRS2:
	ld     hl,RAM3BUF        ; 00FD95 21 28 00
	res    7,(hl)          ; 00FD98 CB BE
	ret                    ; 00FD9A C9
;;
;; LINDN - cursor down one line
;
LINDN:
	call   GDCUA           ; 00FD9B CD B0 F7
	dec    hl              ; 00FD9E 2B
	ld     de,$0050        ; 00FD9F 11 50 00
	add    hl,de           ; 00FDA2 19
	call   SDCUAE           ; 00FDA3 CD 60 F0
	jp     MOVDN1           ; 00FDA6 C3 64 FB
;;
IOCNUL:
	ex     de,hl           ; 00FDA9 EB
	res    7,(hl)          ; 00FDAA CB BE
	ret                    ; 00FDAC C9
;
IOCDC2:
	jp     CURBLB           ; 00FDAD C3 F0 FB
IOCDC3:
	jp     CURBLL           ; 00FDB0 C3 F4 FB
IOCET2:
	ex     de,hl           ; 00FDB3 EB
	set    6,(hl)          ; 00FDB4 CB F6
	ret                    ; 00FDB6 C9

	nop                    ; 00FDB7 00
	nop                    ; 00FDB8 00
	nop                    ; 00FDB9 00
	nop                    ; 00FDBA 00
	nop                    ; 00FDBB 00
	nop                    ; 00FDBC 00
	nop                    ; 00FDBD 00
	nop                    ; 00FDBE 00
	nop                    ; 00FDBF 00
;;
;; CLRLIN - clear current line
;
CLRLIN:
	ld     bc,$0050        ; 00FDC0 01 50 00
CLRLIN1:
	ld     a,(RAM3BUF)       ; 00FDC3 3A 28 00
	push   af              ; 00FDC6 F5
	ld     a,$ff           ; 00FDC7 3E FF
	ld     (RAM3BUF),a       ; 00FDC9 32 28 00
CLRLP1:	ld     a,$20           ; 00FDCC 3E 20
	call   DISPCH           ; 00FDCE CD D0 F7
	dec    bc              ; 00FDD1 0B
	ld     a,b             ; 00FDD2 78
	or     c               ; 00FDD3 B1
	jr     nz,CLRLP1        ; 00FDD4 20 F6
	pop    af              ; 00FDD6 F1
	ld     (RAM3BUF),a       ; 00FDD7 32 28 00
	ret                    ; 00FDDA C9
;;
	nop                    ; 00FDDB 00
	nop                    ; 00FDDC 00
	nop                    ; 00FDDD 00
	nop                    ; 00FDDE 00
	nop                    ; 00FDDF 00
;;
;; NIB2ASC convert lower nibble in reg A to ascii in reg C
;
NIB2ASC:
	and    $0f             ; 00FDE0 E6 0F
	add    a,$90           ; 00FDE2 C6 90
	daa                    ; 00FDE4 27
	adc    a,$40           ; 00FDE5 CE 40
	daa                    ; 00FDE7 27
	ld     c,a             ; 00FDE8 4F
	ret                    ; 00FDE9 C9
IOCVT2:
	jp     CURFXL           ; 00FDEA C3 08 FC
	nop                    ; 00FDED 00
	nop                    ; 00FDEE 00
	nop                    ; 00FDEF 00
IOCFF2:
	jp     DBLANK           ; 00FDF0 C3 40 FE
	nop                    ; 00FDF3 00
	nop                    ; 00FDF4 00
	nop                    ; 00FDF5 00
	nop                    ; 00FDF6 00
	nop                    ; 00FDF7 00
	nop                    ; 00FDF8 00
	nop                    ; 00FDF9 00
	nop                    ; 00FDFA 00
	nop                    ; 00FDFB 00
	nop                    ; 00FDFC 00
	nop                    ; 00FDFD 00
	nop                    ; 00FDFE 00
	nop                    ; 00FDFF 00
;; This table define the offsets to jump from
;; IOCBASE (IOCBASE+IOCVEC) to a set fo routines that
;; handles cntrl char < 0x20 when we are in CONOUT
IOCVEC:
	db    IOCBASE-IOCBASE          ; NUL 0x00 (00)  no-op
	db    IOCSOH-IOCBASE           ; SOH 0x01 (01)  set bit 3 (de)
	db    IOCSTX-IOCBASE           ; STX 0x02 (05)  res bit 3 (de)
	db    IOCBASE-IOCBASE          ; ETX 0x03 (00)  no-op
	db    IOCEOT-IOCBASE           ; EOT 0x04 (db)  cursor blink fast block
	db    IOCENQ-IOCBASE           ; ENQ 0x05 (9e)  cursor blink fast line
	db    IOCACK-IOCBASE           ; ACK 0x06 (09)  locate cursor at CURPBUF
	db    IOCBEL-IOCBASE           ; BEL 0x07 (13)  beep
	db    IOCBS-IOCBASE            ; BS  0x08 (16)  cursor back
	db    IOCBASE-IOCBASE          ; HT  0x09 (00)  no-op
	db    IOCLF-IOCBASE            ; LF  0x0a (cc)  cursor down one line
	db    IOCVT-IOCBASE            ; VT  0x0b (45)  cursor home
	db    IOCFF-IOCBASE            ; FF  0x0c (56)  page down (clear screen)
	db    IOCCR-IOCBASE            ; CR  0x0d (7a)  cursor home
	db    IOCSO-IOCBASE            ; SO  0x0e (85)  to end of page clear line
	db    IOCSI-IOCBASE            ; SI  0x0f (a6)  clear to EOL
	db    IOCBASE-IOCBASE          ; DLE 0x10 (00)  no-op
	db    IOCDC1-IOCBASE           ; DC1 0x11 (cf)  reset all attributes
	db    IOCBASE-IOCBASE          ; DC2 0x12 (00)  no-op
	db    IOCBASE-IOCBASE          ; DC3 0x13 (00)  no-op
	db    IOCBASE-IOCBASE          ; DC4 0x14 (00)  no-op
	db    IOCBASE-IOCBASE          ; NAK 0x15 (00)  no-op
	db    IOCSYN-IOCBASE           ; SYN 0x16 (b8) set bit 2 of (de)
	db    IOCETB-IOCBASE           ; ETB 0x17 (bc) res bit 2 of (de)
	db    IOCCAN-IOCBASE           ; CAN 0x18 (d5) hard crt reset and clear
	db    IOCBASE-IOCBASE          ; EM  0x19 (00)  no-op
	db    IOCBASE-IOCBASE          ; SUB 0x1a (00)  no-op
	db    IOCESC-IOCBASE           ; ESC 0x1b (c8) set bit 7 of (de)
	db    IOCFS-IOCBASE            ; FS  0x1c (c0) res bit 1 of (de)
	db    IOCGS-IOCBASE            ; GS  0x1d (c4) set bit 1 of (de)
	db    IOCRS-IOCBASE            ; RS  0x1e (d8) display graphic buffer (ram[012]buf)
	db    IOCUS-IOCBASE            ; US  0x1f (a1) set bit 1 of (de)
;; This table define the offsets to jump from
;; IOCBAS2 (IOCBAS2+IOCVEC2) to a set fo routines that
;; handles cntrl char < 0x20 when we are in CONOUT FD0F
IOCVEC2:
	db    IOCNUL-IOCBAS2           ; NUL 0x00 (9a)  res bit 7 (de)
	db    IOCSO2-IOCBAS2           ; SOH 0x01 (2c)  set bit 0 RAM3BUF
	db    IOCST2-IOCBAS2           ; STX 0x02 (5c)  res bit 0 RAM3BUF
	db    IOCETX-IOCBAS2           ; ETX 0x03 (38)  set bit 2 RAM3BUF
	db    IOCEO2-IOCBAS2           ; EOT 0x04 (68)  res bit 2 RAM3BUF
	db    IOCEN2-IOCBAS2           ; ENQ 0x05 (3e)  set bit 3 RAM3BUF
	db    IOCAC2-IOCBAS2           ; ACK 0x06 (6e)  res bit 3 RAM3BUF
	db    IOCBE2-IOCBAS2           ; BEL 0x07 (44)  set bit 4 RAM3BUF
	db    IOCBAS2-IOCBAS2          ; BS  0x08 (00)  no-op
	db    IOCHT-IOCBAS2            ; HT  0x09 (74)  res bit 4 RAM3BUF
	db    IOCBAS2-IOCBAS2          ; LF  0x0a (00)  no-op
	db    IOCVT2-IOCBAS2           ; VT  0x0b (db)  cursor fixed line
	db    IOCFF2-IOCBAS2           ; FF  0x0c (e1)  clear screen
	db    IOCBAS2-IOCBAS2          ; CR  0x0d (00)  cursor home
	db    IOCS2-IOCBAS2            ; SO  0x0e (4a)  set bit 4 RAM3BUF
	db    IOCSI2-IOCBAS2           ; SI  0x0f (7a)  res bit 4 RAM3BUF
	db    IOCDLE-IOCBAS2           ; DLE 0x10 (50)  set bit 6 RAM3BUF
	db    IOCD12-IOCBAS2           ; DC1 0x11 (80)  res bit 6 RAM3BUF
	db    IOCDC2-IOCBAS2           ; DC2 0x12 (9e)  cursor blink slow block
	db    IOCDC3-IOCBAS2           ; DC3 0x13 (a1)  cursor blink slow line
	db    IOCDC4-IOCBAS2           ; DC4 0x14 (8c)  cursor down one line
	db    IOCNAK-IOCBAS2           ; NAK 0x15 (01)  cursor right
	db    IOCSY2-IOCBAS2           ; SYN 0x16 (04)  cursor up one line
	db    IOCET2-IOCBAS2           ; ETB 0x17 (a4)  set bit 6 of (de)
	db    IOCCA2-IOCBAS2           ; CAN 0x18 (20)  res bit 6 of (de)
	db    IOCEM-IOCBAS2            ; EM  0x19 (24)  set bit 4 of (de)
	db    IOCSUB-IOCBAS2           ; SUB 0x1a (28)  res bit 4 of (de)
	db    IOCES2-IOCBAS2           ; ESC 0x1b (62)  res bit 1 RAM3BUF
	db    IOCFS2-IOCBAS2           ; FS  0x1c (32)  set bit 1 RAM3BUF
	db    IOCGS2-IOCBAS2           ; GS  0x1d (56)  set bit 7 RAM3BUF
	db    IOCRS2-IOCBAS2           ; RS  0x1e (86)  res bit 7 RAM3BUF
	db    IOCUS2-IOCBAS2           ; US  0x1f (1a)  res bit 3 of MIOBYTE
;;
;; DBLANK
;; fill video ram (2k) with 0's
;
DBLANK:
	ld     hl,$0000        ; 00FE40 21 00 00
	ld     (RAM0BUF),hl      ; 00FE43 22 2A 00
	xor    a               ; 00FE46 AF
	ld     (RAM2BUF),a       ; 00FE47 32 2C 00
;;
;; CRTFIL - Fill video ram with ram buffer chrs
;
CRTFIL:
	ld     a,$ef           ; 00FE4A 3E EF
	ld     (RAM3BUF),a       ; 00FE4C 32 28 00
	ld     hl,$0000        ; 00FE4F 21 00 00
	ld     (CURPBUF),hl      ; 00FE52 22 48 00
	call   RDRR19R12           ; 00FE55 CD D8 F0
CFIL1:	push   hl              ; 00FE58 E5
	call   DISPGR2           ; 00FE59 CD 66 FE
	pop    hl              ; 00FE5C E1
	inc    hl              ; 00FE5D 23
	ld     a,h             ; 00FE5E 7C
	cp     $08             ; 00FE5F FE 08
	jr     nz,CFIL1        ; 00FE61 20 F5
	jp     RDRR19R12           ; 00FE63 C3 D8 F0
;;
;; DISPGR2 - absolutely the same of DISPGR but takes chars from locs
;; 002a/b/c WHY THIS???
;
DISPGR2:
	in     a,(CRT6545ADST)         ; 00FE66 DB 8C
	bit    7,a             ; 00FE68 CB 7F
	jr     z,DISPGR2         ; 00FE6A 28 FA
DISPNORTR:
	ld     hl,RAM0BUF        ; 00FE6C 21 2A 00
	ld     a,(hl)          ; 00FE6F 7E
	out    (CRTRAM0DAT),a         ; 00FE70 D3 80
	inc    hl              ; 00FE72 23
	ld     a,(hl)          ; 00FE73 7E
	out    (CRTRAM1DAT),a         ; 00FE74 D3 84
	inc    hl              ; 00FE76 23
	ld     a,(hl)          ; 00FE77 7E
	out    (CRTRAM2DAT),a         ; 00FE78 D3 88
	ld     a,(RAM3BUF)       ; 00FE7A 3A 28 00
	out    (CRTRAM3PORT),a         ; 00FE7D D3 8E
	xor    a               ; 00FE7F AF
	out    (CRT6545DATA),a         ; 00FE80 D3 8D
	ret                    ; 00FE82 C9
;;
	nop                    ; 00FE83 00
UKR13:	call   GDCUA           ; 00FE84 CD B0 F7
	push   hl              ; 00FE87 E5
	ld     a,(COLBUF)       ; 00FE88 3A 29 00
	push   af              ; 00FE8B F5
	jp     UKR04           ; 00FE8C C3 E1 FE
	nop                    ; 00FE8F 00
UKR03:	ld     a,($002d)       ; 00FE90 3A 2D 00
	cp     $a0             ; 00FE93 FE A0
	ret    nc              ; 00FE95 D0
	ld     b,a             ; 00FE96 47
	xor    a               ; 00FE97 AF
	bit    7,b             ; 00FE98 CB 78
	jr     z,UKR05         ; 00FE9A 28 02
	ld     a,$20           ; 00FE9C 3E 20
UKR05:	bit    6,b             ; 00FE9E CB 70
	jr     z,UKR06         ; 00FEA0 28 02
	add    a,$10           ; 00FEA2 C6 10
UKR06:	bit    5,b             ; 00FEA4 CB 68
	jr     z,UKR07         ; 00FEA6 28 02
	add    a,$08           ; 00FEA8 C6 08
UKR07:	bit    4,b             ; 00FEAA CB 60
	jr     z,UKR08         ; 00FEAC 28 02
	add    a,$04           ; 00FEAE C6 04
UKR08:	bit    3,b             ; 00FEB0 CB 58
	jr     z,UKR09         ; 00FEB2 28 02
	add    a,$02           ; 00FEB4 C6 02
UKR09:	bit    2,b             ; 00FEB6 CB 50
	jr     z,UKR10         ; 00FEB8 28 02
	add    a,$01           ; 00FEBA C6 01
UKR10:	ld     hl,$002f        ; 00FEBC 21 2F 00
	bit    0,(hl)          ; 00FEBF CB 46
	jr     z,UKR11         ; 00FEC1 28 02
	add    a,$28           ; 00FEC3 C6 28
UKR11:	ld     ($0025),a       ; 00FEC5 32 25 00
	ld     a,b             ; 00FEC8 78
	and    $03             ; 00FEC9 E6 03
	ld     e,a             ; 00FECB 5F
	ld     a,($002e)       ; 00FECC 3A 2E 00
	cp     $95             ; 00FECF FE 95
	ret    nc              ; 00FED1 D0
	ld     b,$01           ; 00FED2 06 01
UKR12:	sub    $06             ; 00FED4 D6 06
	jr     c,UKR41         ; 00FED6 38 03
	inc    b               ; 00FED8 04
	jr     UKR12           ; 00FED9 18 F9
UKR41:	add    a,$06           ; 00FEDB C6 06
	ld     d,a             ; 00FEDD 57
	jp     UKR13           ; 00FEDE C3 84 FE
UKR04:	nop                    ; 00FEE1 00
	push   de              ; 00FEE2 D5
	call   UKR14           ; 00FEE3 CD C5 FB
	pop    de              ; 00FEE6 D1
	ld     hl,RAM0BUF        ; 00FEE7 21 2A 00
UKR15:	in     a,(CRT6545ADST)         ; 00FEEA DB 8C
	bit    7,a             ; 00FEEC CB 7F
	jr     z,UKR15         ; 00FEEE 28 FA
	in     a,(CRTRAM0DAT)         ; 00FEF0 DB 80
	ld     (hl),a          ; 00FEF2 77
	inc    hl              ; 00FEF3 23
	in     a,(CRTRAM1DAT)         ; 00FEF4 DB 84
	ld     (hl),a          ; 00FEF6 77
	inc    hl              ; 00FEF7 23
	in     a,(CRTRAM2DAT)         ; 00FEF8 DB 88
	ld     (hl),a          ; 00FEFA 77
	ld     a,(RAM3BUF)       ; 00FEFB 3A 28 00
	res    4,a             ; 00FEFE CB A7
	ld     (RAM3BUF),a       ; 00FF00 32 28 00
	ld     hl,RAM0BUF        ; 00FF03 21 2A 00
	bit    1,d             ; 00FF06 CB 4A
	jr     z,UKR16         ; 00FF08 28 03
	inc    hl              ; 00FF0A 23
	jr     UKR17           ; 00FF0B 18 06
UKR16:	bit    2,d             ; 00FF0D CB 52
	jr     z,UKR17         ; 00FF0F 28 02
	inc    hl              ; 00FF11 23
	inc    hl              ; 00FF12 23
UKR17:	ld     a,e             ; 00FF13 7B
	bit    0,d             ; 00FF14 CB 42
	jr     z,UKR18         ; 00FF16 28 02
	add    a,$04           ; 00FF18 C6 04
UKR18:	rlca                   ; 00FF1A 07
	rlca                   ; 00FF1B 07
	rlca                   ; 00FF1C 07
	ex     de,hl           ; 00FF1D EB
	ld     hl,$002f        ; 00FF1E 21 2F 00
	bit    1,(hl)          ; 00FF21 CB 4E
	jr     z,UKR19         ; 00FF23 28 02
	set    6,a             ; 00FF25 CB F7
UKR19:	or     $86             ; 00FF27 F6 86
	ld     hl,UR200        ; 00FF29 21 74 FF
	push   hl              ; 00FF2C E5
	ld     ($002d),sp      ; 00FF2D ED 73 2D 00
	ld     hl,($002d)      ; 00FF31 2A 2D 00
	dec    hl              ; 00FF34 2B
	ld     (hl),$c9        ; 00FF35 36 C9
	dec    hl              ; 00FF37 2B
	ld     (hl),a          ; 00FF38 77
	dec    hl              ; 00FF39 2B
	ld     (hl),$cb        ; 00FF3A 36 CB
	dec    hl              ; 00FF3C 2B
	ld     (hl),$eb        ; 00FF3D 36 EB
	jp     (hl)            ; 00FF3F E9
;;
;; CIGRTOG - toggle graphic mode on
;
CIGRTOG:
	in     a,(CRT6545ADST)         ; 00FF40 DB 8C
	bit    7,a             ; 00FF42 CB 7F
	jr     z,CIGRTOG         ; 00FF44 28 FA
	in     a,(CRTRAM3PORT)         ; 00FF46 DB 8E
	set    4,a             ; 00FF48 CB E7
	ld     (RAM3BUF),a       ; 00FF4A 32 28 00
	in     a,(CRTRAM0DAT)         ; 00FF4D DB 80
	pop    hl              ; 00FF4F E1
	pop    hl              ; 00FF50 E1
	ret                    ; 00FF51 C9
;
	nop                    ; 00FF52 00
	nop                    ; 00FF53 00
	nop                    ; 00FF54 00
	nop                    ; 00FF55 00
	nop                    ; 00FF56 00
	nop                    ; 00FF57 00
	nop                    ; 00FF58 00
;;
;; OUTGRBUF - set graphic mode, display RAM[012]BUF and revert to ascii
;
OUTGRBUF:
	call   GDCUA           ; 00FF59 CD B0 F7
	dec    hl              ; 00FF5C 2B
	ld     a,(RAM3BUF)       ; 00FF5D 3A 28 00
	push   af              ; 00FF60 F5
	push   hl              ; 00FF61 E5
	res    4,a             ; 00FF62 CB A7
	ld     (RAM3BUF),a       ; 00FF64 32 28 00
	call   DISPGR2           ; 00FF67 CD 66 FE
	pop    hl              ; 00FF6A E1
	pop    af              ; 00FF6B F1
	ld     (RAM3BUF),a       ; 00FF6C 32 28 00
	jp     SDCUAE           ; 00FF6F C3 60 F0
;
	nop                    ; 00FF72 00
	nop                    ; 00FF73 00
UR200:
	call   DISPGR2           ; 00FF74 CD 66 FE
	pop    af              ; 00FF77 F1
	ld     (COLBUF),a       ; 00FF78 32 29 00
	pop    hl              ; 00FF7B E1
	dec    hl              ; 00FF7C 2B
	jp     SDCUAE           ; 00FF7D C3 60 F0
	call   GDCUA           ; 00FF80 CD B0 F7
	dec    hl              ; 00FF83 2B
	push   hl              ; 00FF84 E5
	ld     hl,$0000        ; 00FF85 21 00 00
UR206:	ld     b,$19           ; 00FF88 06 19
	push   bc              ; 00FF8A C5
	ld     b,$50           ; 00FF8B 06 50
UR205:	call   SDCUAE           ; 00FF8D CD 60 F0
UR201:	in     a,(CRT6545ADST)         ; 00FF90 DB 8C
	bit    7,a             ; 00FF92 CB 7F
	jr     z,UR201         ; 00FF94 28 FA
	in     a,(CRTRAM3PORT)         ; 00FF96 DB 8E
	bit    4,a             ; 00FF98 CB 67
	jr     nz,UR202        ; 00FF9A 20 04
UR204:	ld     a,$20           ; 00FF9C 3E 20
	jr     UR203           ; 00FF9E 18 06
UR202:	in     a,(CRTRAM0DAT)         ; 00FFA0 DB 80
	cp     $20             ; 00FFA2 FE 20
	jr     c,UR204         ; 00FFA4 38 F6
UR203:	call   PRNCHR           ; 00FFA6 CD 75 FA
	call   GDCUA           ; 00FFA9 CD B0 F7
	djnz   UR205           ; 00FFAC 10 DF
	ld     a,$0d           ; 00FFAE 3E 0D
	call   PRNCHR           ; 00FFB0 CD 75 FA
	ld     a,$0a           ; 00FFB3 3E 0A
	call   PRNCHR           ; 00FFB5 CD 75 FA
	pop    bc              ; 00FFB8 C1
	djnz   UR206           ; 00FFB9 10 CD
	pop    hl              ; 00FFBB E1
	jp     SDCUAE           ; 00FFBC C3 60 F0
	nop                    ; 00FFBF 00
;;
;;
;
UKROUT:
	push   de              ; 00FFC0 D5
	ld     e,(hl)          ; 00FFC1 5E
	inc    hl              ; 00FFC2 23
	ld     d,(hl)          ; 00FFC3 56
	ld     hl,$00a0        ; 00FFC4 21 A0 00
	ex     de,hl           ; 00FFC7 EB
	xor    a               ; 00FFC8 AF
	ld     a,$01           ; 00FFC9 3E 01
	sbc    hl,de           ; 00FFCB ED 52
	jr     nc,UKR01        ; 00FFCD 30 02
	add    hl,de           ; 00FFCF 19
	dec    a               ; 00FFD0 3D
UKR01:	ld     ($002f),a       ; 00FFD1 32 2F 00
	ld     a,l             ; 00FFD4 7D
	ld     ($002d),a       ; 00FFD5 32 2D 00
	pop    de              ; 00FFD8 D1
	ld     a,(de)          ; 00FFD9 1A
	ld     ($002e),a       ; 00FFDA 32 2E 00
	ld     a,(bc)          ; 00FFDD 0A
	bit    0,a             ; 00FFDE CB 47
	ld     hl,$002f        ; 00FFE0 21 2F 00
	jr     nz,UKR02        ; 00FFE3 20 04
	set    1,(hl)          ; 00FFE5 CB CE
	jr     UKR49           ; 00FFE7 18 02
UKR02:	res    1,(hl)          ; 00FFE9 CB 8E
UKR49:	jp     UKR03           ; 00FFEB C3 90 FE
	nop                    ; 00FFEE 00
	nop                    ; 00FFEF 00
SET3MIOB:
	ld     hl,MIOBYTE        ; 00FFF0 21 47 00
	set    3,(hl)          ; 00FFF3 CB DE
	ret                    ; 00FFF5 C9
RES3MIOB:
	ld     hl,MIOBYTE        ; 00FFF6 21 47 00
	res    3,(hl)          ; 00FFF9 CB 9E
	ret                    ; 00FFFB C9
	nop                    ; 00FFFC 00
	nop                    ; 00FFFD 00
	nop                    ; 00FFFE 00
	nop                    ; 00FFFF 00
