;****** Equ's file autogenerated by genequs ver: 1.0
;****** Input files:
;****** SysCommon.lst
VI0            	.equ	0xFFF0
VI1            	.equ	0xFFF2
VI2            	.equ	0xFFF4
VI3            	.equ	0xFFF6
VI4            	.equ	0xFFF8
VI5            	.equ	0xFFFA
VI6            	.equ	0xFFFC
VI7            	.equ	0xFFFE
TX0            	.equ	0xFF05
FIN            	.equ	0xFE4E
VC00           	.equ	0xFDC1
VC01           	.equ	0xFDC5
DLY1           	.equ	0xFD7D
DLY2           	.equ	0xFD7B
FOUT           	.equ	0xFE6F
U1NUL          	.equ	0xFEF3
U0ISR          	.equ	0xFEB7
U1ISR          	.equ	0xFEEA
DELAY          	.equ	0xFD79
UISRE          	.equ	0xFEDF
FSTAT          	.equ	0xFE3F
UISRI          	.equ	0xFEC9
COUT00         	.equ	0xFDD8
PRINT          	.equ	0xFE25
UISRS          	.equ	0xFEDC
DOSTX          	.equ	0xFEFD
DGCLP0         	.equ	0xFDE5
PRINT0         	.equ	0xFE27
PRINT1         	.equ	0xFE36
BBU1ST         	.equ	0xFC3A
BBU1RX         	.equ	0xFC35
BBU1TX         	.equ	0xFC30
BBEXEC         	.equ	0xFD1E
BBHDRD         	.equ	0xFCE4
BBVOID         	.equ	0xFD5E
DISPCH         	.equ	0xFDE4
INLINE         	.equ	0xFE39
UASTKB         	.equ	0xFF1E
MMPMAP         	.equ	0xFD5F
INTRDI         	.equ	0xFEA1
SCONIN         	.equ	0xFC21
VCONIN         	.equ	0xFC0D
BBDIV16        	.equ	0xFCC6
BBHDWR         	.equ	0xFCDF
MMGETP         	.equ	0xFD6C
INTREN         	.equ	0xFE90
RLDROM         	.equ	0xFF11
BBMUL16        	.equ	0xFCCB
SYSCOM         	.equ	0xFC00
UASTAV         	.equ	0xFF1C
MOVRGT         	.equ	0xFDC8
SYTIMR         	.equ	0xFEAB
SCONST         	.equ	0xFC26
VCONST         	.equ	0xFC12
SRXRSM         	.equ	0xFEFB
SCRTST         	.equ	0xFDF7
SRXSTP         	.equ	0xFEF7
BBEXEC1        	.equ	0xFD1B
BBEXEC2        	.equ	0xFD16
BBEXEC3        	.equ	0xFD11
BBU0INI        	.equ	0xFC2B
BBU1INI        	.equ	0xFC3F
BBFREAD        	.equ	0xFC80
BBEIDCK        	.equ	0xFCFD
BBHDGEO        	.equ	0xFCE9
BBSTACK        	.equ	0xFF4E
BBFHOME        	.equ	0xFC7B
BBCONIN        	.equ	0xFD88
SINTVEC        	.equ	0xFFF0
UPDVIDP        	.equ	0xFDFF
VBCEXIT        	.equ	0xFDDF
SYSCMLO        	.equ	0xFF4E
VOIDISR        	.equ	0xFEB4
BBCONST        	.equ	0xFD9E
EOSTEST        	.equ	0xFDCC
SCRSPOS        	.equ	0xFE04
SCONOUT        	.equ	0xFC1C
VCONOUT        	.equ	0xFDA9
BBJBNK_1       	.equ	0xFC00
BBJBNK_2       	.equ	0xFC1E
BBJBNK_3       	.equ	0xFC3A
BBCONOU2       	.equ	0xFC53
BBOFFCAL       	.equ	0xFCD0
BBINICTC       	.equ	0xFC44
BBSTBASE       	.equ	0xFF2A
BBRESCTC       	.equ	0xFC49
BBRDTIME       	.equ	0xFC99
BBCALRET       	.equ	0xFD4E
BBDMASET       	.equ	0xFCA8
BBDSKSEL       	.equ	0xFCAD
BBHDINIT       	.equ	0xFCD5
BBSECSET       	.equ	0xFCA3
BBHDBOOT       	.equ	0xFCEE
BBUPLCHR       	.equ	0xFC67
BBPRNCHR       	.equ	0xFC8F
BBVCPMBT       	.equ	0xFCB7
BBFLOPIO       	.equ	0xFC8A
BBSIDSET       	.equ	0xFCBC
BBLDPART       	.equ	0xFCF3
BBRDVDSK       	.equ	0xFC71
BBWRTIME       	.equ	0xFC94
BBSCROLL       	.equ	0xFC4E
BBFWRITE       	.equ	0xFC85
BBGETCRS       	.equ	0xFC58
BBCPBOOT       	.equ	0xFCB2
BBGETDSR       	.equ	0xFD07
UPDTUREG       	.equ	0xFE12
BBSETCRS       	.equ	0xFC5D
BBSETDSR       	.equ	0xFD02
BBCURSET       	.equ	0xFC17
BBTRKSET       	.equ	0xFC9E
BBWRVDSK       	.equ	0xFC76
BBCONOUT       	.equ	0xFD93
BBSYSINT       	.equ	0xFD0C
BBDRIVEID      	.equ	0xFCDA
BBPSNDBLK      	.equ	0xFC62
BBCRTCINI      	.equ	0xFC03
BBPRCVBLK      	.equ	0xFC6C
BBCRTFILL      	.equ	0xFC08
BBFDRVSEL      	.equ	0xFCC1
BBDPRMSET      	.equ	0xFCF8
;****** EOF ***

