;****** Equ's file autogenerated by genequs ver: 1.0
;****** Input files:
;****** SysCommon.lst
VI0            	.equ	0xFFF0
VI1            	.equ	0xFFF2
VI2            	.equ	0xFFF4
VI3            	.equ	0xFFF6
VI4            	.equ	0xFFF8
VI5            	.equ	0xFFFA
VI6            	.equ	0xFFFC
VI7            	.equ	0xFFFE
TX0            	.equ	0xFF33
FIN            	.equ	0xFE7C
VC00           	.equ	0xFDE9
VC01           	.equ	0xFDED
DLY1           	.equ	0xFDA5
DLY2           	.equ	0xFDA3
RPCH           	.equ	0xFE67
FOUT           	.equ	0xFE9D
U1NUL          	.equ	0xFF21
U0ISR          	.equ	0xFEE5
U1ISR          	.equ	0xFF18
DELAY          	.equ	0xFDA1
UISRE          	.equ	0xFF0D
FSTAT          	.equ	0xFE6D
UISRI          	.equ	0xFEF7
COUT00         	.equ	0xFE00
PRINT          	.equ	0xFE4D
UISRS          	.equ	0xFF0A
DOSTX          	.equ	0xFF2B
DGCLP0         	.equ	0xFE0D
PRINT0         	.equ	0xFE4F
PRINT1         	.equ	0xFE5E
BBU1ST         	.equ	0xFC3A
BBU1RX         	.equ	0xFC35
BBU1TX         	.equ	0xFC30
BBEXEC         	.equ	0xFD46
BBHDRD         	.equ	0xFCE4
BBVOID         	.equ	0xFD86
DISPCH         	.equ	0xFE0C
INLINE         	.equ	0xFE61
UASTKB         	.equ	0xFF4C
MMPMAP         	.equ	0xFD87
INTRDI         	.equ	0xFECF
BBDBOX         	.equ	0xFC62
SCONIN         	.equ	0xFC21
VCONIN         	.equ	0xFC0D
BBDIV16        	.equ	0xFCC1
BBHDWR         	.equ	0xFCDF
MMGETP         	.equ	0xFD94
INTREN         	.equ	0xFEBE
RLDROM         	.equ	0xFF3F
BBMUL16        	.equ	0xFCC6
UASTAV         	.equ	0xFF4A
MOVRGT         	.equ	0xFDF0
SYTIMR         	.equ	0xFED9
SCONST         	.equ	0xFC26
VCONST         	.equ	0xFC12
SRXRSM         	.equ	0xFF29
SCRTST         	.equ	0xFE1F
SRXSTP         	.equ	0xFF25
BBEXEC1        	.equ	0xFD43
BBEXEC2        	.equ	0xFD3E
BBEXEC3        	.equ	0xFD39
BBEXEC4        	.equ	0xFD34
BBEXEC5        	.equ	0xFD2F
BBEXEC6        	.equ	0xFD2A
BBEXEC7        	.equ	0xFD25
BBU0INI        	.equ	0xFC2B
BBU1INI        	.equ	0xFC3F
BBFREAD        	.equ	0xFC85
BBEIDCK        	.equ	0xFCF8
BBHDGEO        	.equ	0xFCE9
BBSTACK        	.equ	0xFF7C
BBFHOME        	.equ	0xFC80
BBCONIN        	.equ	0xFDB0
SINTVEC        	.equ	0xFFF0
UPDVIDP        	.equ	0xFE27
VBCEXIT        	.equ	0xFE07
SYSCMLO        	.equ	0xFF7C
VOIDISR        	.equ	0xFEE2
BBCONST        	.equ	0xFDC6
EOSTEST        	.equ	0xFDF4
SCRSPOS        	.equ	0xFE2C
SCONOUT        	.equ	0xFC1C
VCONOUT        	.equ	0xFDD1
BBJBNK_2       	.equ	0xFC1E
BBJBNK_3       	.equ	0xFC3C
BBJBNK_4       	.equ	0xFC5A
BBJBNK_5       	.equ	0xFC78
BBJBNK_6       	.equ	0xFC96
BBJBNK_7       	.equ	0xFCB4
BBCONOU2       	.equ	0xFC53
BBSYSFN1       	.equ	0xFD1B
BBSYSFN2       	.equ	0xFD20
BBOFFCAL       	.equ	0xFCCB
BBINICTC       	.equ	0xFC44
BBSTBASE       	.equ	0xFF58
BBRESCTC       	.equ	0xFC49
BBRDTIME       	.equ	0xFC9E
BBCALRET       	.equ	0xFD76
BBDMASET       	.equ	0xFCAD
BBDSKSEL       	.equ	0xFCB2
BBHDINIT       	.equ	0xFCD5
BBSECSET       	.equ	0xFCA8
BBUPLCHR       	.equ	0xFC6C
BBPRNCHR       	.equ	0xFC94
BBFLOPIO       	.equ	0xFC8F
BBSIDSET       	.equ	0xFCB7
BBLDPART       	.equ	0xFCEE
BBRDVDSK       	.equ	0xFC76
BBWRTIME       	.equ	0xFC99
BBSCROLL       	.equ	0xFC4E
BBFWRITE       	.equ	0xFC8A
BBGETCRS       	.equ	0xFC58
BBGETDSR       	.equ	0xFD02
UPDTUREG       	.equ	0xFE3A
BBSETCRS       	.equ	0xFC5D
BBSETDSR       	.equ	0xFCFD
BBCURSET       	.equ	0xFC17
BBTRKSET       	.equ	0xFCA3
BBWRVDSK       	.equ	0xFC7B
BBMVPART       	.equ	0xFD07
BBCONOUT       	.equ	0xFDBB
BBSYSMON       	.equ	0xFD11
BBSYSINT       	.equ	0xFD0C
BBSYSEXT       	.equ	0xFD16
BBDRIVEID      	.equ	0xFCDA
BBPSNDBLK      	.equ	0xFC67
BBCRTCINI      	.equ	0xFC03
BBPRCVBLK      	.equ	0xFC71
BBCRTFILL      	.equ	0xFC08
BBFDRVSEL      	.equ	0xFCBC
BBLOGHDRV      	.equ	0xFCD0
BBDPRMSET      	.equ	0xFCF3
;****** EOF ***

